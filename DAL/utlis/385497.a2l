ASAP2_VERSION 1 71
/begin PROJECT ProjectName "Project Comment Goes Here"
/begin HEADER "Header Comments go here" /end HEADER
/begin MODULE ModuleName "Module Comment Goes Here"
/begin MOD_COMMON "Common definitions" BYTE_ORDER MSB_LAST ALIGNMENT_BYTE 1 ALIGNMENT_WORD 2 ALIGNMENT_LONG 4 ALIGNMENT_FLOAT32_IEEE 4 ALIGNMENT_FLOAT64_IEEE 8 /end MOD_COMMON
/begin MOD_COMMON "Mod Common Comment Here" BYTE_ORDER MSB_LAST ALIGNMENT_BYTE 1 ALIGNMENT_WORD 2 ALIGNMENT_LONG 4 ALIGNMENT_FLOAT32_IEEE 4 ALIGNMENT_FLOAT64_IEEE 8 ALIGNMENT_INT64 8 /end MOD_COMMON
/begin CHARACTERISTIC S2S_AmbLightAllZoneReq_Dummy "" VALUE 0x34700045 /* @ECU_Address@S2S_AmbLightAllZoneReq_Dummy@ */ Record_UBYTE 0 CM_uint8 0 255 /end CHARACTERISTIC
/begin CHARACTERISTIC TIME_FRAME "Time frame" VALUE 0x34703644 /* @ECU_Address@TIME_FRAME@ */ Record_FLOAT32_IEEE 0 CM_single -3.4E+38 3.4E+38 /end CHARACTERISTIC
/begin CHARACTERISTIC FLASH_CYCLE "Flash turn light cycle" VALUE 0x347035F0 /* @ECU_Address@FLASH_CYCLE@ */ Record_FLOAT32_IEEE 0 CM_single -3.4E+38 3.4E+38 /end CHARACTERISTIC
/begin CHARACTERISTIC DEACTIVATE_HIGH_BEAM_FLASHING_TIME "Flashing high beam function will be deactivated if SCM send \"High-beam light flashing status\" = \"ON\" for more than 20s" VALUE 0x347035E0 /* @ECU_Address@DEACTIVATE_HIGH_BEAM_FLASHING_TIME@ */ Record_FLOAT32_IEEE 0 CM_single -3.4E+38 3.4E+38 /end CHARACTERISTIC
/begin CHARACTERISTIC WALK_AW_TIMEOUT "User not walk away timeout" VALUE 0x347035C0 /* @ECU_Address@WALK_AW_TIMEOUT@ */ Record_FLOAT32_IEEE 0 CM_single -3.4E+38 3.4E+38 /end CHARACTERISTIC
/begin CHARACTERISTIC SPEED_LOCK_DEFAULT "" VALUE 0x347035BC /* @ECU_Address@SPEED_LOCK_DEFAULT@ */ Record_FLOAT32_IEEE 0 CM_single -3.4E+38 3.4E+38 /end CHARACTERISTIC
/begin CHARACTERISTIC RELOCK_DELAY_TIME "Speed sensing auto lock delay times" VALUE 0x347035B8 /* @ECU_Address@RELOCK_DELAY_TIME@ */ Record_FLOAT32_IEEE 0 CM_single -3.4E+38 3.4E+38 /end CHARACTERISTIC
/begin CHARACTERISTIC N1 "Key invalid re-search times" VALUE 0x347035B4 /* @ECU_Address@N1@ */ Record_FLOAT32_IEEE 0 CM_single -3.4E+38 3.4E+38 /end CHARACTERISTIC
/begin CHARACTERISTIC IRIV "Key invalid re-search interval" VALUE 0x347035B0 /* @ECU_Address@IRIV@ */ Record_FLOAT32_IEEE 0 CM_single -3.4E+38 3.4E+38 /end CHARACTERISTIC
/begin CHARACTERISTIC DOOR_LOCK_DELAY "central button trigger unlock delay time" VALUE 0x347035AC /* @ECU_Address@DOOR_LOCK_DELAY@ */ Record_FLOAT32_IEEE 0 CM_single -3.4E+38 3.4E+38 /end CHARACTERISTIC
/begin CHARACTERISTIC CLM_VehMoveSpdThd_P "vehicle moving speed threshold" VALUE 0x347035A8 /* @ECU_Address@CLM_VehMoveSpdThd_P@ */ Record_FLOAT32_IEEE 0 CM_single -3.4E+38 3.4E+38 /end CHARACTERISTIC
/begin CHARACTERISTIC CLM_UnlockLockReqDelayTd_P "" VALUE 0x347035A4 /* @ECU_Address@CLM_UnlockLockReqDelayTd_P@ */ Record_FLOAT32_IEEE 0 CM_single -3.4E+38 3.4E+38 /end CHARACTERISTIC
/begin CHARACTERISTIC CLM_SampleTi_P "Sample time" VALUE 0x347035A0 /* @ECU_Address@CLM_SampleTi_P@ */ Record_FLOAT32_IEEE 0 CM_single -3.4E+38 3.4E+38 /end CHARACTERISTIC
/begin CHARACTERISTIC CLM_ReminderDelayTd_P "" VALUE 0x3470359C /* @ECU_Address@CLM_ReminderDelayTd_P@ */ Record_FLOAT32_IEEE 0 CM_single -3.4E+38 3.4E+38 /end CHARACTERISTIC
/begin CHARACTERISTIC CLM_PEDelayTd_P "" VALUE 0x34703598 /* @ECU_Address@CLM_PEDelayTd_P@ */ Record_FLOAT32_IEEE 0 CM_single -3.4E+38 3.4E+38 /end CHARACTERISTIC
/begin CHARACTERISTIC CLM_KeyFOBSearchReqDelayTd_P "" VALUE 0x34703594 /* @ECU_Address@CLM_KeyFOBSearchReqDelayTd_P@ */ Record_FLOAT32_IEEE 0 CM_single -3.4E+38 3.4E+38 /end CHARACTERISTIC
/begin CHARACTERISTIC CLM_IniTi_P "Timer initial time" VALUE 0x34703590 /* @ECU_Address@CLM_IniTi_P@ */ Record_FLOAT32_IEEE 0 CM_single -3.4E+38 3.4E+38 /end CHARACTERISTIC
/begin CHARACTERISTIC CLM_DriverCfg_P "0: Driver Door is FL Door 1: Driver Door is FR Door" VALUE 0x347000EE /* @ECU_Address@CLM_DriverCfg_P@ */ Record_UBYTE 0 CM_uint8 0 255 /end CHARACTERISTIC
/begin CHARACTERISTIC CLM_DoorOpenWarnCfg_P "Door Open Warning" VALUE 0x347000ED /* @ECU_Address@CLM_DoorOpenWarnCfg_P@ */ Record_UBYTE 0 CM_uint8 0 255 /end CHARACTERISTIC
/begin CHARACTERISTIC CLM_DoorOpenReqDelayTd_P "" VALUE 0x3470358C /* @ECU_Address@CLM_DoorOpenReqDelayTd_P@ */ Record_FLOAT32_IEEE 0 CM_single -3.4E+38 3.4E+38 /end CHARACTERISTIC
/begin CHARACTERISTIC CLM_DisaWalkAwayLockCfg_P "Disable switch for walk away lock configuration" VALUE 0x347000EC /* @ECU_Address@CLM_DisaWalkAwayLockCfg_P@ */ Record_UBYTE 0 CM_uint8 0 255 /end CHARACTERISTIC
/begin CHARACTERISTIC CLM_DisaUnlockOption_P "Disable unlock option value (Driver door or All door)" VALUE 0x347000EB /* @ECU_Address@CLM_DisaUnlockOption_P@ */ Record_UBYTE 0 CM_uint8 0 255 /end CHARACTERISTIC
/begin CHARACTERISTIC CLM_DisaUnlockOptionCfg_P "Disable switch for unlock option configuration" VALUE 0x347000EA /* @ECU_Address@CLM_DisaUnlockOptionCfg_P@ */ Record_UBYTE 0 CM_uint8 0 255 /end CHARACTERISTIC
/begin CHARACTERISTIC CLM_DisaSpdLockCfg_P "Disable switch for speed sensing lock configuration" VALUE 0x347000E9 /* @ECU_Address@CLM_DisaSpdLockCfg_P@ */ Record_UBYTE 0 CM_uint8 0 255 /end CHARACTERISTIC
/begin CHARACTERISTIC CLM_DisaRelsCfg_P "" VALUE 0x347000E8 /* @ECU_Address@CLM_DisaRelsCfg_P@ */ Record_UBYTE 0 CM_uint8 0 255 /end CHARACTERISTIC
/begin CHARACTERISTIC CLM_DisaParkUnlockSetCfg_P "" VALUE 0x347000E7 /* @ECU_Address@CLM_DisaParkUnlockSetCfg_P@ */ Record_UBYTE 0 CM_uint8 0 255 /end CHARACTERISTIC
/begin CHARACTERISTIC CLM_DisaFeedbackCfg_P "Disable switch for unlock\\lock feedback configuration" VALUE 0x347000E6 /* @ECU_Address@CLM_DisaFeedbackCfg_P@ */ Record_UBYTE 0 CM_uint8 0 255 /end CHARACTERISTIC
/begin CHARACTERISTIC CLM_DisaCentralBtnCfg_P "Disable switch for central button configuration" VALUE 0x347000E5 /* @ECU_Address@CLM_DisaCentralBtnCfg_P@ */ Record_UBYTE 0 CM_uint8 0 255 /end CHARACTERISTIC
/begin CHARACTERISTIC CLM_AutoRelockTime_P "Auto relock countdown time." VALUE 0x34703588 /* @ECU_Address@CLM_AutoRelockTime_P@ */ Record_FLOAT32_IEEE 0 CM_single -3.4E+38 3.4E+38 /end CHARACTERISTIC
/begin CHARACTERISTIC CLM_AutoRelockCfg_P "Disable switch for auto relock configuration" VALUE 0x347000E4 /* @ECU_Address@CLM_AutoRelockCfg_P@ */ Record_UBYTE 0 CM_uint8 0 255 /end CHARACTERISTIC
/begin CHARACTERISTIC AUTO_RELOCK_TRY_TIME "Speed sensing auto lock times" VALUE 0x34703584 /* @ECU_Address@AUTO_RELOCK_TRY_TIME@ */ Record_FLOAT32_IEEE 0 CM_single -3.4E+38 3.4E+38 /end CHARACTERISTIC
/begin CHARACTERISTIC ARIV "Key valid AR re-search interval" VALUE 0x34703580 /* @ECU_Address@ARIV@ */ Record_FLOAT32_IEEE 0 CM_single -3.4E+38 3.4E+38 /end CHARACTERISTIC
/begin CHARACTERISTIC ELM_FRAHLTargetPosition_Dummy "" VALUE 0x34700122 /* @ECU_Address@ELM_FRAHLTargetPosition_Dummy@ */ Record_UWORD 0 CM_uint16 0 65535 /end CHARACTERISTIC
/begin CHARACTERISTIC ELM_FLAHLTargetPosition_Dummy "" VALUE 0x34700120 /* @ECU_Address@ELM_FLAHLTargetPosition_Dummy@ */ Record_UWORD 0 CM_uint16 0 65535 /end CHARACTERISTIC
/begin CHARACTERISTIC COM_WindowDSBBtnPressRR_Dummy "" VALUE 0x34700089 /* @ECU_Address@COM_WindowDSBBtnPressRR_Dummy@ */ Record_UBYTE 0 CM_uint8 0 255 /end CHARACTERISTIC
/begin CHARACTERISTIC COM_WindowDSBBtnPressRL_Dummy "" VALUE 0x34700088 /* @ECU_Address@COM_WindowDSBBtnPressRL_Dummy@ */ Record_UBYTE 0 CM_uint8 0 255 /end CHARACTERISTIC
/begin CHARACTERISTIC COM_WindowDSBBtnPressFR_Dummy "" VALUE 0x34700087 /* @ECU_Address@COM_WindowDSBBtnPressFR_Dummy@ */ Record_UBYTE 0 CM_uint8 0 255 /end CHARACTERISTIC
/begin CHARACTERISTIC COM_WindowDSBBtnPressFL_Dummy "" VALUE 0x34700086 /* @ECU_Address@COM_WindowDSBBtnPressFL_Dummy@ */ Record_UBYTE 0 CM_uint8 0 255 /end CHARACTERISTIC
/begin CHARACTERISTIC WWM_AutoOrIntervalModeSts_Dummy "" VALUE 0x34700085 /* @ECU_Address@WWM_AutoOrIntervalModeSts_Dummy@ */ Record_UBYTE 0 CM_uint8 0 255 /end CHARACTERISTIC
/begin CHARACTERISTIC WWM_AutoModeLEDSts_Dummy "" VALUE 0x34700084 /* @ECU_Address@WWM_AutoModeLEDSts_Dummy@ */ Record_UBYTE 0 CM_uint8 0 255 /end CHARACTERISTIC
/begin CHARACTERISTIC ELM_AHBRightHBStatus_Dummy "" VALUE 0x34700083 /* @ECU_Address@ELM_AHBRightHBStatus_Dummy@ */ Record_UBYTE 0 CM_uint8 0 255 /end CHARACTERISTIC
/begin CHARACTERISTIC ELM_AHBLeftHBStatus_Dummy "" VALUE 0x34700082 /* @ECU_Address@ELM_AHBLeftHBStatus_Dummy@ */ Record_UBYTE 0 CM_uint8 0 255 /end CHARACTERISTIC
/begin CHARACTERISTIC ELM_AHBStatus_Dummy "" VALUE 0x34700081 /* @ECU_Address@ELM_AHBStatus_Dummy@ */ Record_UBYTE 0 CM_uint8 0 255 /end CHARACTERISTIC
/begin CHARACTERISTIC ILM_PWM_FN_ILUM_LIN_Dummy "" VALUE 0x34700080 /* @ECU_Address@ILM_PWM_FN_ILUM_LIN_Dummy@ */ Record_UBYTE 0 CM_uint8 0 255 /end CHARACTERISTIC
/begin CHARACTERISTIC Nv_AutoSunroofSts_Dummy "" VALUE 0x3470007F /* @ECU_Address@Nv_AutoSunroofSts_Dummy@ */ Record_UBYTE 0 CM_uint8 0 255 /end CHARACTERISTIC
/begin CHARACTERISTIC MHU_SetRearDefrost_Dummy "" VALUE 0x3470007E /* @ECU_Address@MHU_SetRearDefrost_Dummy@ */ Record_UBYTE 0 CM_uint8 0 255 /end CHARACTERISTIC
/begin CHARACTERISTIC MFS_UpControl_Dummy "" VALUE 0x3470007D /* @ECU_Address@MFS_UpControl_Dummy@ */ Record_UBYTE 0 CM_uint8 0 255 /end CHARACTERISTIC
/begin CHARACTERISTIC MFS_RightControl_Dummy "" VALUE 0x3470007C /* @ECU_Address@MFS_RightControl_Dummy@ */ Record_UBYTE 0 CM_uint8 0 255 /end CHARACTERISTIC
/begin CHARACTERISTIC MFS_LeftControl_Dummy "" VALUE 0x3470007B /* @ECU_Address@MFS_LeftControl_Dummy@ */ Record_UBYTE 0 CM_uint8 0 255 /end CHARACTERISTIC
/begin CHARACTERISTIC MFS_DownControl_Dummy "" VALUE 0x3470007A /* @ECU_Address@MFS_DownControl_Dummy@ */ Record_UBYTE 0 CM_uint8 0 255 /end CHARACTERISTIC
/begin CHARACTERISTIC S2S_WindowCAppControlRR_Dummy "" VALUE 0x34700079 /* @ECU_Address@S2S_WindowCAppControlRR_Dummy@ */ Record_UBYTE 0 CM_uint8 0 255 /end CHARACTERISTIC
/begin CHARACTERISTIC S2S_WindowCAppControlRL_Dummy "" VALUE 0x34700078 /* @ECU_Address@S2S_WindowCAppControlRL_Dummy@ */ Record_UBYTE 0 CM_uint8 0 255 /end CHARACTERISTIC
/begin CHARACTERISTIC S2S_WindowCAppControlFR_Dummy "" VALUE 0x34700077 /* @ECU_Address@S2S_WindowCAppControlFR_Dummy@ */ Record_UBYTE 0 CM_uint8 0 255 /end CHARACTERISTIC
/begin CHARACTERISTIC S2S_WindowCAppControlFL_Dummy "" VALUE 0x34700076 /* @ECU_Address@S2S_WindowCAppControlFL_Dummy@ */ Record_UBYTE 0 CM_uint8 0 255 /end CHARACTERISTIC
/begin CHARACTERISTIC S2S_WindowVoiceControlRR_Dummy "" VALUE 0x34700075 /* @ECU_Address@S2S_WindowVoiceControlRR_Dummy@ */ Record_UBYTE 0 CM_uint8 0 255 /end CHARACTERISTIC
/begin CHARACTERISTIC S2S_WindowVoiceControlRL_Dummy "" VALUE 0x34700074 /* @ECU_Address@S2S_WindowVoiceControlRL_Dummy@ */ Record_UBYTE 0 CM_uint8 0 255 /end CHARACTERISTIC
/begin CHARACTERISTIC S2S_WindowVoiceControlFR_Dummy "" VALUE 0x34700073 /* @ECU_Address@S2S_WindowVoiceControlFR_Dummy@ */ Record_UBYTE 0 CM_uint8 0 255 /end CHARACTERISTIC
/begin CHARACTERISTIC S2S_WindowVoiceControlFL_Dummy "" VALUE 0x34700072 /* @ECU_Address@S2S_WindowVoiceControlFL_Dummy@ */ Record_UBYTE 0 CM_uint8 0 255 /end CHARACTERISTIC
/begin CHARACTERISTIC S2S_WashModeSet_Dummy "" VALUE 0x34700071 /* @ECU_Address@S2S_WashModeSet_Dummy@ */ Record_UBYTE 0 CM_uint8 0 255 /end CHARACTERISTIC
/begin CHARACTERISTIC S2S_RearWiperAutoModeSet_Dummy "" VALUE 0x34700070 /* @ECU_Address@S2S_RearWiperAutoModeSet_Dummy@ */ Record_UBYTE 0 CM_uint8 0 255 /end CHARACTERISTIC
/begin CHARACTERISTIC S2S_WiperServiceModeSet_Dummy "" VALUE 0x3470006F /* @ECU_Address@S2S_WiperServiceModeSet_Dummy@ */ Record_UBYTE 0 CM_uint8 0 255 /end CHARACTERISTIC
/begin CHARACTERISTIC S2S_CAPPHornRequest_Dummy "" VALUE 0x3470006E /* @ECU_Address@S2S_CAPPHornRequest_Dummy@ */ Record_UBYTE 0 CM_uint8 0 255 /end CHARACTERISTIC
/begin CHARACTERISTIC CVC_RemoteParkingRequest_Dummy "" VALUE 0x3470006D /* @ECU_Address@CVC_RemoteParkingRequest_Dummy@ */ Record_UBYTE 0 CM_uint8 0 255 /end CHARACTERISTIC
/begin CHARACTERISTIC CVC_ACTGear_Dummy "" VALUE 0x3470006C /* @ECU_Address@CVC_ACTGear_Dummy@ */ Record_UBYTE 0 CM_uint8 0 255 /end CHARACTERISTIC
/begin CHARACTERISTIC CVC_TransportModeSts_Dummy "" VALUE 0x3470006B /* @ECU_Address@CVC_TransportModeSts_Dummy@ */ Record_UBYTE 0 CM_uint8 0 255 /end CHARACTERISTIC
/begin CHARACTERISTIC CVC_AccessoryModeRequest_Dummy "" VALUE 0x3470006A /* @ECU_Address@CVC_AccessoryModeRequest_Dummy@ */ Record_UBYTE 0 CM_uint8 0 255 /end CHARACTERISTIC
/begin CHARACTERISTIC FCAM_RemoteDrivingRequest_Dummy "" VALUE 0x34700069 /* @ECU_Address@FCAM_RemoteDrivingRequest_Dummy@ */ Record_UBYTE 0 CM_uint8 0 255 /end CHARACTERISTIC
/begin CHARACTERISTIC CVC_OtaRequest_Dummy "" VALUE 0x34700068 /* @ECU_Address@CVC_OtaRequest_Dummy@ */ Record_UBYTE 0 CM_uint8 0 255 /end CHARACTERISTIC
/begin CHARACTERISTIC CVC_ActualGearValid_Dummy "" VALUE 0x34700067 /* @ECU_Address@CVC_ActualGearValid_Dummy@ */ Record_UBYTE 0 CM_uint8 0 255 /end CHARACTERISTIC
/begin CHARACTERISTIC Nv_WelcomeLightSet_Dummy "" VALUE 0x34700066 /* @ECU_Address@Nv_WelcomeLightSet_Dummy@ */ Record_UBYTE 0 CM_uint8 0 255 /end CHARACTERISTIC
/begin CHARACTERISTIC S2S_WelcomeLightSet_Dummy "" VALUE 0x34700065 /* @ECU_Address@S2S_WelcomeLightSet_Dummy@ */ Record_UBYTE 0 CM_uint8 0 255 /end CHARACTERISTIC
/begin CHARACTERISTIC Nv_FMHSet_Dummy "" VALUE 0x34700064 /* @ECU_Address@Nv_FMHSet_Dummy@ */ Record_UBYTE 0 CM_uint8 0 255 /end CHARACTERISTIC
/begin CHARACTERISTIC S2S_FMHSet_Dummy "" VALUE 0x34700063 /* @ECU_Address@S2S_FMHSet_Dummy@ */ Record_UBYTE 0 CM_uint8 0 255 /end CHARACTERISTIC
/begin CHARACTERISTIC S2S_AHBSet_Dummy "" VALUE 0x34700062 /* @ECU_Address@S2S_AHBSet_Dummy@ */ Record_UBYTE 0 CM_uint8 0 255 /end CHARACTERISTIC
/begin CHARACTERISTIC IDB_BrakingSensorStatus_Dummy "" VALUE 0x34700061 /* @ECU_Address@IDB_BrakingSensorStatus_Dummy@ */ Record_UBYTE 0 CM_uint8 0 255 /end CHARACTERISTIC
/begin CHARACTERISTIC Nv_RearFogLightSet_Dummy "" VALUE 0x34700060 /* @ECU_Address@Nv_RearFogLightSet_Dummy@ */ Record_UBYTE 0 CM_uint8 0 255 /end CHARACTERISTIC
/begin CHARACTERISTIC S2S_RearFogLightSet_Dummy "" VALUE 0x3470005F /* @ECU_Address@S2S_RearFogLightSet_Dummy@ */ Record_UBYTE 0 CM_uint8 0 255 /end CHARACTERISTIC
/begin CHARACTERISTIC Nv_FrontFogLightSet_Dummy "" VALUE 0x3470005E /* @ECU_Address@Nv_FrontFogLightSet_Dummy@ */ Record_UBYTE 0 CM_uint8 0 255 /end CHARACTERISTIC
/begin CHARACTERISTIC S2S_FrontFogLightSet_Dummy "" VALUE 0x3470005D /* @ECU_Address@S2S_FrontFogLightSet_Dummy@ */ Record_UBYTE 0 CM_uint8 0 255 /end CHARACTERISTIC
/begin CHARACTERISTIC Nv_ExteriorLightSet_Dummy "" VALUE 0x3470005C /* @ECU_Address@Nv_ExteriorLightSet_Dummy@ */ Record_UBYTE 0 CM_uint8 0 255 /end CHARACTERISTIC
/begin CHARACTERISTIC S2S_ExteriorLightSet_Dummy "" VALUE 0x3470005B /* @ECU_Address@S2S_ExteriorLightSet_Dummy@ */ Record_UBYTE 0 CM_uint8 0 255 /end CHARACTERISTIC
/begin CHARACTERISTIC Nv_ChildModeSet_Dummy "" VALUE 0x3470005A /* @ECU_Address@Nv_ChildModeSet_Dummy@ */ Record_UBYTE 0 CM_uint8 0 255 /end CHARACTERISTIC
/begin CHARACTERISTIC Nv_FeedbackSignalsSet_Dummy "" VALUE 0x34700059 /* @ECU_Address@Nv_FeedbackSignalsSet_Dummy@ */ Record_UBYTE 0 CM_uint8 0 255 /end CHARACTERISTIC
/begin CHARACTERISTIC Nv_DoorUnlockOptionSet_Dummy "" VALUE 0x34700058 /* @ECU_Address@Nv_DoorUnlockOptionSet_Dummy@ */ Record_UBYTE 0 CM_uint8 0 255 /end CHARACTERISTIC
/begin CHARACTERISTIC Nv_WalkAwayLockSet_Dummy "" VALUE 0x34700057 /* @ECU_Address@Nv_WalkAwayLockSet_Dummy@ */ Record_UBYTE 0 CM_uint8 0 255 /end CHARACTERISTIC
/begin CHARACTERISTIC Nv_SpeedLockSet_Dummy "" VALUE 0x34700056 /* @ECU_Address@Nv_SpeedLockSet_Dummy@ */ Record_UBYTE 0 CM_uint8 0 255 /end CHARACTERISTIC
/begin CHARACTERISTIC Nv_ParkUnlockSet_Dummy "" VALUE 0x34700055 /* @ECU_Address@Nv_ParkUnlockSet_Dummy@ */ Record_UBYTE 0 CM_uint8 0 255 /end CHARACTERISTIC
/begin CHARACTERISTIC S2S_ChildModeSet_Dummy "" VALUE 0x34700054 /* @ECU_Address@S2S_ChildModeSet_Dummy@ */ Record_UBYTE 0 CM_uint8 0 255 /end CHARACTERISTIC
/begin CHARACTERISTIC S2S_FeedbackSignalsSet_Dummy "" VALUE 0x34700053 /* @ECU_Address@S2S_FeedbackSignalsSet_Dummy@ */ Record_UBYTE 0 CM_uint8 0 255 /end CHARACTERISTIC
/begin CHARACTERISTIC S2S_DoorUnlockOptionSet_Dummy "" VALUE 0x34700052 /* @ECU_Address@S2S_DoorUnlockOptionSet_Dummy@ */ Record_UBYTE 0 CM_uint8 0 255 /end CHARACTERISTIC
/begin CHARACTERISTIC S2S_WalkAwayLockSet_Dummy "" VALUE 0x34700051 /* @ECU_Address@S2S_WalkAwayLockSet_Dummy@ */ Record_UBYTE 0 CM_uint8 0 255 /end CHARACTERISTIC
/begin CHARACTERISTIC S2S_SpeedLockSet_Dummy "" VALUE 0x34700050 /* @ECU_Address@S2S_SpeedLockSet_Dummy@ */ Record_UBYTE 0 CM_uint8 0 255 /end CHARACTERISTIC
/begin CHARACTERISTIC S2S_ParkUnlockSet_Dummy "" VALUE 0x3470004F /* @ECU_Address@S2S_ParkUnlockSet_Dummy@ */ Record_UBYTE 0 CM_uint8 0 255 /end CHARACTERISTIC
/begin CHARACTERISTIC S2S_SwitchLightBrightness_Dummy "" VALUE 0x3470004E /* @ECU_Address@S2S_SwitchLightBrightness_Dummy@ */ Record_UBYTE 0 CM_uint8 0 255 /end CHARACTERISTIC
/begin CHARACTERISTIC S2S_RearDomeLampSet_Dummy "" VALUE 0x3470004D /* @ECU_Address@S2S_RearDomeLampSet_Dummy@ */ Record_UBYTE 0 CM_uint8 0 255 /end CHARACTERISTIC
/begin CHARACTERISTIC S2S_FrontDomeLampSet_Dummy "" VALUE 0x3470004C /* @ECU_Address@S2S_FrontDomeLampSet_Dummy@ */ Record_UBYTE 0 CM_uint8 0 255 /end CHARACTERISTIC
/begin CHARACTERISTIC S2S_FootwellLightMode_Dummy "" VALUE 0x3470004B /* @ECU_Address@S2S_FootwellLightMode_Dummy@ */ Record_UBYTE 0 CM_uint8 0 255 /end CHARACTERISTIC
/begin CHARACTERISTIC S2S_AmbLightTypeReq_Dummy "" VALUE 0x3470004A /* @ECU_Address@S2S_AmbLightTypeReq_Dummy@ */ Record_UBYTE 0 CM_uint8 0 255 /end CHARACTERISTIC
/begin CHARACTERISTIC S2S_AmbLightBrightnessReq_Dummy "" VALUE 0x34700049 /* @ECU_Address@S2S_AmbLightBrightnessReq_Dummy@ */ Record_UBYTE 0 CM_uint8 0 255 /end CHARACTERISTIC
/begin CHARACTERISTIC S2S_AmbLightColorBlue_Dummy "" VALUE 0x34700048 /* @ECU_Address@S2S_AmbLightColorBlue_Dummy@ */ Record_UBYTE 0 CM_uint8 0 255 /end CHARACTERISTIC
/begin CHARACTERISTIC S2S_AmbLightColorGreen_Dummy "" VALUE 0x34700047 /* @ECU_Address@S2S_AmbLightColorGreen_Dummy@ */ Record_UBYTE 0 CM_uint8 0 255 /end CHARACTERISTIC
/begin CHARACTERISTIC S2S_AmbLightColorRed_Dummy "" VALUE 0x34700046 /* @ECU_Address@S2S_AmbLightColorRed_Dummy@ */ Record_UBYTE 0 CM_uint8 0 255 /end CHARACTERISTIC
/begin COMPU_METHOD CM_uint8 "Q = V" IDENTICAL "%3.0" "" /end COMPU_METHOD
/begin COMPU_METHOD CM_uint16 "Q = V" IDENTICAL "%5.0" "" /end COMPU_METHOD
/begin COMPU_METHOD CM_single "Q = V" IDENTICAL "%8.6" "" /end COMPU_METHOD
/begin COMPU_METHOD CM_boolean "Q = V" IDENTICAL "%1.0" "" /end COMPU_METHOD
/begin RECORD_LAYOUT Record_UBYTE FNC_VALUES 1 UBYTE COLUMN_DIR DIRECT /end RECORD_LAYOUT
/begin RECORD_LAYOUT Record_SBYTE FNC_VALUES 1 SBYTE COLUMN_DIR DIRECT /end RECORD_LAYOUT
/begin RECORD_LAYOUT Record_FLOAT64_IEEE FNC_VALUES 1 FLOAT64_IEEE COLUMN_DIR DIRECT /end RECORD_LAYOUT
/begin RECORD_LAYOUT Record_ULONG FNC_VALUES 1 ULONG COLUMN_DIR DIRECT /end RECORD_LAYOUT
/begin RECORD_LAYOUT Record_UWORD FNC_VALUES 1 UWORD COLUMN_DIR DIRECT /end RECORD_LAYOUT
/begin RECORD_LAYOUT Record_SLONG FNC_VALUES 1 SLONG COLUMN_DIR DIRECT /end RECORD_LAYOUT
/begin RECORD_LAYOUT Record_FLOAT32_IEEE FNC_VALUES 1 FLOAT32_IEEE COLUMN_DIR DIRECT /end RECORD_LAYOUT
/begin GROUP ExteriorLightManager_ELM_Main_sys_ELM_Main_ExteriorLightingControlByStalkSwitch_TurnIndicatorLightControl_RightTurnIndicatorLightDeactive "ExteriorLightManager/ELM_Main_sys/ELM_Main/ExteriorLightingControlByStalkSwitch/TurnIndicatorLightControl/RightTurnIndicatorLightDeactive"
 /begin SUB_GROUP ExteriorLightManager_ELM_Main_sys_ELM_Main_ExteriorLightingControlByStalkSwitch_TurnIndicatorLightControl_RightTurnIndicatorLightDeactive_SteeringBacktoCenterDeactiveDetect ExteriorLightManager_ELM_Main_sys_ELM_Main_ExteriorLightingControlByStalkSwitch_TurnIndicatorLightControl_RightTurnIndicatorLightDeactive_SteeringOppositeDeactiveDetect /end SUB_GROUP
/end GROUP
/begin GROUP ExteriorLightManager_ELM_Main_sys_ELM_Main_ExteriorLightingControlByStalkSwitch_TurnIndicatorLightControl_RightTurnIndicatorLightControl_HighwayFlashing_Timer1 "ExteriorLightManager/ELM_Main_sys/ELM_Main/ExteriorLightingControlByStalkSwitch/TurnIndicatorLightControl/RightTurnIndicatorLightControl_HighwayFlashing/Timer1" /end GROUP
/begin GROUP ExteriorLightManager_ELM_Main_sys_ELM_Main_ExteriorLightingControlByStalkSwitch_TurnIndicatorLightControl_RightTurnIndicatorLightControl_HighwayFlashing_S_R_Flip_Flop "ExteriorLightManager/ELM_Main_sys/ELM_Main/ExteriorLightingControlByStalkSwitch/TurnIndicatorLightControl/RightTurnIndicatorLightControl_HighwayFlashing/S-R\r\nFlip-Flop" /end GROUP
/begin GROUP ExteriorLightManager_ELM_Main_sys_ELM_Main_ExteriorLightingControlByStalkSwitch_TurnIndicatorLightControl_RightTurnIndicatorLightControl_HighwayFlashing_FLASH_CYCLE "ExteriorLightManager/ELM_Main_sys/ELM_Main/ExteriorLightingControlByStalkSwitch/TurnIndicatorLightControl/RightTurnIndicatorLightControl_HighwayFlashing/FLASH_CYCLE" /begin REF_CHARACTERISTIC FLASH_CYCLE /end REF_CHARACTERISTIC /end GROUP
/begin GROUP ExteriorLightManager_ELM_Main_sys_ELM_Main_ExteriorLightingControlByStalkSwitch_TurnIndicatorLightControl_RightTurnIndicatorLightControl_HighwayFlashing_Detect_Rise_Positive "ExteriorLightManager/ELM_Main_sys/ELM_Main/ExteriorLightingControlByStalkSwitch/TurnIndicatorLightControl/RightTurnIndicatorLightControl_HighwayFlashing/Detect Rise\r\nPositive" /end GROUP
/begin GROUP ExteriorLightManager_ELM_Main_sys_ELM_Main_ExteriorLightingControlByStalkSwitch_TurnIndicatorLightControl_RightTurnIndicatorLightControl_HighwayFlashing "ExteriorLightManager/ELM_Main_sys/ELM_Main/ExteriorLightingControlByStalkSwitch/TurnIndicatorLightControl/RightTurnIndicatorLightControl_HighwayFlashing"
 /begin SUB_GROUP ExteriorLightManager_ELM_Main_sys_ELM_Main_ExteriorLightingControlByStalkSwitch_TurnIndicatorLightControl_RightTurnIndicatorLightControl_HighwayFlashing_Detect_Rise_Positive ExteriorLightManager_ELM_Main_sys_ELM_Main_ExteriorLightingControlByStalkSwitch_TurnIndicatorLightControl_RightTurnIndicatorLightControl_HighwayFlashing_ELM_Ts_P2 ExteriorLightManager_ELM_Main_sys_ELM_Main_ExteriorLightingControlByStalkSwitch_TurnIndicatorLightControl_RightTurnIndicatorLightControl_HighwayFlashing_FLASH_CYCLE ExteriorLightManager_ELM_Main_sys_ELM_Main_ExteriorLightingControlByStalkSwitch_TurnIndicatorLightControl_RightTurnIndicatorLightControl_HighwayFlashing_S_R_Flip_Flop ExteriorLightManager_ELM_Main_sys_ELM_Main_ExteriorLightingControlByStalkSwitch_TurnIndicatorLightControl_RightTurnIndicatorLightControl_HighwayFlashing_TURN_LIGHT_FREQUENCY1 ExteriorLightManager_ELM_Main_sys_ELM_Main_ExteriorLightingControlByStalkSwitch_TurnIndicatorLightControl_RightTurnIndicatorLightControl_HighwayFlashing_Timer1 /end SUB_GROUP
/end GROUP
/begin GROUP ExteriorLightManager_ELM_Main_sys_ELM_Main_ExteriorLightingControlByStalkSwitch_TurnIndicatorLightControl_RightTurnIndicatorLightControl_ContinuousFlash_S_R_Flip_Flop "ExteriorLightManager/ELM_Main_sys/ELM_Main/ExteriorLightingControlByStalkSwitch/TurnIndicatorLightControl/RightTurnIndicatorLightControl_ContinuousFlash/S-R\r\nFlip-Flop" /end GROUP
/begin GROUP ExteriorLightManager_ELM_Main_sys_ELM_Main_ExteriorLightingControlByStalkSwitch_TurnIndicatorLightControl_RightTurnIndicatorLightControl_ContinuousFlash_Detect_Rise_Positive "ExteriorLightManager/ELM_Main_sys/ELM_Main/ExteriorLightingControlByStalkSwitch/TurnIndicatorLightControl/RightTurnIndicatorLightControl_ContinuousFlash/Detect Rise\r\nPositive" /end GROUP
/begin GROUP ExteriorLightManager_ELM_Main_sys_ELM_Main_ExteriorLightingControlByStalkSwitch_TurnIndicatorLightControl_RightTurnIndicatorLightControl_ContinuousFlash "ExteriorLightManager/ELM_Main_sys/ELM_Main/ExteriorLightingControlByStalkSwitch/TurnIndicatorLightControl/RightTurnIndicatorLightControl_ContinuousFlash"
 /begin SUB_GROUP ExteriorLightManager_ELM_Main_sys_ELM_Main_ExteriorLightingControlByStalkSwitch_TurnIndicatorLightControl_RightTurnIndicatorLightControl_ContinuousFlash_Detect_Rise_Positive ExteriorLightManager_ELM_Main_sys_ELM_Main_ExteriorLightingControlByStalkSwitch_TurnIndicatorLightControl_RightTurnIndicatorLightControl_ContinuousFlash_S_R_Flip_Flop /end SUB_GROUP
/end GROUP
/begin GROUP ExteriorLightManager_ELM_Main_sys_ELM_Main_ExteriorLightingControlByStalkSwitch_TurnIndicatorLightControl_LeftTurnIndicatorLightDeactive_SteeringOppositeDeactiveDetect_Detect_Rise_Positive5 "ExteriorLightManager/ELM_Main_sys/ELM_Main/ExteriorLightingControlByStalkSwitch/TurnIndicatorLightControl/LeftTurnIndicatorLightDeactive/SteeringOppositeDeactiveDetect/Detect Rise\r\nPositive5" /end GROUP
/begin GROUP ExteriorLightManager_ELM_Main_sys_ELM_Main_ExteriorLightingControlByStalkSwitch_TurnIndicatorLightControl_LeftTurnIndicatorLightDeactive_SteeringOppositeDeactiveDetect_Detect_Rise_Positive4 "ExteriorLightManager/ELM_Main_sys/ELM_Main/ExteriorLightingControlByStalkSwitch/TurnIndicatorLightControl/LeftTurnIndicatorLightDeactive/SteeringOppositeDeactiveDetect/Detect Rise\r\nPositive4" /end GROUP
/begin GROUP ExteriorLightManager_ELM_Main_sys_ELM_Main_ExteriorLightingControlByStalkSwitch_TurnIndicatorLightControl_LeftTurnIndicatorLightDeactive_SteeringOppositeDeactiveDetect_Detect_Rise_Positive2 "ExteriorLightManager/ELM_Main_sys/ELM_Main/ExteriorLightingControlByStalkSwitch/TurnIndicatorLightControl/LeftTurnIndicatorLightDeactive/SteeringOppositeDeactiveDetect/Detect Rise\r\nPositive2" /end GROUP
/begin GROUP ExteriorLightManager_ELM_Main_sys_ELM_Main_ExteriorLightingControlByStalkSwitch_TurnIndicatorLightControl_LeftTurnIndicatorLightDeactive_SteeringOppositeDeactiveDetect_Detect_Rise_Positive1 "ExteriorLightManager/ELM_Main_sys/ELM_Main/ExteriorLightingControlByStalkSwitch/TurnIndicatorLightControl/LeftTurnIndicatorLightDeactive/SteeringOppositeDeactiveDetect/Detect Rise\r\nPositive1" /end GROUP
/begin GROUP ExteriorLightManager_ELM_Main_sys_ELM_Main_ExteriorLightingControlByStalkSwitch_TurnIndicatorLightControl_LeftTurnIndicatorLightDeactive_SteeringOppositeDeactiveDetect "ExteriorLightManager/ELM_Main_sys/ELM_Main/ExteriorLightingControlByStalkSwitch/TurnIndicatorLightControl/LeftTurnIndicatorLightDeactive/SteeringOppositeDeactiveDetect"
 /begin SUB_GROUP ExteriorLightManager_ELM_Main_sys_ELM_Main_ExteriorLightingControlByStalkSwitch_TurnIndicatorLightControl_LeftTurnIndicatorLightDeactive_SteeringOppositeDeactiveDetect_Detect_Rise_Positive1 ExteriorLightManager_ELM_Main_sys_ELM_Main_ExteriorLightingControlByStalkSwitch_TurnIndicatorLightControl_LeftTurnIndicatorLightDeactive_SteeringOppositeDeactiveDetect_Detect_Rise_Positive2 ExteriorLightManager_ELM_Main_sys_ELM_Main_ExteriorLightingControlByStalkSwitch_TurnIndicatorLightControl_LeftTurnIndicatorLightDeactive_SteeringOppositeDeactiveDetect_Detect_Rise_Positive4 ExteriorLightManager_ELM_Main_sys_ELM_Main_ExteriorLightingControlByStalkSwitch_TurnIndicatorLightControl_LeftTurnIndicatorLightDeactive_SteeringOppositeDeactiveDetect_Detect_Rise_Positive5 ExteriorLightManager_ELM_Main_sys_ELM_Main_ExteriorLightingControlByStalkSwitch_TurnIndicatorLightControl_LeftTurnIndicatorLightDeactive_SteeringOppositeDeactiveDetect_OPPOSITE_ANGLE_THRESHOLD ExteriorLightManager_ELM_Main_sys_ELM_Main_ExteriorLightingControlByStalkSwitch_TurnIndicatorLightControl_LeftTurnIndicatorLightDeactive_SteeringOppositeDeactiveDetect_OPPOSITE_ANGLE_THRESHOLD1 ExteriorLightManager_ELM_Main_sys_ELM_Main_ExteriorLightingControlByStalkSwitch_TurnIndicatorLightControl_LeftTurnIndicatorLightDeactive_SteeringOppositeDeactiveDetect_OPPOSITE_OFFSET_ANGLE /end SUB_GROUP
/end GROUP
/begin GROUP ExteriorLightManager_ELM_Main_sys_ELM_Main_ExteriorLightingControlByStalkSwitch_TurnIndicatorLightControl_LeftTurnIndicatorLightDeactive_SteeringBacktoCenterDeactiveDetect_S_R_Flip_Flop1 "ExteriorLightManager/ELM_Main_sys/ELM_Main/ExteriorLightingControlByStalkSwitch/TurnIndicatorLightControl/LeftTurnIndicatorLightDeactive/SteeringBacktoCenterDeactiveDetect/S-R\r\nFlip-Flop1" /end GROUP
/begin GROUP ExteriorLightManager_ELM_Main_sys_ELM_Main_ExteriorLightingControlByStalkSwitch_TurnIndicatorLightControl_LeftTurnIndicatorLightDeactive_SteeringBacktoCenterDeactiveDetect_S_R_Flip_Flop "ExteriorLightManager/ELM_Main_sys/ELM_Main/ExteriorLightingControlByStalkSwitch/TurnIndicatorLightControl/LeftTurnIndicatorLightDeactive/SteeringBacktoCenterDeactiveDetect/S-R\r\nFlip-Flop" /end GROUP
/begin GROUP ExteriorLightManager_ELM_Main_sys_ELM_Main_ExteriorLightingControlByStalkSwitch_TurnIndicatorLightControl_LeftTurnIndicatorLightDeactive_SteeringBacktoCenterDeactiveDetect_Detect_Rise_Positive3 "ExteriorLightManager/ELM_Main_sys/ELM_Main/ExteriorLightingControlByStalkSwitch/TurnIndicatorLightControl/LeftTurnIndicatorLightDeactive/SteeringBacktoCenterDeactiveDetect/Detect Rise\r\nPositive3" /end GROUP
/begin GROUP ExteriorLightManager_ELM_Main_sys_ELM_Main_ExteriorLightingControlByStalkSwitch_TurnIndicatorLightControl_LeftTurnIndicatorLightDeactive_SteeringBacktoCenterDeactiveDetect_Detect_Rise_Positive2 "ExteriorLightManager/ELM_Main_sys/ELM_Main/ExteriorLightingControlByStalkSwitch/TurnIndicatorLightControl/LeftTurnIndicatorLightDeactive/SteeringBacktoCenterDeactiveDetect/Detect Rise\r\nPositive2" /end GROUP
/begin GROUP ExteriorLightManager_ELM_Main_sys_ELM_Main_ExteriorLightingControlByStalkSwitch_TurnIndicatorLightControl_LeftTurnIndicatorLightDeactive_SteeringBacktoCenterDeactiveDetect_Detect_Rise_Positive1 "ExteriorLightManager/ELM_Main_sys/ELM_Main/ExteriorLightingControlByStalkSwitch/TurnIndicatorLightControl/LeftTurnIndicatorLightDeactive/SteeringBacktoCenterDeactiveDetect/Detect Rise\r\nPositive1" /end GROUP
/begin GROUP ExteriorLightManager_ELM_Main_sys_ELM_Main_ExteriorLightingControlByStalkSwitch_TurnIndicatorLightControl_LeftTurnIndicatorLightDeactive_SteeringBacktoCenterDeactiveDetect_Detect_Rise_Positive "ExteriorLightManager/ELM_Main_sys/ELM_Main/ExteriorLightingControlByStalkSwitch/TurnIndicatorLightControl/LeftTurnIndicatorLightDeactive/SteeringBacktoCenterDeactiveDetect/Detect Rise\r\nPositive" /end GROUP
/begin GROUP ExteriorLightManager_ELM_Main_sys_ELM_Main_ExteriorLightingControlByStalkSwitch_TurnIndicatorLightControl_LeftTurnIndicatorLightDeactive_SteeringBacktoCenterDeactiveDetect_Detect_Decrease1 "ExteriorLightManager/ELM_Main_sys/ELM_Main/ExteriorLightingControlByStalkSwitch/TurnIndicatorLightControl/LeftTurnIndicatorLightDeactive/SteeringBacktoCenterDeactiveDetect/Detect\r\nDecrease1" /end GROUP
/begin GROUP ExteriorLightManager_ELM_Main_sys_ELM_Main_ExteriorLightingControlByStalkSwitch_TurnIndicatorLightControl_LeftTurnIndicatorLightDeactive_SteeringBacktoCenterDeactiveDetect_Detect_Decrease "ExteriorLightManager/ELM_Main_sys/ELM_Main/ExteriorLightingControlByStalkSwitch/TurnIndicatorLightControl/LeftTurnIndicatorLightDeactive/SteeringBacktoCenterDeactiveDetect/Detect\r\nDecrease" /end GROUP
/begin GROUP ExteriorLightManager_ELM_Main_sys_ELM_Main_ExteriorLightingControlByStalkSwitch_TurnIndicatorLightControl_LeftTurnIndicatorLightDeactive_SteeringBacktoCenterDeactiveDetect "ExteriorLightManager/ELM_Main_sys/ELM_Main/ExteriorLightingControlByStalkSwitch/TurnIndicatorLightControl/LeftTurnIndicatorLightDeactive/SteeringBacktoCenterDeactiveDetect"
 /begin SUB_GROUP ExteriorLightManager_ELM_Main_sys_ELM_Main_ExteriorLightingControlByStalkSwitch_TurnIndicatorLightControl_LeftTurnIndicatorLightDeactive_SteeringBacktoCenterDeactiveDetect_CENTER_POSITION_THRESHOLD ExteriorLightManager_ELM_Main_sys_ELM_Main_ExteriorLightingControlByStalkSwitch_TurnIndicatorLightControl_LeftTurnIndicatorLightDeactive_SteeringBacktoCenterDeactiveDetect_CENTER_POSITION_THRESHOLD4 ExteriorLightManager_ELM_Main_sys_ELM_Main_ExteriorLightingControlByStalkSwitch_TurnIndicatorLightControl_LeftTurnIndicatorLightDeactive_SteeringBacktoCenterDeactiveDetect_Detect_Decrease ExteriorLightManager_ELM_Main_sys_ELM_Main_ExteriorLightingControlByStalkSwitch_TurnIndicatorLightControl_LeftTurnIndicatorLightDeactive_SteeringBacktoCenterDeactiveDetect_Detect_Decrease1 ExteriorLightManager_ELM_Main_sys_ELM_Main_ExteriorLightingControlByStalkSwitch_TurnIndicatorLightControl_LeftTurnIndicatorLightDeactive_SteeringBacktoCenterDeactiveDetect_Detect_Rise_Positive ExteriorLightManager_ELM_Main_sys_ELM_Main_ExteriorLightingControlByStalkSwitch_TurnIndicatorLightControl_LeftTurnIndicatorLightDeactive_SteeringBacktoCenterDeactiveDetect_Detect_Rise_Positive1 ExteriorLightManager_ELM_Main_sys_ELM_Main_ExteriorLightingControlByStalkSwitch_TurnIndicatorLightControl_LeftTurnIndicatorLightDeactive_SteeringBacktoCenterDeactiveDetect_Detect_Rise_Positive2 ExteriorLightManager_ELM_Main_sys_ELM_Main_ExteriorLightingControlByStalkSwitch_TurnIndicatorLightControl_LeftTurnIndicatorLightDeactive_SteeringBacktoCenterDeactiveDetect_Detect_Rise_Positive3 ExteriorLightManager_ELM_Main_sys_ELM_Main_ExteriorLightingControlByStalkSwitch_TurnIndicatorLightControl_LeftTurnIndicatorLightDeactive_SteeringBacktoCenterDeactiveDetect_SAME_DIRECTION_ANGLE_THRESHOLD ExteriorLightManager_ELM_Main_sys_ELM_Main_ExteriorLightingControlByStalkSwitch_TurnIndicatorLightControl_LeftTurnIndicatorLightDeactive_SteeringBacktoCenterDeactiveDetect_SAME_DIRECTION_ANGLE_THRESHOLD1 ExteriorLightManager_ELM_Main_sys_ELM_Main_ExteriorLightingControlByStalkSwitch_TurnIndicatorLightControl_LeftTurnIndicatorLightDeactive_SteeringBacktoCenterDeactiveDetect_S_R_Flip_Flop ExteriorLightManager_ELM_Main_sys_ELM_Main_ExteriorLightingControlByStalkSwitch_TurnIndicatorLightControl_LeftTurnIndicatorLightDeactive_SteeringBacktoCenterDeactiveDetect_S_R_Flip_Flop1 /end SUB_GROUP
/end GROUP
/begin GROUP ExteriorLightManager_ELM_Main_sys_ELM_Main_ExteriorLightingControlByStalkSwitch_TurnIndicatorLightControl_LeftTurnIndicatorLightDeactive "ExteriorLightManager/ELM_Main_sys/ELM_Main/ExteriorLightingControlByStalkSwitch/TurnIndicatorLightControl/LeftTurnIndicatorLightDeactive"
 /begin SUB_GROUP ExteriorLightManager_ELM_Main_sys_ELM_Main_ExteriorLightingControlByStalkSwitch_TurnIndicatorLightControl_LeftTurnIndicatorLightDeactive_SteeringBacktoCenterDeactiveDetect ExteriorLightManager_ELM_Main_sys_ELM_Main_ExteriorLightingControlByStalkSwitch_TurnIndicatorLightControl_LeftTurnIndicatorLightDeactive_SteeringOppositeDeactiveDetect /end SUB_GROUP
/end GROUP
/begin GROUP ExteriorLightManager_ELM_Main_sys_ELM_Main_ExteriorLightingControlByStalkSwitch_TurnIndicatorLightControl_LeftTurnIndicatorLightControl_HighwayFlashing_Timer "ExteriorLightManager/ELM_Main_sys/ELM_Main/ExteriorLightingControlByStalkSwitch/TurnIndicatorLightControl/LeftTurnIndicatorLightControl_HighwayFlashing/Timer" /end GROUP
/begin GROUP ExteriorLightManager_ELM_Main_sys_ELM_Main_ExteriorLightingControlByStalkSwitch_TurnIndicatorLightControl_LeftTurnIndicatorLightControl_HighwayFlashing_S_R_Flip_Flop "ExteriorLightManager/ELM_Main_sys/ELM_Main/ExteriorLightingControlByStalkSwitch/TurnIndicatorLightControl/LeftTurnIndicatorLightControl_HighwayFlashing/S-R\r\nFlip-Flop" /end GROUP
/begin GROUP ExteriorLightManager_ELM_Main_sys_ELM_Main_ExteriorLightingControlByStalkSwitch_TurnIndicatorLightControl_LeftTurnIndicatorLightControl_HighwayFlashing_FLASH_CYCLE "ExteriorLightManager/ELM_Main_sys/ELM_Main/ExteriorLightingControlByStalkSwitch/TurnIndicatorLightControl/LeftTurnIndicatorLightControl_HighwayFlashing/FLASH_CYCLE" /begin REF_CHARACTERISTIC FLASH_CYCLE /end REF_CHARACTERISTIC /end GROUP
/begin GROUP ExteriorLightManager_ELM_Main_sys_ELM_Main_ExteriorLightingControlByStalkSwitch_TurnIndicatorLightControl_LeftTurnIndicatorLightControl_HighwayFlashing_Detect_Rise_Positive "ExteriorLightManager/ELM_Main_sys/ELM_Main/ExteriorLightingControlByStalkSwitch/TurnIndicatorLightControl/LeftTurnIndicatorLightControl_HighwayFlashing/Detect Rise\r\nPositive" /end GROUP
/begin GROUP ExteriorLightManager_ELM_Main_sys_ELM_Main_ExteriorLightingControlByStalkSwitch_TurnIndicatorLightControl_LeftTurnIndicatorLightControl_HighwayFlashing "ExteriorLightManager/ELM_Main_sys/ELM_Main/ExteriorLightingControlByStalkSwitch/TurnIndicatorLightControl/LeftTurnIndicatorLightControl_HighwayFlashing"
 /begin SUB_GROUP ExteriorLightManager_ELM_Main_sys_ELM_Main_ExteriorLightingControlByStalkSwitch_TurnIndicatorLightControl_LeftTurnIndicatorLightControl_HighwayFlashing_Detect_Rise_Positive ExteriorLightManager_ELM_Main_sys_ELM_Main_ExteriorLightingControlByStalkSwitch_TurnIndicatorLightControl_LeftTurnIndicatorLightControl_HighwayFlashing_ELM_Ts_P2 ExteriorLightManager_ELM_Main_sys_ELM_Main_ExteriorLightingControlByStalkSwitch_TurnIndicatorLightControl_LeftTurnIndicatorLightControl_HighwayFlashing_FLASH_CYCLE ExteriorLightManager_ELM_Main_sys_ELM_Main_ExteriorLightingControlByStalkSwitch_TurnIndicatorLightControl_LeftTurnIndicatorLightControl_HighwayFlashing_S_R_Flip_Flop ExteriorLightManager_ELM_Main_sys_ELM_Main_ExteriorLightingControlByStalkSwitch_TurnIndicatorLightControl_LeftTurnIndicatorLightControl_HighwayFlashing_TURN_LIGHT_FREQUENCY1 ExteriorLightManager_ELM_Main_sys_ELM_Main_ExteriorLightingControlByStalkSwitch_TurnIndicatorLightControl_LeftTurnIndicatorLightControl_HighwayFlashing_Timer /end SUB_GROUP
/end GROUP
/begin GROUP ExteriorLightManager_ELM_Main_sys_ELM_Main_ExteriorLightingControlByStalkSwitch_TurnIndicatorLightControl_LeftTurnIndicatorLightControl_ContinuousFlash_S_R_Flip_Flop "ExteriorLightManager/ELM_Main_sys/ELM_Main/ExteriorLightingControlByStalkSwitch/TurnIndicatorLightControl/LeftTurnIndicatorLightControl_ContinuousFlash/S-R\r\nFlip-Flop" /end GROUP
/begin GROUP ExteriorLightManager_ELM_Main_sys_ELM_Main_ExteriorLightingControlByStalkSwitch_TurnIndicatorLightControl_LeftTurnIndicatorLightControl_ContinuousFlash_Detect_Rise_Positive "ExteriorLightManager/ELM_Main_sys/ELM_Main/ExteriorLightingControlByStalkSwitch/TurnIndicatorLightControl/LeftTurnIndicatorLightControl_ContinuousFlash/Detect Rise\r\nPositive" /end GROUP
/begin GROUP ExteriorLightManager_ELM_Main_sys_ELM_Main_ExteriorLightingControlByStalkSwitch_TurnIndicatorLightControl_LeftTurnIndicatorLightControl_ContinuousFlash "ExteriorLightManager/ELM_Main_sys/ELM_Main/ExteriorLightingControlByStalkSwitch/TurnIndicatorLightControl/LeftTurnIndicatorLightControl_ContinuousFlash"
 /begin SUB_GROUP ExteriorLightManager_ELM_Main_sys_ELM_Main_ExteriorLightingControlByStalkSwitch_TurnIndicatorLightControl_LeftTurnIndicatorLightControl_ContinuousFlash_Detect_Rise_Positive ExteriorLightManager_ELM_Main_sys_ELM_Main_ExteriorLightingControlByStalkSwitch_TurnIndicatorLightControl_LeftTurnIndicatorLightControl_ContinuousFlash_S_R_Flip_Flop /end SUB_GROUP
/end GROUP
/begin GROUP ExteriorLightManager_ELM_Main_sys_ELM_Main_ExteriorLightingControlByStalkSwitch_TurnIndicatorLightControl_CentralLockingTurnIndicatorLightControl_Timer "ExteriorLightManager/ELM_Main_sys/ELM_Main/ExteriorLightingControlByStalkSwitch/TurnIndicatorLightControl/CentralLockingTurnIndicatorLightControl/Timer" /end GROUP
/begin GROUP ExteriorLightManager_ELM_Main_sys_ELM_Main_ExteriorLightingControlByStalkSwitch_TurnIndicatorLightControl_CentralLockingTurnIndicatorLightControl_S_R_Flip_Flop "ExteriorLightManager/ELM_Main_sys/ELM_Main/ExteriorLightingControlByStalkSwitch/TurnIndicatorLightControl/CentralLockingTurnIndicatorLightControl/S-R\r\nFlip-Flop" /end GROUP
/begin GROUP ExteriorLightManager_ELM_Main_sys_ELM_Main_ExteriorLightingControlByStalkSwitch_TurnIndicatorLightControl_CentralLockingTurnIndicatorLightControl_FLASH_CYCLE "ExteriorLightManager/ELM_Main_sys/ELM_Main/ExteriorLightingControlByStalkSwitch/TurnIndicatorLightControl/CentralLockingTurnIndicatorLightControl/FLASH_CYCLE" /begin REF_CHARACTERISTIC FLASH_CYCLE /end REF_CHARACTERISTIC /end GROUP
/begin GROUP ExteriorLightManager_ELM_Main_sys_ELM_Main_ExteriorLightingControlByStalkSwitch_TurnIndicatorLightControl_CentralLockingTurnIndicatorLightControl_Detect_Rise_Positive_Positive "ExteriorLightManager/ELM_Main_sys/ELM_Main/ExteriorLightingControlByStalkSwitch/TurnIndicatorLightControl/CentralLockingTurnIndicatorLightControl/Detect Rise\r\nPositive/Positive" /begin REF_MEASUREMENT CLM_LampONReminder /end REF_MEASUREMENT /end GROUP
/begin GROUP ExteriorLightManager_ELM_Main_sys_ELM_Main_ExteriorLightingControlByStalkSwitch_TurnIndicatorLightControl_CentralLockingTurnIndicatorLightControl_Detect_Rise_Positive "ExteriorLightManager/ELM_Main_sys/ELM_Main/ExteriorLightingControlByStalkSwitch/TurnIndicatorLightControl/CentralLockingTurnIndicatorLightControl/Detect Rise\r\nPositive"
 /begin SUB_GROUP ExteriorLightManager_ELM_Main_sys_ELM_Main_ExteriorLightingControlByStalkSwitch_TurnIndicatorLightControl_CentralLockingTurnIndicatorLightControl_Detect_Rise_Positive_Positive /end SUB_GROUP
/end GROUP
/begin GROUP ExteriorLightManager_ELM_Main_sys_ELM_Main_ExteriorLightingControlByStalkSwitch_TurnIndicatorLightControl_CentralLockingTurnIndicatorLightControl "ExteriorLightManager/ELM_Main_sys/ELM_Main/ExteriorLightingControlByStalkSwitch/TurnIndicatorLightControl/CentralLockingTurnIndicatorLightControl"
 /begin SUB_GROUP ExteriorLightManager_ELM_Main_sys_ELM_Main_ExteriorLightingControlByStalkSwitch_TurnIndicatorLightControl_CentralLockingTurnIndicatorLightControl_Detect_Rise_Positive ExteriorLightManager_ELM_Main_sys_ELM_Main_ExteriorLightingControlByStalkSwitch_TurnIndicatorLightControl_CentralLockingTurnIndicatorLightControl_ELM_Ts_P2 ExteriorLightManager_ELM_Main_sys_ELM_Main_ExteriorLightingControlByStalkSwitch_TurnIndicatorLightControl_CentralLockingTurnIndicatorLightControl_FLASH_CYCLE ExteriorLightManager_ELM_Main_sys_ELM_Main_ExteriorLightingControlByStalkSwitch_TurnIndicatorLightControl_CentralLockingTurnIndicatorLightControl_S_R_Flip_Flop ExteriorLightManager_ELM_Main_sys_ELM_Main_ExteriorLightingControlByStalkSwitch_TurnIndicatorLightControl_CentralLockingTurnIndicatorLightControl_TURN_LIGHT_FREQUENCY1 ExteriorLightManager_ELM_Main_sys_ELM_Main_ExteriorLightingControlByStalkSwitch_TurnIndicatorLightControl_CentralLockingTurnIndicatorLightControl_Timer /end SUB_GROUP
/end GROUP
/begin GROUP ExteriorLightManager_ELM_Main_sys_ELM_Main_ExteriorLightingControlByStalkSwitch_TurnIndicatorLightControl "ExteriorLightManager/ELM_Main_sys/ELM_Main/ExteriorLightingControlByStalkSwitch/TurnIndicatorLightControl"
 /begin SUB_GROUP ExteriorLightManager_ELM_Main_sys_ELM_Main_ExteriorLightingControlByStalkSwitch_TurnIndicatorLightControl_CentralLockingTurnIndicatorLightControl ExteriorLightManager_ELM_Main_sys_ELM_Main_ExteriorLightingControlByStalkSwitch_TurnIndicatorLightControl_LeftTurnIndicatorLightControl_ContinuousFlash ExteriorLightManager_ELM_Main_sys_ELM_Main_ExteriorLightingControlByStalkSwitch_TurnIndicatorLightControl_LeftTurnIndicatorLightControl_HighwayFlashing ExteriorLightManager_ELM_Main_sys_ELM_Main_ExteriorLightingControlByStalkSwitch_TurnIndicatorLightControl_LeftTurnIndicatorLightDeactive ExteriorLightManager_ELM_Main_sys_ELM_Main_ExteriorLightingControlByStalkSwitch_TurnIndicatorLightControl_RightTurnIndicatorLightControl_ContinuousFlash ExteriorLightManager_ELM_Main_sys_ELM_Main_ExteriorLightingControlByStalkSwitch_TurnIndicatorLightControl_RightTurnIndicatorLightControl_HighwayFlashing ExteriorLightManager_ELM_Main_sys_ELM_Main_ExteriorLightingControlByStalkSwitch_TurnIndicatorLightControl_RightTurnIndicatorLightDeactive ExteriorLightManager_ELM_Main_sys_ELM_Main_ExteriorLightingControlByStalkSwitch_TurnIndicatorLightControl_TurnIndicatorLightReqGenerator /end SUB_GROUP
/end GROUP
/begin GROUP ExteriorLightManager_ELM_Main_sys_ELM_Main_ExteriorLightingControlByStalkSwitch_ManualHighBeamControl_FlashHighBeam_Timer "ExteriorLightManager/ELM_Main_sys/ELM_Main/ExteriorLightingControlByStalkSwitch/ManualHighBeamControl/FlashHighBeam/Timer" /end GROUP
/begin GROUP ExteriorLightManager_ELM_Main_sys_ELM_Main_ExteriorLightingControlByStalkSwitch_ManualHighBeamControl_FlashHighBeam_Detect_Rise_Positive2 "ExteriorLightManager/ELM_Main_sys/ELM_Main/ExteriorLightingControlByStalkSwitch/ManualHighBeamControl/FlashHighBeam/Detect Rise\r\nPositive2" /end GROUP
/begin GROUP ExteriorLightManager_ELM_Main_sys_ELM_Main_ExteriorLightingControlByStalkSwitch_ManualHighBeamControl_FlashHighBeam_Detect_Rise_Positive1 "ExteriorLightManager/ELM_Main_sys/ELM_Main/ExteriorLightingControlByStalkSwitch/ManualHighBeamControl/FlashHighBeam/Detect Rise\r\nPositive1" /end GROUP
/begin GROUP ExteriorLightManager_ELM_Main_sys_ELM_Main_ExteriorLightingControlByStalkSwitch_ManualHighBeamControl_FlashHighBeam_Detect_Decrease "ExteriorLightManager/ELM_Main_sys/ELM_Main/ExteriorLightingControlByStalkSwitch/ManualHighBeamControl/FlashHighBeam/Detect\r\nDecrease" /end GROUP
/begin GROUP ExteriorLightManager_ELM_Main_sys_ELM_Main_ExteriorLightingControlByStalkSwitch_ManualHighBeamControl_FlashHighBeam_DEACTIVATE_HIGH_BEAM_FLASHING_TIME "ExteriorLightManager/ELM_Main_sys/ELM_Main/ExteriorLightingControlByStalkSwitch/ManualHighBeamControl/FlashHighBeam/DEACTIVATE_HIGH_BEAM_FLASHING_TIME" /begin REF_CHARACTERISTIC DEACTIVATE_HIGH_BEAM_FLASHING_TIME /end REF_CHARACTERISTIC /end GROUP
/begin GROUP ExteriorLightManager_ELM_Main_sys_ELM_Main_ExteriorLightingControlByStalkSwitch_ManualHighBeamControl_FlashHighBeam "ExteriorLightManager/ELM_Main_sys/ELM_Main/ExteriorLightingControlByStalkSwitch/ManualHighBeamControl/FlashHighBeam"
 /begin SUB_GROUP ExteriorLightManager_ELM_Main_sys_ELM_Main_ExteriorLightingControlByStalkSwitch_ManualHighBeamControl_FlashHighBeam_DEACTIVATE_HIGH_BEAM_FLASHING_TIME ExteriorLightManager_ELM_Main_sys_ELM_Main_ExteriorLightingControlByStalkSwitch_ManualHighBeamControl_FlashHighBeam_Detect_Decrease ExteriorLightManager_ELM_Main_sys_ELM_Main_ExteriorLightingControlByStalkSwitch_ManualHighBeamControl_FlashHighBeam_Detect_Rise_Positive1 ExteriorLightManager_ELM_Main_sys_ELM_Main_ExteriorLightingControlByStalkSwitch_ManualHighBeamControl_FlashHighBeam_Detect_Rise_Positive2 ExteriorLightManager_ELM_Main_sys_ELM_Main_ExteriorLightingControlByStalkSwitch_ManualHighBeamControl_FlashHighBeam_ELM_Ts_P ExteriorLightManager_ELM_Main_sys_ELM_Main_ExteriorLightingControlByStalkSwitch_ManualHighBeamControl_FlashHighBeam_Timer /end SUB_GROUP
/end GROUP
/begin GROUP ExteriorLightManager_ELM_Main_sys_ELM_Main_ExteriorLightingControlByStalkSwitch_ManualHighBeamControl_ContinuousHighBeam_Detect_Rise_Positive2 "ExteriorLightManager/ELM_Main_sys/ELM_Main/ExteriorLightingControlByStalkSwitch/ManualHighBeamControl/ContinuousHighBeam/Detect Rise\r\nPositive2" /end GROUP
/begin GROUP ExteriorLightManager_ELM_Main_sys_ELM_Main_ExteriorLightingControlByStalkSwitch_ManualHighBeamControl_ContinuousHighBeam_Detect_Rise_Positive "ExteriorLightManager/ELM_Main_sys/ELM_Main/ExteriorLightingControlByStalkSwitch/ManualHighBeamControl/ContinuousHighBeam/Detect Rise\r\nPositive" /end GROUP
/begin GROUP ExteriorLightManager_ELM_Main_sys_ELM_Main_ExteriorLightingControlByStalkSwitch_ManualHighBeamControl_ContinuousHighBeam_ContinuousHighBeamDeactiveTriggerDetect_Detect_Rise_Positive "ExteriorLightManager/ELM_Main_sys/ELM_Main/ExteriorLightingControlByStalkSwitch/ManualHighBeamControl/ContinuousHighBeam/ContinuousHighBeamDeactiveTriggerDetect/Detect Rise\r\nPositive" /end GROUP
/begin GROUP ExteriorLightManager_ELM_Main_sys_ELM_Main_ExteriorLightingControlByStalkSwitch_ManualHighBeamControl_ContinuousHighBeam_ContinuousHighBeamDeactiveTriggerDetect_Detect_Decrease "ExteriorLightManager/ELM_Main_sys/ELM_Main/ExteriorLightingControlByStalkSwitch/ManualHighBeamControl/ContinuousHighBeam/ContinuousHighBeamDeactiveTriggerDetect/Detect\r\nDecrease" /end GROUP
/begin GROUP ExteriorLightManager_ELM_Main_sys_ELM_Main_ExteriorLightingControlByStalkSwitch_ManualHighBeamControl_ContinuousHighBeam_ContinuousHighBeamDeactiveTriggerDetect "ExteriorLightManager/ELM_Main_sys/ELM_Main/ExteriorLightingControlByStalkSwitch/ManualHighBeamControl/ContinuousHighBeam/ContinuousHighBeamDeactiveTriggerDetect"
 /begin SUB_GROUP ExteriorLightManager_ELM_Main_sys_ELM_Main_ExteriorLightingControlByStalkSwitch_ManualHighBeamControl_ContinuousHighBeam_ContinuousHighBeamDeactiveTriggerDetect_Detect_Decrease ExteriorLightManager_ELM_Main_sys_ELM_Main_ExteriorLightingControlByStalkSwitch_ManualHighBeamControl_ContinuousHighBeam_ContinuousHighBeamDeactiveTriggerDetect_Detect_Rise_Positive /end SUB_GROUP
/end GROUP
/begin GROUP ExteriorLightManager_ELM_Main_sys_ELM_Main_ExteriorLightingControlByStalkSwitch_ManualHighBeamControl_ContinuousHighBeam_ContinuousHighBeamDeactivePreconditionDetmn "ExteriorLightManager/ELM_Main_sys/ELM_Main/ExteriorLightingControlByStalkSwitch/ManualHighBeamControl/ContinuousHighBeam/ContinuousHighBeamDeactivePreconditionDetmn" /end GROUP
/begin GROUP ExteriorLightManager_ELM_Main_sys_ELM_Main_ExteriorLightingControlByStalkSwitch_ManualHighBeamControl_ContinuousHighBeam_ContinuousHighBeamActivePreconditionDetmn "ExteriorLightManager/ELM_Main_sys/ELM_Main/ExteriorLightingControlByStalkSwitch/ManualHighBeamControl/ContinuousHighBeam/ContinuousHighBeamActivePreconditionDetmn" /end GROUP
/begin GROUP ExteriorLightManager_ELM_Main_sys_ELM_Main_ExteriorLightingControlByStalkSwitch_ManualHighBeamControl_ContinuousHighBeam "ExteriorLightManager/ELM_Main_sys/ELM_Main/ExteriorLightingControlByStalkSwitch/ManualHighBeamControl/ContinuousHighBeam"
 /begin SUB_GROUP ExteriorLightManager_ELM_Main_sys_ELM_Main_ExteriorLightingControlByStalkSwitch_ManualHighBeamControl_ContinuousHighBeam_ContinuousHighBeamActivePreconditionDetmn ExteriorLightManager_ELM_Main_sys_ELM_Main_ExteriorLightingControlByStalkSwitch_ManualHighBeamControl_ContinuousHighBeam_ContinuousHighBeamDeactivePreconditionDetmn ExteriorLightManager_ELM_Main_sys_ELM_Main_ExteriorLightingControlByStalkSwitch_ManualHighBeamControl_ContinuousHighBeam_ContinuousHighBeamDeactiveTriggerDetect ExteriorLightManager_ELM_Main_sys_ELM_Main_ExteriorLightingControlByStalkSwitch_ManualHighBeamControl_ContinuousHighBeam_Detect_Rise_Positive ExteriorLightManager_ELM_Main_sys_ELM_Main_ExteriorLightingControlByStalkSwitch_ManualHighBeamControl_ContinuousHighBeam_Detect_Rise_Positive2 /end SUB_GROUP
/end GROUP
/begin GROUP ExteriorLightManager_ELM_Main_sys_ELM_Main_ExteriorLightingControlByStalkSwitch_ManualHighBeamControl "ExteriorLightManager/ELM_Main_sys/ELM_Main/ExteriorLightingControlByStalkSwitch/ManualHighBeamControl"
 /begin SUB_GROUP ExteriorLightManager_ELM_Main_sys_ELM_Main_ExteriorLightingControlByStalkSwitch_ManualHighBeamControl_ContinuousHighBeam ExteriorLightManager_ELM_Main_sys_ELM_Main_ExteriorLightingControlByStalkSwitch_ManualHighBeamControl_FlashHighBeam /end SUB_GROUP
/end GROUP
/begin GROUP ExteriorLightManager_ELM_Main_sys_ELM_Main_ExteriorLightingControlByStalkSwitch_IndividualParkingLightControl_RightParkingLightControl_Timer "ExteriorLightManager/ELM_Main_sys/ELM_Main/ExteriorLightingControlByStalkSwitch/IndividualParkingLightControl/RightParkingLightControl/Timer" /end GROUP
/begin GROUP ExteriorLightManager_ELM_Main_sys_ELM_Main_ExteriorLightingControlByStalkSwitch_IndividualParkingLightControl_RightParkingLightControl_TIME_FRAME "ExteriorLightManager/ELM_Main_sys/ELM_Main/ExteriorLightingControlByStalkSwitch/IndividualParkingLightControl/RightParkingLightControl/TIME_FRAME" /begin REF_CHARACTERISTIC TIME_FRAME /end REF_CHARACTERISTIC /end GROUP
/begin GROUP ExteriorLightManager_ELM_Main_sys_ELM_Main_ExteriorLightingControlByStalkSwitch_IndividualParkingLightControl_RightParkingLightControl_S_R_Flip_Flop2 "ExteriorLightManager/ELM_Main_sys/ELM_Main/ExteriorLightingControlByStalkSwitch/IndividualParkingLightControl/RightParkingLightControl/S-R\r\nFlip-Flop2" /end GROUP
/begin GROUP ExteriorLightManager_ELM_Main_sys_ELM_Main_ExteriorLightingControlByStalkSwitch_IndividualParkingLightControl_RightParkingLightControl_S_R_Flip_Flop1 "ExteriorLightManager/ELM_Main_sys/ELM_Main/ExteriorLightingControlByStalkSwitch/IndividualParkingLightControl/RightParkingLightControl/S-R\r\nFlip-Flop1" /end GROUP
/begin GROUP ExteriorLightManager_ELM_Main_sys_ELM_Main_ExteriorLightingControlByStalkSwitch_IndividualParkingLightControl_RightParkingLightControl_Detect_Rise_Positive1 "ExteriorLightManager/ELM_Main_sys/ELM_Main/ExteriorLightingControlByStalkSwitch/IndividualParkingLightControl/RightParkingLightControl/Detect Rise\r\nPositive1" /end GROUP
/begin GROUP ExteriorLightManager_ELM_Main_sys_ELM_Main_ExteriorLightingControlByStalkSwitch_IndividualParkingLightControl_RightParkingLightControl_Detect_Rise_Positive "ExteriorLightManager/ELM_Main_sys/ELM_Main/ExteriorLightingControlByStalkSwitch/IndividualParkingLightControl/RightParkingLightControl/Detect Rise\r\nPositive" /end GROUP
/begin GROUP ExteriorLightManager_ELM_Main_sys_ELM_Main_ExteriorLightingControlByStalkSwitch_IndividualParkingLightControl_RightParkingLightControl "ExteriorLightManager/ELM_Main_sys/ELM_Main/ExteriorLightingControlByStalkSwitch/IndividualParkingLightControl/RightParkingLightControl"
 /begin SUB_GROUP ExteriorLightManager_ELM_Main_sys_ELM_Main_ExteriorLightingControlByStalkSwitch_IndividualParkingLightControl_RightParkingLightControl_Detect_Rise_Positive ExteriorLightManager_ELM_Main_sys_ELM_Main_ExteriorLightingControlByStalkSwitch_IndividualParkingLightControl_RightParkingLightControl_Detect_Rise_Positive1 ExteriorLightManager_ELM_Main_sys_ELM_Main_ExteriorLightingControlByStalkSwitch_IndividualParkingLightControl_RightParkingLightControl_ELM_Ts_P ExteriorLightManager_ELM_Main_sys_ELM_Main_ExteriorLightingControlByStalkSwitch_IndividualParkingLightControl_RightParkingLightControl_S_R_Flip_Flop1 ExteriorLightManager_ELM_Main_sys_ELM_Main_ExteriorLightingControlByStalkSwitch_IndividualParkingLightControl_RightParkingLightControl_S_R_Flip_Flop2 ExteriorLightManager_ELM_Main_sys_ELM_Main_ExteriorLightingControlByStalkSwitch_IndividualParkingLightControl_RightParkingLightControl_TIME_FRAME ExteriorLightManager_ELM_Main_sys_ELM_Main_ExteriorLightingControlByStalkSwitch_IndividualParkingLightControl_RightParkingLightControl_Timer /end SUB_GROUP
/end GROUP
/begin GROUP ExteriorLightManager_ELM_Main_sys_ELM_Main_ExteriorLightingControlByStalkSwitch_IndividualParkingLightControl_LeftParkingLightControl_Timer "ExteriorLightManager/ELM_Main_sys/ELM_Main/ExteriorLightingControlByStalkSwitch/IndividualParkingLightControl/LeftParkingLightControl/Timer" /end GROUP
/begin GROUP ExteriorLightManager_ELM_Main_sys_ELM_Main_ExteriorLightingControlByStalkSwitch_IndividualParkingLightControl_LeftParkingLightControl_TIME_FRAME "ExteriorLightManager/ELM_Main_sys/ELM_Main/ExteriorLightingControlByStalkSwitch/IndividualParkingLightControl/LeftParkingLightControl/TIME_FRAME" /begin REF_CHARACTERISTIC TIME_FRAME /end REF_CHARACTERISTIC /end GROUP
/begin GROUP ExteriorLightManager_ELM_Main_sys_ELM_Main_ExteriorLightingControlByStalkSwitch_IndividualParkingLightControl_LeftParkingLightControl_S_R_Flip_Flop2 "ExteriorLightManager/ELM_Main_sys/ELM_Main/ExteriorLightingControlByStalkSwitch/IndividualParkingLightControl/LeftParkingLightControl/S-R\r\nFlip-Flop2" /end GROUP
/begin GROUP ExteriorLightManager_ELM_Main_sys_ELM_Main_ExteriorLightingControlByStalkSwitch_IndividualParkingLightControl_LeftParkingLightControl_S_R_Flip_Flop1 "ExteriorLightManager/ELM_Main_sys/ELM_Main/ExteriorLightingControlByStalkSwitch/IndividualParkingLightControl/LeftParkingLightControl/S-R\r\nFlip-Flop1" /end GROUP
/begin GROUP ExteriorLightManager_ELM_Main_sys_ELM_Main_ExteriorLightingControlByStalkSwitch_IndividualParkingLightControl_LeftParkingLightControl_Detect_Rise_Positive1 "ExteriorLightManager/ELM_Main_sys/ELM_Main/ExteriorLightingControlByStalkSwitch/IndividualParkingLightControl/LeftParkingLightControl/Detect Rise\r\nPositive1" /end GROUP
/begin GROUP ExteriorLightManager_ELM_Main_sys_ELM_Main_ExteriorLightingControlByStalkSwitch_IndividualParkingLightControl_LeftParkingLightControl_Detect_Rise_Positive "ExteriorLightManager/ELM_Main_sys/ELM_Main/ExteriorLightingControlByStalkSwitch/IndividualParkingLightControl/LeftParkingLightControl/Detect Rise\r\nPositive" /end GROUP
/begin GROUP ExteriorLightManager_ELM_Main_sys_ELM_Main_ExteriorLightingControlByStalkSwitch_IndividualParkingLightControl_LeftParkingLightControl "ExteriorLightManager/ELM_Main_sys/ELM_Main/ExteriorLightingControlByStalkSwitch/IndividualParkingLightControl/LeftParkingLightControl"
 /begin SUB_GROUP ExteriorLightManager_ELM_Main_sys_ELM_Main_ExteriorLightingControlByStalkSwitch_IndividualParkingLightControl_LeftParkingLightControl_Detect_Rise_Positive ExteriorLightManager_ELM_Main_sys_ELM_Main_ExteriorLightingControlByStalkSwitch_IndividualParkingLightControl_LeftParkingLightControl_Detect_Rise_Positive1 ExteriorLightManager_ELM_Main_sys_ELM_Main_ExteriorLightingControlByStalkSwitch_IndividualParkingLightControl_LeftParkingLightControl_ELM_Ts_P ExteriorLightManager_ELM_Main_sys_ELM_Main_ExteriorLightingControlByStalkSwitch_IndividualParkingLightControl_LeftParkingLightControl_S_R_Flip_Flop1 ExteriorLightManager_ELM_Main_sys_ELM_Main_ExteriorLightingControlByStalkSwitch_IndividualParkingLightControl_LeftParkingLightControl_S_R_Flip_Flop2 ExteriorLightManager_ELM_Main_sys_ELM_Main_ExteriorLightingControlByStalkSwitch_IndividualParkingLightControl_LeftParkingLightControl_TIME_FRAME ExteriorLightManager_ELM_Main_sys_ELM_Main_ExteriorLightingControlByStalkSwitch_IndividualParkingLightControl_LeftParkingLightControl_Timer /end SUB_GROUP
/end GROUP
/begin GROUP ExteriorLightManager_ELM_Main_sys_ELM_Main_ExteriorLightingControlByStalkSwitch_IndividualParkingLightControl "ExteriorLightManager/ELM_Main_sys/ELM_Main/ExteriorLightingControlByStalkSwitch/IndividualParkingLightControl"
 /begin SUB_GROUP ExteriorLightManager_ELM_Main_sys_ELM_Main_ExteriorLightingControlByStalkSwitch_IndividualParkingLightControl_LeftParkingLightControl ExteriorLightManager_ELM_Main_sys_ELM_Main_ExteriorLightingControlByStalkSwitch_IndividualParkingLightControl_RightParkingLightControl /end SUB_GROUP
/end GROUP
/begin GROUP ExteriorLightManager_ELM_Main_sys_ELM_Main_ExteriorLightingControlByStalkSwitch "ExteriorLightManager/ELM_Main_sys/ELM_Main/ExteriorLightingControlByStalkSwitch"
 /begin SUB_GROUP ExteriorLightManager_ELM_Main_sys_ELM_Main_ExteriorLightingControlByStalkSwitch_IndividualParkingLightControl ExteriorLightManager_ELM_Main_sys_ELM_Main_ExteriorLightingControlByStalkSwitch_ManualHighBeamControl ExteriorLightManager_ELM_Main_sys_ELM_Main_ExteriorLightingControlByStalkSwitch_TurnIndicatorLightControl /end SUB_GROUP
/end GROUP
/begin GROUP ExteriorLightManager_ELM_Main_sys_ELM_Main_ExteriorLightingControl "ExteriorLightManager/ELM_Main_sys/ELM_Main/ExteriorLightingControl"
 /begin SUB_GROUP ExteriorLightManager_ELM_Main_sys_ELM_Main_ExteriorLightingControl_AutoHeadlightsControl ExteriorLightManager_ELM_Main_sys_ELM_Main_ExteriorLightingControl_AutoHeadlightsSetting ExteriorLightManager_ELM_Main_sys_ELM_Main_ExteriorLightingControl_CorneringLightsControl ExteriorLightManager_ELM_Main_sys_ELM_Main_ExteriorLightingControl_DaytimeRunningLightControl ExteriorLightManager_ELM_Main_sys_ELM_Main_ExteriorLightingControl_FogLightControl ExteriorLightManager_ELM_Main_sys_ELM_Main_ExteriorLightingControl_LowBeamControl ExteriorLightManager_ELM_Main_sys_ELM_Main_ExteriorLightingControl_ParkingLightsControl /end SUB_GROUP
/end GROUP
/begin GROUP ExteriorLightManager_ELM_Main_sys_ELM_Main "ExteriorLightManager/ELM_Main_sys/ELM_Main"
 /begin SUB_GROUP ExteriorLightManager_ELM_Main_sys_ELM_Main_ExteriorLightingControl ExteriorLightManager_ELM_Main_sys_ELM_Main_ExteriorLightingControlByStalkSwitch ExteriorLightManager_ELM_Main_sys_ELM_Main_HazardWarningAndRearLightingControl ExteriorLightManager_ELM_Main_sys_ELM_Main_IntelligentExteriorLightingControl ExteriorLightManager_ELM_Main_sys_ELM_Main_LeftStalkStsDetmn ExteriorLightManager_ELM_Main_sys_ELM_Main_LightActuator ExteriorLightManager_ELM_Main_sys_ELM_Main_LightStsDetmn /end SUB_GROUP
/end GROUP
/begin GROUP ExteriorLightManager_ELM_Main_sys "ExteriorLightManager/ELM_Main_sys" /begin SUB_GROUP ExteriorLightManager_ELM_Main_sys_ELM_Main /end SUB_GROUP /end GROUP
/begin GROUP ExteriorLightManager "ExteriorLightManager" ROOT /begin SUB_GROUP ExteriorLightManager_ELM_Main_sys /end SUB_GROUP
 /begin REF_MEASUREMENT CLM_LampONReminder COM_FLMirrorLEDSts COM_FRMirrorLEDSts ELM_AHBIcon ELM_AHBLeftHBStatus ELM_AHBOverrideSts ELM_AHBRightHBStatus ELM_AHBStatus ELM_AHLPitchAngle ELM_AHLWorkingMode ELM_CMBrakeLightRequest ELM_ExteriorLightStatus ELM_FLAHLTargetPosition ELM_FLDRLRequest ELM_FLFogLightRequest ELM_FLHighBeamRequest ELM_FLLowBeamRequest ELM_FLMirrorLEDRequest ELM_FLPosLightRequest ELM_FLTurnIndicatorRequest ELM_FMHStatus ELM_FRAHLTargetPosition ELM_FRDRLRequest ELM_FRFogLightRequest ELM_FRHighBeamRequest ELM_FRLowBeamRequest ELM_FRMirrorLEDRequest ELM_FRPosLightRequest ELM_FRTurnIndicatorRequest ELM_FrontFogLightStatus ELM_IndicatorLightMode ELM_LeftBrakeLightRequest ELM_LeftReverseLampRequest ELM_LicensePlateLampRequest ELM_Nv_ExteriorLightSet ELM_Nv_FMHSet ELM_Nv_FrontFogLightSet ELM_Nv_RearFogLightSet ELM_Nv_WelcomeLightSet ELM_RLFogLightRequest ELM_RLPosLightRequest ELM_RLTurnIndicatorRequest ELM_RRFogLightRequest ELM_RRPosLightRequest ELM_RRTurnIndicatorRequest ELM_RearFogLightStatus ELM_RegenerativeBrakeLightSts ELM_RightBrakeLightRequest ELM_RightReverseLampRequest ELM_WelcomeLightStatus /end REF_MEASUREMENT
/end GROUP
/begin GROUP CentralLockingMaster_CLM_Main_sys_CentralLocking_StatusJudge_DoorLockJudge_CLM_DriverCfg_P "CentralLockingMaster/CLM_Main_sys/CentralLocking/StatusJudge/DoorLockJudge/CLM_DriverCfg_P" /begin REF_CHARACTERISTIC CLM_DriverCfg_P /end REF_CHARACTERISTIC /end GROUP
/begin GROUP CentralLockingMaster_CLM_Main_sys_CentralLocking_StatusJudge_DoorLockJudge "CentralLockingMaster/CLM_Main_sys/CentralLocking/StatusJudge/DoorLockJudge"
 /begin SUB_GROUP CentralLockingMaster_CLM_Main_sys_CentralLocking_StatusJudge_DoorLockJudge_CLM_DriverCfg_P /end SUB_GROUP
 /begin REF_MEASUREMENT BCMFL_DoorLockStatusFL BCMFR_DoorLockStatusFR BCMRE_DoorLockStatusRL BCMRE_DoorLockStatusRR /end REF_MEASUREMENT
/end GROUP
/begin GROUP CentralLockingMaster_CLM_Main_sys_CentralLocking_StatusJudge_AjarJudge_CLM_DriverCfg_P "CentralLockingMaster/CLM_Main_sys/CentralLocking/StatusJudge/AjarJudge/CLM_DriverCfg_P" /begin REF_CHARACTERISTIC CLM_DriverCfg_P /end REF_CHARACTERISTIC /end GROUP
/begin GROUP CentralLockingMaster_CLM_Main_sys_CentralLocking_StatusJudge_AjarJudge "CentralLockingMaster/CLM_Main_sys/CentralLocking/StatusJudge/AjarJudge"
 /begin SUB_GROUP CentralLockingMaster_CLM_Main_sys_CentralLocking_StatusJudge_AjarJudge_CLM_DriverCfg_P /end SUB_GROUP
 /begin REF_MEASUREMENT BCMFL_BonnetAjarStatus BCMFL_DoorAjarStatusFL BCMFR_DoorAjarStatusFR BCMRE_DoorAjarStatusRL BCMRE_DoorAjarStatusRR BCMRE_TailgateAjarStatus /end REF_MEASUREMENT
/end GROUP
/begin GROUP CentralLockingMaster_CLM_Main_sys_CentralLocking_StatusJudge "CentralLockingMaster/CLM_Main_sys/CentralLocking/StatusJudge"
 /begin SUB_GROUP CentralLockingMaster_CLM_Main_sys_CentralLocking_StatusJudge_AjarJudge CentralLockingMaster_CLM_Main_sys_CentralLocking_StatusJudge_DoorLockJudge /end SUB_GROUP
/end GROUP
/begin GROUP CentralLockingMaster_CLM_Main_sys_CentralLocking_SettgStore_CLM_DisaWalkAwayLockCfg_P "CentralLockingMaster/CLM_Main_sys/CentralLocking/SettgStore/CLM_DisaWalkAwayLockCfg_P" /begin REF_CHARACTERISTIC CLM_DisaWalkAwayLockCfg_P /end REF_CHARACTERISTIC /end GROUP
/begin GROUP CentralLockingMaster_CLM_Main_sys_CentralLocking_SettgStore_CLM_DisaUnlockOption_P "CentralLockingMaster/CLM_Main_sys/CentralLocking/SettgStore/CLM_DisaUnlockOption_P" /begin REF_CHARACTERISTIC CLM_DisaUnlockOption_P /end REF_CHARACTERISTIC /end GROUP
/begin GROUP CentralLockingMaster_CLM_Main_sys_CentralLocking_SettgStore_CLM_DisaUnlockOptionCfg_P "CentralLockingMaster/CLM_Main_sys/CentralLocking/SettgStore/CLM_DisaUnlockOptionCfg_P" /begin REF_CHARACTERISTIC CLM_DisaUnlockOptionCfg_P /end REF_CHARACTERISTIC /end GROUP
/begin GROUP CentralLockingMaster_CLM_Main_sys_CentralLocking_SettgStore_CLM_DisaSpdLockCfg_P1 "CentralLockingMaster/CLM_Main_sys/CentralLocking/SettgStore/CLM_DisaSpdLockCfg_P1" /begin REF_CHARACTERISTIC CLM_DisaSpdLockCfg_P /end REF_CHARACTERISTIC /end GROUP
/begin GROUP CentralLockingMaster_CLM_Main_sys_CentralLocking_SettgStore_CLM_DisaParkUnlockSetCfg_P "CentralLockingMaster/CLM_Main_sys/CentralLocking/SettgStore/CLM_DisaParkUnlockSetCfg_P" /begin REF_CHARACTERISTIC CLM_DisaParkUnlockSetCfg_P /end REF_CHARACTERISTIC /end GROUP
/begin GROUP CentralLockingMaster_CLM_Main_sys_CentralLocking_SettgStore_CLM_DisaFeedbackCfg_P "CentralLockingMaster/CLM_Main_sys/CentralLocking/SettgStore/CLM_DisaFeedbackCfg_P" /begin REF_CHARACTERISTIC CLM_DisaFeedbackCfg_P /end REF_CHARACTERISTIC /end GROUP
/begin GROUP CentralLockingMaster_CLM_Main_sys_CentralLocking_SettgStore "CentralLockingMaster/CLM_Main_sys/CentralLocking/SettgStore"
 /begin SUB_GROUP CentralLockingMaster_CLM_Main_sys_CentralLocking_SettgStore_CLM_DisaFeedbackCfg_P CentralLockingMaster_CLM_Main_sys_CentralLocking_SettgStore_CLM_DisaParkUnlockSetCfg_P CentralLockingMaster_CLM_Main_sys_CentralLocking_SettgStore_CLM_DisaSpdLockCfg_P1 CentralLockingMaster_CLM_Main_sys_CentralLocking_SettgStore_CLM_DisaUnlockOptionCfg_P CentralLockingMaster_CLM_Main_sys_CentralLocking_SettgStore_CLM_DisaUnlockOption_P CentralLockingMaster_CLM_Main_sys_CentralLocking_SettgStore_CLM_DisaWalkAwayLockCfg_P /end SUB_GROUP
 /begin REF_MEASUREMENT Nv_ChildModeSet Nv_DoorUnlockOptionSet Nv_FeedbackSignalsSet Nv_ParkUnlockSet Nv_SpeedLockSet Nv_WalkAwayLockSet S2S_ChildModeSet S2S_DoorUnlockOptionSet S2S_FeedbackSignalsSet S2S_ParkUnlockSet S2S_SpeedLockSet S2S_WalkAwayLockSet /end REF_MEASUREMENT
/end GROUP
/begin GROUP CentralLockingMaster_CLM_Main_sys_CentralLocking_KeyFobSearch_TurnOffDelay "CentralLockingMaster/CLM_Main_sys/CentralLocking/KeyFobSearch/TurnOffDelay" /end GROUP
/begin GROUP CentralLockingMaster_CLM_Main_sys_CentralLocking_KeyFobSearch_PESwitchSearch_Detect_Rise_Positive2 "CentralLockingMaster/CLM_Main_sys/CentralLocking/KeyFobSearch/PESwitchSearch/Detect Rise\r\nPositive2" /end GROUP
/begin GROUP CentralLockingMaster_CLM_Main_sys_CentralLocking_KeyFobSearch_PESwitchSearch "CentralLockingMaster/CLM_Main_sys/CentralLocking/KeyFobSearch/PESwitchSearch"
 /begin SUB_GROUP CentralLockingMaster_CLM_Main_sys_CentralLocking_KeyFobSearch_PESwitchSearch_Detect_Rise_Positive2 /end SUB_GROUP
 /begin REF_MEASUREMENT BCMFL_PassiveEntryButtonReq BCMFR_KeyFOBAuthenStatus BCMFR_KeyFOBPosition /end REF_MEASUREMENT
/end GROUP
/begin GROUP CentralLockingMaster_CLM_Main_sys_CentralLocking_KeyFobSearch_Detect_Rise_Positive4 "CentralLockingMaster/CLM_Main_sys/CentralLocking/KeyFobSearch/Detect Rise\r\nPositive4" /end GROUP
/begin GROUP CentralLockingMaster_CLM_Main_sys_CentralLocking_KeyFobSearch_Detect_Rise_Positive3 "CentralLockingMaster/CLM_Main_sys/CentralLocking/KeyFobSearch/Detect Rise\r\nPositive3" /end GROUP
/begin GROUP CentralLockingMaster_CLM_Main_sys_CentralLocking_KeyFobSearch_Detect_Rise_Positive1 "CentralLockingMaster/CLM_Main_sys/CentralLocking/KeyFobSearch/Detect Rise\r\nPositive1" /end GROUP
/begin GROUP CentralLockingMaster_CLM_Main_sys_CentralLocking_KeyFobSearch_CLM_SampleTi_P "CentralLockingMaster/CLM_Main_sys/CentralLocking/KeyFobSearch/CLM_SampleTi_P" /begin REF_CHARACTERISTIC CLM_SampleTi_P /end REF_CHARACTERISTIC /end GROUP
/begin GROUP CentralLockingMaster_CLM_Main_sys_CentralLocking_KeyFobSearch_CLM_KeyFOBSearchReqDelayTd_P "CentralLockingMaster/CLM_Main_sys/CentralLocking/KeyFobSearch/CLM_KeyFOBSearchReqDelayTd_P" /begin REF_CHARACTERISTIC CLM_KeyFOBSearchReqDelayTd_P /end REF_CHARACTERISTIC /end GROUP
/begin GROUP CentralLockingMaster_CLM_Main_sys_CentralLocking_KeyFobSearch "CentralLockingMaster/CLM_Main_sys/CentralLocking/KeyFobSearch"
 /begin SUB_GROUP CentralLockingMaster_CLM_Main_sys_CentralLocking_KeyFobSearch_CLM_KeyFOBSearchReqDelayTd_P CentralLockingMaster_CLM_Main_sys_CentralLocking_KeyFobSearch_CLM_SampleTi_P CentralLockingMaster_CLM_Main_sys_CentralLocking_KeyFobSearch_Detect_Rise_Positive1 CentralLockingMaster_CLM_Main_sys_CentralLocking_KeyFobSearch_Detect_Rise_Positive3 CentralLockingMaster_CLM_Main_sys_CentralLocking_KeyFobSearch_Detect_Rise_Positive4 CentralLockingMaster_CLM_Main_sys_CentralLocking_KeyFobSearch_PESwitchSearch CentralLockingMaster_CLM_Main_sys_CentralLocking_KeyFobSearch_TurnOffDelay /end SUB_GROUP
 /begin REF_MEASUREMENT ATA_KeyFOBSearchReq CVC_ACTGear IDB_BrakingSensorStatus IMMO_KeyFOBSearchReq TCM_VehicleOperationState /end REF_MEASUREMENT
/end GROUP
/begin GROUP CentralLockingMaster_CLM_Main_sys_CentralLocking_InternalControl_ParkUnlockCtrl_ParkUnlck "CentralLockingMaster/CLM_Main_sys/CentralLocking/InternalControl/ParkUnlockCtrl/ParkUnlck" /begin REF_MEASUREMENT CVC_ACTGear TCM_VehicleOperationState /end REF_MEASUREMENT /end GROUP
/begin GROUP CentralLockingMaster_CLM_Main_sys_CentralLocking_InternalControl_ParkUnlockCtrl "CentralLockingMaster/CLM_Main_sys/CentralLocking/InternalControl/ParkUnlockCtrl"
 /begin SUB_GROUP CentralLockingMaster_CLM_Main_sys_CentralLocking_InternalControl_ParkUnlockCtrl_ParkUnlck /end SUB_GROUP
/end GROUP
/begin GROUP CentralLockingMaster_CLM_Main_sys_CentralLocking_InternalControl_DoorLockCtrlBySpd_VehSpdLockCfg_SPEED_LOCK_DEFAULT2 "CentralLockingMaster/CLM_Main_sys/CentralLocking/InternalControl/DoorLockCtrlBySpd/VehSpdLockCfg/SPEED_LOCK_DEFAULT2" /begin REF_CHARACTERISTIC SPEED_LOCK_DEFAULT /end REF_CHARACTERISTIC /end GROUP
/begin GROUP CentralLockingMaster_CLM_Main_sys_CentralLocking_InternalControl_DoorLockCtrlBySpd_VehSpdLockCfg_SPEED_LOCK_DEFAULT1 "CentralLockingMaster/CLM_Main_sys/CentralLocking/InternalControl/DoorLockCtrlBySpd/VehSpdLockCfg/SPEED_LOCK_DEFAULT1" /begin REF_CHARACTERISTIC SPEED_LOCK_DEFAULT /end REF_CHARACTERISTIC /end GROUP
/begin GROUP CentralLockingMaster_CLM_Main_sys_CentralLocking_InternalControl_DoorLockCtrlBySpd_VehSpdLockCfg_SPEED_LOCK_DEFAULT "CentralLockingMaster/CLM_Main_sys/CentralLocking/InternalControl/DoorLockCtrlBySpd/VehSpdLockCfg/SPEED_LOCK_DEFAULT" /begin REF_CHARACTERISTIC SPEED_LOCK_DEFAULT /end REF_CHARACTERISTIC /end GROUP
/begin GROUP CentralLockingMaster_CLM_Main_sys_CentralLocking_InternalControl_DoorLockCtrlBySpd_VehSpdLockCfg "CentralLockingMaster/CLM_Main_sys/CentralLocking/InternalControl/DoorLockCtrlBySpd/VehSpdLockCfg"
 /begin SUB_GROUP CentralLockingMaster_CLM_Main_sys_CentralLocking_InternalControl_DoorLockCtrlBySpd_VehSpdLockCfg_SPEED_LOCK_DEFAULT CentralLockingMaster_CLM_Main_sys_CentralLocking_InternalControl_DoorLockCtrlBySpd_VehSpdLockCfg_SPEED_LOCK_DEFAULT1 CentralLockingMaster_CLM_Main_sys_CentralLocking_InternalControl_DoorLockCtrlBySpd_VehSpdLockCfg_SPEED_LOCK_DEFAULT2 /end SUB_GROUP
/end GROUP
/begin GROUP CentralLockingMaster_CLM_Main_sys_CentralLocking_InternalControl_DoorLockCtrlBySpd_SpdLockCtrlOnDoorOpen_UnitDelayRst "CentralLockingMaster/CLM_Main_sys/CentralLocking/InternalControl/DoorLockCtrlBySpd/SpdLockCtrlOnDoorOpen/UnitDelayRst" /end GROUP
/begin GROUP CentralLockingMaster_CLM_Main_sys_CentralLocking_InternalControl_DoorLockCtrlBySpd_SpdLockCtrlOnDoorOpen_Timer_MaxTimeDetermin "CentralLockingMaster/CLM_Main_sys/CentralLocking/InternalControl/DoorLockCtrlBySpd/SpdLockCtrlOnDoorOpen/Timer_MaxTimeDetermin" /end GROUP
/begin GROUP CentralLockingMaster_CLM_Main_sys_CentralLocking_InternalControl_DoorLockCtrlBySpd_SpdLockCtrlOnDoorOpen_S_R_Flip_Flop "CentralLockingMaster/CLM_Main_sys/CentralLocking/InternalControl/DoorLockCtrlBySpd/SpdLockCtrlOnDoorOpen/S-R\r\nFlip-Flop" /end GROUP
/begin GROUP CentralLockingMaster_CLM_Main_sys_CentralLocking_InternalControl_DoorLockCtrlBySpd_SpdLockCtrlOnDoorOpen_RELOCK_DELAY_TIME "CentralLockingMaster/CLM_Main_sys/CentralLocking/InternalControl/DoorLockCtrlBySpd/SpdLockCtrlOnDoorOpen/RELOCK_DELAY_TIME" /begin REF_CHARACTERISTIC RELOCK_DELAY_TIME /end REF_CHARACTERISTIC /end GROUP
/begin GROUP CentralLockingMaster_CLM_Main_sys_CentralLocking_InternalControl_DoorLockCtrlBySpd_SpdLockCtrlOnDoorOpen_InitialValueJudge_CLM_SampleTi_P "CentralLockingMaster/CLM_Main_sys/CentralLocking/InternalControl/DoorLockCtrlBySpd/SpdLockCtrlOnDoorOpen/InitialValueJudge/CLM_SampleTi_P" /begin REF_CHARACTERISTIC CLM_SampleTi_P /end REF_CHARACTERISTIC /end GROUP
/begin GROUP CentralLockingMaster_CLM_Main_sys_CentralLocking_InternalControl_DoorLockCtrlBySpd_SpdLockCtrlOnDoorOpen_InitialValueJudge_CLM_IniTi_P "CentralLockingMaster/CLM_Main_sys/CentralLocking/InternalControl/DoorLockCtrlBySpd/SpdLockCtrlOnDoorOpen/InitialValueJudge/CLM_IniTi_P" /begin REF_CHARACTERISTIC CLM_IniTi_P /end REF_CHARACTERISTIC /end GROUP
/begin GROUP CentralLockingMaster_CLM_Main_sys_CentralLocking_InternalControl_DoorLockCtrlBySpd_SpdLockCtrlOnDoorOpen_InitialValueJudge "CentralLockingMaster/CLM_Main_sys/CentralLocking/InternalControl/DoorLockCtrlBySpd/SpdLockCtrlOnDoorOpen/InitialValueJudge"
 /begin SUB_GROUP CentralLockingMaster_CLM_Main_sys_CentralLocking_InternalControl_DoorLockCtrlBySpd_SpdLockCtrlOnDoorOpen_InitialValueJudge_CLM_IniTi_P CentralLockingMaster_CLM_Main_sys_CentralLocking_InternalControl_DoorLockCtrlBySpd_SpdLockCtrlOnDoorOpen_InitialValueJudge_CLM_SampleTi_P /end SUB_GROUP
/end GROUP
/begin GROUP CentralLockingMaster_CLM_Main_sys_CentralLocking_InternalControl_DoorLockCtrlBySpd_SpdLockCtrlOnDoorOpen_Detect_Rise_Positive "CentralLockingMaster/CLM_Main_sys/CentralLocking/InternalControl/DoorLockCtrlBySpd/SpdLockCtrlOnDoorOpen/Detect Rise\r\nPositive" /end GROUP
/begin GROUP CentralLockingMaster_CLM_Main_sys_CentralLocking_InternalControl_DoorLockCtrlBySpd_SpdLockCtrlOnDoorOpen_Detect_Increase "CentralLockingMaster/CLM_Main_sys/CentralLocking/InternalControl/DoorLockCtrlBySpd/SpdLockCtrlOnDoorOpen/Detect\r\nIncrease" /end GROUP
/begin GROUP CentralLockingMaster_CLM_Main_sys_CentralLocking_InternalControl_DoorLockCtrlBySpd_SpdLockCtrlOnDoorOpen_CLM_SampleTi_P "CentralLockingMaster/CLM_Main_sys/CentralLocking/InternalControl/DoorLockCtrlBySpd/SpdLockCtrlOnDoorOpen/CLM_SampleTi_P" /begin REF_CHARACTERISTIC CLM_SampleTi_P /end REF_CHARACTERISTIC /end GROUP
/begin GROUP CentralLockingMaster_CLM_Main_sys_CentralLocking_InternalControl_DoorLockCtrlBySpd_SpdLockCtrlOnDoorOpen_AUTO_RELOCK_TRY_TIME "CentralLockingMaster/CLM_Main_sys/CentralLocking/InternalControl/DoorLockCtrlBySpd/SpdLockCtrlOnDoorOpen/AUTO_RELOCK_TRY_TIME" /begin REF_CHARACTERISTIC AUTO_RELOCK_TRY_TIME /end REF_CHARACTERISTIC /end GROUP
/begin GROUP CentralLockingMaster_CLM_Main_sys_CentralLocking_InternalControl_DoorLockCtrlBySpd_SpdLockCtrlOnDoorOpen "CentralLockingMaster/CLM_Main_sys/CentralLocking/InternalControl/DoorLockCtrlBySpd/SpdLockCtrlOnDoorOpen"
 /begin SUB_GROUP CentralLockingMaster_CLM_Main_sys_CentralLocking_InternalControl_DoorLockCtrlBySpd_SpdLockCtrlOnDoorOpen_AUTO_RELOCK_TRY_TIME CentralLockingMaster_CLM_Main_sys_CentralLocking_InternalControl_DoorLockCtrlBySpd_SpdLockCtrlOnDoorOpen_CLM_SampleTi_P CentralLockingMaster_CLM_Main_sys_CentralLocking_InternalControl_DoorLockCtrlBySpd_SpdLockCtrlOnDoorOpen_Detect_Increase CentralLockingMaster_CLM_Main_sys_CentralLocking_InternalControl_DoorLockCtrlBySpd_SpdLockCtrlOnDoorOpen_Detect_Rise_Positive CentralLockingMaster_CLM_Main_sys_CentralLocking_InternalControl_DoorLockCtrlBySpd_SpdLockCtrlOnDoorOpen_InitialValueJudge CentralLockingMaster_CLM_Main_sys_CentralLocking_InternalControl_DoorLockCtrlBySpd_SpdLockCtrlOnDoorOpen_RELOCK_DELAY_TIME CentralLockingMaster_CLM_Main_sys_CentralLocking_InternalControl_DoorLockCtrlBySpd_SpdLockCtrlOnDoorOpen_S_R_Flip_Flop CentralLockingMaster_CLM_Main_sys_CentralLocking_InternalControl_DoorLockCtrlBySpd_SpdLockCtrlOnDoorOpen_Timer_MaxTimeDetermin CentralLockingMaster_CLM_Main_sys_CentralLocking_InternalControl_DoorLockCtrlBySpd_SpdLockCtrlOnDoorOpen_UnitDelayRst /end SUB_GROUP
/end GROUP
/begin GROUP CentralLockingMaster_CLM_Main_sys_CentralLocking_InternalControl_DoorLockCtrlBySpd_Detect_Rise_Positive2 "CentralLockingMaster/CLM_Main_sys/CentralLocking/InternalControl/DoorLockCtrlBySpd/Detect Rise\r\nPositive2" /end GROUP
/begin GROUP CentralLockingMaster_CLM_Main_sys_CentralLocking_InternalControl_DoorLockCtrlBySpd "CentralLockingMaster/CLM_Main_sys/CentralLocking/InternalControl/DoorLockCtrlBySpd"
 /begin SUB_GROUP CentralLockingMaster_CLM_Main_sys_CentralLocking_InternalControl_DoorLockCtrlBySpd_Detect_Rise_Positive2 CentralLockingMaster_CLM_Main_sys_CentralLocking_InternalControl_DoorLockCtrlBySpd_SpdLockCtrlOnDoorOpen CentralLockingMaster_CLM_Main_sys_CentralLocking_InternalControl_DoorLockCtrlBySpd_VehSpdLockCfg /end SUB_GROUP
 /begin REF_MEASUREMENT IDB_VehicleSpd TCM_VehicleOperationState /end REF_MEASUREMENT
/end GROUP
/begin GROUP CentralLockingMaster_CLM_Main_sys_CentralLocking_InternalControl_CentralButtonCtrl_TurnOffDelay "CentralLockingMaster/CLM_Main_sys/CentralLocking/InternalControl/CentralButtonCtrl/TurnOffDelay" /end GROUP
/begin GROUP CentralLockingMaster_CLM_Main_sys_CentralLocking_InternalControl_CentralButtonCtrl_Detect_Rise_Positive2 "CentralLockingMaster/CLM_Main_sys/CentralLocking/InternalControl/CentralButtonCtrl/Detect Rise\r\nPositive2" /end GROUP
/begin GROUP CentralLockingMaster_CLM_Main_sys_CentralLocking_InternalControl_CentralButtonCtrl_Detect_Decrease "CentralLockingMaster/CLM_Main_sys/CentralLocking/InternalControl/CentralButtonCtrl/Detect\r\nDecrease" /end GROUP
/begin GROUP CentralLockingMaster_CLM_Main_sys_CentralLocking_InternalControl_CentralButtonCtrl_DOOR_LOCK_DELAY "CentralLockingMaster/CLM_Main_sys/CentralLocking/InternalControl/CentralButtonCtrl/DOOR_LOCK_DELAY" /begin REF_CHARACTERISTIC DOOR_LOCK_DELAY /end REF_CHARACTERISTIC /end GROUP
/begin GROUP CentralLockingMaster_CLM_Main_sys_CentralLocking_InternalControl_CentralButtonCtrl_CLM_SampleTi_P "CentralLockingMaster/CLM_Main_sys/CentralLocking/InternalControl/CentralButtonCtrl/CLM_SampleTi_P" /begin REF_CHARACTERISTIC CLM_SampleTi_P /end REF_CHARACTERISTIC /end GROUP
/begin GROUP CentralLockingMaster_CLM_Main_sys_CentralLocking_InternalControl_CentralButtonCtrl_CLM_DisaCentralBtnCfg_P1 "CentralLockingMaster/CLM_Main_sys/CentralLocking/InternalControl/CentralButtonCtrl/CLM_DisaCentralBtnCfg_P1" /begin REF_CHARACTERISTIC CLM_DisaCentralBtnCfg_P /end REF_CHARACTERISTIC /end GROUP
/begin GROUP CentralLockingMaster_CLM_Main_sys_CentralLocking_InternalControl_CentralButtonCtrl_CLM_DisaCentralBtnCfg_P "CentralLockingMaster/CLM_Main_sys/CentralLocking/InternalControl/CentralButtonCtrl/CLM_DisaCentralBtnCfg_P" /begin REF_CHARACTERISTIC CLM_DisaCentralBtnCfg_P /end REF_CHARACTERISTIC /end GROUP
/begin GROUP CentralLockingMaster_CLM_Main_sys_CentralLocking_InternalControl_CentralButtonCtrl "CentralLockingMaster/CLM_Main_sys/CentralLocking/InternalControl/CentralButtonCtrl"
 /begin SUB_GROUP CentralLockingMaster_CLM_Main_sys_CentralLocking_InternalControl_CentralButtonCtrl_CLM_DisaCentralBtnCfg_P CentralLockingMaster_CLM_Main_sys_CentralLocking_InternalControl_CentralButtonCtrl_CLM_DisaCentralBtnCfg_P1 CentralLockingMaster_CLM_Main_sys_CentralLocking_InternalControl_CentralButtonCtrl_CLM_SampleTi_P CentralLockingMaster_CLM_Main_sys_CentralLocking_InternalControl_CentralButtonCtrl_DOOR_LOCK_DELAY CentralLockingMaster_CLM_Main_sys_CentralLocking_InternalControl_CentralButtonCtrl_Detect_Decrease CentralLockingMaster_CLM_Main_sys_CentralLocking_InternalControl_CentralButtonCtrl_Detect_Rise_Positive2 CentralLockingMaster_CLM_Main_sys_CentralLocking_InternalControl_CentralButtonCtrl_TurnOffDelay /end SUB_GROUP
 /begin REF_MEASUREMENT BCMFR_CentralLockLightStatus BCMFR_CentralLockingButton TCM_VehicleOperationState /end REF_MEASUREMENT
/end GROUP
/begin GROUP CentralLockingMaster_CLM_Main_sys_CentralLocking_InternalControl "CentralLockingMaster/CLM_Main_sys/CentralLocking/InternalControl"
 /begin SUB_GROUP CentralLockingMaster_CLM_Main_sys_CentralLocking_InternalControl_CentralButtonCtrl CentralLockingMaster_CLM_Main_sys_CentralLocking_InternalControl_DoorLockCtrlBySpd CentralLockingMaster_CLM_Main_sys_CentralLocking_InternalControl_ParkUnlockCtrl /end SUB_GROUP
/end GROUP
/begin GROUP CentralLockingMaster_CLM_Main_sys_CentralLocking_ExternalControl_WalkAway_WalkAwayFunctionSts_sys "CentralLockingMaster/CLM_Main_sys/CentralLocking/ExternalControl/WalkAway/WalkAwayFunctionSts_sys" /begin REF_MEASUREMENT WalkAwayFunctionSts /end REF_MEASUREMENT /end GROUP
/begin GROUP CentralLockingMaster_CLM_Main_sys_CentralLocking_ExternalControl_WalkAway_TranslateJudge_WalkAwayFunctionTrigger_sys "CentralLockingMaster/CLM_Main_sys/CentralLocking/ExternalControl/WalkAway/TranslateJudge/WalkAwayFunctionTrigger_sys" /begin REF_MEASUREMENT WalkAwayFunctionTrigger /end REF_MEASUREMENT /end GROUP
/begin GROUP CentralLockingMaster_CLM_Main_sys_CentralLocking_ExternalControl_WalkAway_TranslateJudge_WalkAwayFunctionTriggerJudge "CentralLockingMaster/CLM_Main_sys/CentralLocking/ExternalControl/WalkAway/TranslateJudge/WalkAwayFunctionTriggerJudge" /begin REF_MEASUREMENT ACM_DriverSeatBeltStatus CVC_ACTGear IDB_VehicleSpd /end REF_MEASUREMENT /end GROUP
/begin GROUP CentralLockingMaster_CLM_Main_sys_CentralLocking_ExternalControl_WalkAway_TranslateJudge_TrigSearchKeyToHandleKeyValid_sys "CentralLockingMaster/CLM_Main_sys/CentralLocking/ExternalControl/WalkAway/TranslateJudge/TrigSearchKeyToHandleKeyValid_sys" /begin REF_MEASUREMENT TrigSearchKeyToHandleKeyValid /end REF_MEASUREMENT /end GROUP
/begin GROUP CentralLockingMaster_CLM_Main_sys_CentralLocking_ExternalControl_WalkAway_TranslateJudge_TrigSearchKeyToHandleKeyValidJudge "CentralLockingMaster/CLM_Main_sys/CentralLocking/ExternalControl/WalkAway/TranslateJudge/TrigSearchKeyToHandleKeyValidJudge" /begin REF_MEASUREMENT BCMFR_KeyFOBAuthenStatus /end REF_MEASUREMENT /end GROUP
/begin GROUP CentralLockingMaster_CLM_Main_sys_CentralLocking_ExternalControl_WalkAway_TranslateJudge_RestartToHandleKeyValid_sys "CentralLockingMaster/CLM_Main_sys/CentralLocking/ExternalControl/WalkAway/TranslateJudge/RestartToHandleKeyValid_sys" /begin REF_MEASUREMENT RestartToHandleKeyValid /end REF_MEASUREMENT /end GROUP
/begin GROUP CentralLockingMaster_CLM_Main_sys_CentralLocking_ExternalControl_WalkAway_TranslateJudge_RestartToHandleKeyValidJudge "CentralLockingMaster/CLM_Main_sys/CentralLocking/ExternalControl/WalkAway/TranslateJudge/RestartToHandleKeyValidJudge" /begin REF_MEASUREMENT BCMRE_TailgateAjarStatus /end REF_MEASUREMENT /end GROUP
/begin GROUP CentralLockingMaster_CLM_Main_sys_CentralLocking_ExternalControl_WalkAway_TranslateJudge_RestartJudge "CentralLockingMaster/CLM_Main_sys/CentralLocking/ExternalControl/WalkAway/TranslateJudge/RestartJudge"
 /begin REF_MEASUREMENT BCMRE_DoorAjarStatusRL BCMRE_DoorAjarStatusRR BCMRE_TailgateAjarStatus /end REF_MEASUREMENT
/end GROUP
/begin GROUP CentralLockingMaster_CLM_Main_sys_CentralLocking_ExternalControl_WalkAway_TranslateJudge_RestartFunctionFlg_sys "CentralLockingMaster/CLM_Main_sys/CentralLocking/ExternalControl/WalkAway/TranslateJudge/RestartFunctionFlg_sys" /begin REF_MEASUREMENT RestartFunctionFlg /end REF_MEASUREMENT /end GROUP
/begin GROUP CentralLockingMaster_CLM_Main_sys_CentralLocking_ExternalControl_WalkAway_TranslateJudge_ExitJudge_UnlockExitJudge_UnitDelayRst "CentralLockingMaster/CLM_Main_sys/CentralLocking/ExternalControl/WalkAway/TranslateJudge/ExitJudge/UnlockExitJudge/UnitDelayRst" /end GROUP
/begin GROUP CentralLockingMaster_CLM_Main_sys_CentralLocking_ExternalControl_WalkAway_TranslateJudge_ExitJudge_UnlockExitJudge "CentralLockingMaster/CLM_Main_sys/CentralLocking/ExternalControl/WalkAway/TranslateJudge/ExitJudge/UnlockExitJudge"
 /begin SUB_GROUP CentralLockingMaster_CLM_Main_sys_CentralLocking_ExternalControl_WalkAway_TranslateJudge_ExitJudge_UnlockExitJudge_UnitDelayRst /end SUB_GROUP
/end GROUP
/begin GROUP CentralLockingMaster_CLM_Main_sys_CentralLocking_ExternalControl_WalkAway_TranslateJudge_ExitJudge_KeyValidIRExitJudge "CentralLockingMaster/CLM_Main_sys/CentralLocking/ExternalControl/WalkAway/TranslateJudge/ExitJudge/KeyValidIRExitJudge" /begin REF_MEASUREMENT BCMFR_KeyFOBAuthenStatus /end REF_MEASUREMENT /end GROUP
/begin GROUP CentralLockingMaster_CLM_Main_sys_CentralLocking_ExternalControl_WalkAway_TranslateJudge_ExitJudge "CentralLockingMaster/CLM_Main_sys/CentralLocking/ExternalControl/WalkAway/TranslateJudge/ExitJudge"
 /begin SUB_GROUP CentralLockingMaster_CLM_Main_sys_CentralLocking_ExternalControl_WalkAway_TranslateJudge_ExitJudge_KeyValidIRExitJudge CentralLockingMaster_CLM_Main_sys_CentralLocking_ExternalControl_WalkAway_TranslateJudge_ExitJudge_UnlockExitJudge /end SUB_GROUP
/end GROUP
/begin GROUP CentralLockingMaster_CLM_Main_sys_CentralLocking_ExternalControl_WalkAway_TranslateJudge_ExitFunctionFlg_sys "CentralLockingMaster/CLM_Main_sys/CentralLocking/ExternalControl/WalkAway/TranslateJudge/ExitFunctionFlg_sys" /begin REF_MEASUREMENT ExitFunctionFlg /end REF_MEASUREMENT /end GROUP
/begin GROUP CentralLockingMaster_CLM_Main_sys_CentralLocking_ExternalControl_WalkAway_TranslateJudge "CentralLockingMaster/CLM_Main_sys/CentralLocking/ExternalControl/WalkAway/TranslateJudge"
 /begin SUB_GROUP CentralLockingMaster_CLM_Main_sys_CentralLocking_ExternalControl_WalkAway_TranslateJudge_ExitFunctionFlg_sys CentralLockingMaster_CLM_Main_sys_CentralLocking_ExternalControl_WalkAway_TranslateJudge_ExitJudge CentralLockingMaster_CLM_Main_sys_CentralLocking_ExternalControl_WalkAway_TranslateJudge_RestartFunctionFlg_sys CentralLockingMaster_CLM_Main_sys_CentralLocking_ExternalControl_WalkAway_TranslateJudge_RestartJudge CentralLockingMaster_CLM_Main_sys_CentralLocking_ExternalControl_WalkAway_TranslateJudge_RestartToHandleKeyValidJudge CentralLockingMaster_CLM_Main_sys_CentralLocking_ExternalControl_WalkAway_TranslateJudge_RestartToHandleKeyValid_sys CentralLockingMaster_CLM_Main_sys_CentralLocking_ExternalControl_WalkAway_TranslateJudge_TrigSearchKeyToHandleKeyValidJudge CentralLockingMaster_CLM_Main_sys_CentralLocking_ExternalControl_WalkAway_TranslateJudge_TrigSearchKeyToHandleKeyValid_sys CentralLockingMaster_CLM_Main_sys_CentralLocking_ExternalControl_WalkAway_TranslateJudge_WalkAwayFunctionTriggerJudge CentralLockingMaster_CLM_Main_sys_CentralLocking_ExternalControl_WalkAway_TranslateJudge_WalkAwayFunctionTrigger_sys /end SUB_GROUP
/end GROUP
/begin GROUP CentralLockingMaster_CLM_Main_sys_CentralLocking_ExternalControl_WalkAway_HandleKeyValid_WALK_AW_TIMEOUT "CentralLockingMaster/CLM_Main_sys/CentralLocking/ExternalControl/WalkAway/HandleKeyValid/WALK_AW_TIMEOUT" /begin REF_CHARACTERISTIC WALK_AW_TIMEOUT /end REF_CHARACTERISTIC /end GROUP
/begin GROUP CentralLockingMaster_CLM_Main_sys_CentralLocking_ExternalControl_WalkAway_HandleKeyValid_TrigKeySearchCyclic_sys "CentralLockingMaster/CLM_Main_sys/CentralLocking/ExternalControl/WalkAway/HandleKeyValid/TrigKeySearchCyclic_sys" /begin REF_MEASUREMENT TrigKeySearchCyclic /end REF_MEASUREMENT /end GROUP
/begin GROUP CentralLockingMaster_CLM_Main_sys_CentralLocking_ExternalControl_WalkAway_HandleKeyValid_Timer_MaxTimeDetermin "CentralLockingMaster/CLM_Main_sys/CentralLocking/ExternalControl/WalkAway/HandleKeyValid/Timer_MaxTimeDetermin" /end GROUP
/begin GROUP CentralLockingMaster_CLM_Main_sys_CentralLocking_ExternalControl_WalkAway_HandleKeyValid_KeySearchCyclicTrig_PWMGenerator "CentralLockingMaster/CLM_Main_sys/CentralLocking/ExternalControl/WalkAway/HandleKeyValid/KeySearchCyclicTrig/PWMGenerator" /end GROUP
/begin GROUP CentralLockingMaster_CLM_Main_sys_CentralLocking_ExternalControl_WalkAway_HandleKeyValid_KeySearchCyclicTrig_CLM_SampleTi_P "CentralLockingMaster/CLM_Main_sys/CentralLocking/ExternalControl/WalkAway/HandleKeyValid/KeySearchCyclicTrig/CLM_SampleTi_P" /begin REF_CHARACTERISTIC CLM_SampleTi_P /end REF_CHARACTERISTIC /end GROUP
/begin GROUP CentralLockingMaster_CLM_Main_sys_CentralLocking_ExternalControl_WalkAway_HandleKeyValid_KeySearchCyclicTrig_ARIV "CentralLockingMaster/CLM_Main_sys/CentralLocking/ExternalControl/WalkAway/HandleKeyValid/KeySearchCyclicTrig/ARIV" /begin REF_CHARACTERISTIC ARIV /end REF_CHARACTERISTIC /end GROUP
/begin GROUP CentralLockingMaster_CLM_Main_sys_CentralLocking_ExternalControl_WalkAway_HandleKeyValid_KeySearchCyclicTrig "CentralLockingMaster/CLM_Main_sys/CentralLocking/ExternalControl/WalkAway/HandleKeyValid/KeySearchCyclicTrig"
 /begin SUB_GROUP CentralLockingMaster_CLM_Main_sys_CentralLocking_ExternalControl_WalkAway_HandleKeyValid_KeySearchCyclicTrig_ARIV CentralLockingMaster_CLM_Main_sys_CentralLocking_ExternalControl_WalkAway_HandleKeyValid_KeySearchCyclicTrig_CLM_SampleTi_P CentralLockingMaster_CLM_Main_sys_CentralLocking_ExternalControl_WalkAway_HandleKeyValid_KeySearchCyclicTrig_PWMGenerator /end SUB_GROUP
/end GROUP
/begin GROUP CentralLockingMaster_CLM_Main_sys_CentralLocking_ExternalControl_WalkAway_HandleKeyValid_EndFlgByKeyARIV_sys "CentralLockingMaster/CLM_Main_sys/CentralLocking/ExternalControl/WalkAway/HandleKeyValid/EndFlgByKeyARIV_sys" /begin REF_MEASUREMENT EndFlgByKeyARIV /end REF_MEASUREMENT /end GROUP
/begin GROUP CentralLockingMaster_CLM_Main_sys_CentralLocking_ExternalControl_WalkAway_HandleKeyValid_Detect_Increase1 "CentralLockingMaster/CLM_Main_sys/CentralLocking/ExternalControl/WalkAway/HandleKeyValid/Detect\r\nIncrease1" /end GROUP
/begin GROUP CentralLockingMaster_CLM_Main_sys_CentralLocking_ExternalControl_WalkAway_HandleKeyValid_Detect_Increase "CentralLockingMaster/CLM_Main_sys/CentralLocking/ExternalControl/WalkAway/HandleKeyValid/Detect\r\nIncrease" /end GROUP
/begin GROUP CentralLockingMaster_CLM_Main_sys_CentralLocking_ExternalControl_WalkAway_HandleKeyValid_CLM_SampleTi_P "CentralLockingMaster/CLM_Main_sys/CentralLocking/ExternalControl/WalkAway/HandleKeyValid/CLM_SampleTi_P" /begin REF_CHARACTERISTIC CLM_SampleTi_P /end REF_CHARACTERISTIC /end GROUP
/begin GROUP CentralLockingMaster_CLM_Main_sys_CentralLocking_ExternalControl_WalkAway_HandleKeyValid_CLM_IniTi_P "CentralLockingMaster/CLM_Main_sys/CentralLocking/ExternalControl/WalkAway/HandleKeyValid/CLM_IniTi_P" /begin REF_CHARACTERISTIC CLM_IniTi_P /end REF_CHARACTERISTIC /end GROUP
/begin GROUP CentralLockingMaster_CLM_Main_sys_CentralLocking_ExternalControl_WalkAway_HandleKeyValid_ARWalkAwayTimeFlag_sys "CentralLockingMaster/CLM_Main_sys/CentralLocking/ExternalControl/WalkAway/HandleKeyValid/ARWalkAwayTimeFlag_sys" /begin REF_MEASUREMENT ARWalkAwayTimeFlag /end REF_MEASUREMENT /end GROUP
/begin GROUP CentralLockingMaster_CLM_Main_sys_CentralLocking_ExternalControl_WalkAway_HandleKeyValid "CentralLockingMaster/CLM_Main_sys/CentralLocking/ExternalControl/WalkAway/HandleKeyValid"
 /begin SUB_GROUP CentralLockingMaster_CLM_Main_sys_CentralLocking_ExternalControl_WalkAway_HandleKeyValid_ARWalkAwayTimeFlag_sys CentralLockingMaster_CLM_Main_sys_CentralLocking_ExternalControl_WalkAway_HandleKeyValid_CLM_IniTi_P CentralLockingMaster_CLM_Main_sys_CentralLocking_ExternalControl_WalkAway_HandleKeyValid_CLM_SampleTi_P CentralLockingMaster_CLM_Main_sys_CentralLocking_ExternalControl_WalkAway_HandleKeyValid_Detect_Increase CentralLockingMaster_CLM_Main_sys_CentralLocking_ExternalControl_WalkAway_HandleKeyValid_Detect_Increase1 CentralLockingMaster_CLM_Main_sys_CentralLocking_ExternalControl_WalkAway_HandleKeyValid_EndFlgByKeyARIV_sys CentralLockingMaster_CLM_Main_sys_CentralLocking_ExternalControl_WalkAway_HandleKeyValid_KeySearchCyclicTrig CentralLockingMaster_CLM_Main_sys_CentralLocking_ExternalControl_WalkAway_HandleKeyValid_Timer_MaxTimeDetermin CentralLockingMaster_CLM_Main_sys_CentralLocking_ExternalControl_WalkAway_HandleKeyValid_TrigKeySearchCyclic_sys CentralLockingMaster_CLM_Main_sys_CentralLocking_ExternalControl_WalkAway_HandleKeyValid_WALK_AW_TIMEOUT /end SUB_GROUP
 /begin REF_MEASUREMENT BCMFR_KeyFOBAuthenStatus /end REF_MEASUREMENT
/end GROUP
/begin GROUP CentralLockingMaster_CLM_Main_sys_CentralLocking_ExternalControl_WalkAway_HandleKeyInvalid_WalkKeyReserchCount_sys "CentralLockingMaster/CLM_Main_sys/CentralLocking/ExternalControl/WalkAway/HandleKeyInvalid/WalkKeyReserchCount_sys" /begin REF_MEASUREMENT WalkKeyReserchCount /end REF_MEASUREMENT /end GROUP
/begin GROUP CentralLockingMaster_CLM_Main_sys_CentralLocking_ExternalControl_WalkAway_HandleKeyInvalid_UnitDelayRst "CentralLockingMaster/CLM_Main_sys/CentralLocking/ExternalControl/WalkAway/HandleKeyInvalid/UnitDelayRst" /end GROUP
/begin GROUP CentralLockingMaster_CLM_Main_sys_CentralLocking_ExternalControl_WalkAway_HandleKeyInvalid_TrigKeySearchByWalkAway_sys "CentralLockingMaster/CLM_Main_sys/CentralLocking/ExternalControl/WalkAway/HandleKeyInvalid/TrigKeySearchByWalkAway_sys" /begin REF_MEASUREMENT TrigKeySearchByWalkAway /end REF_MEASUREMENT /end GROUP
/begin GROUP CentralLockingMaster_CLM_Main_sys_CentralLocking_ExternalControl_WalkAway_HandleKeyInvalid_Timer_MaxTimeDetermin "CentralLockingMaster/CLM_Main_sys/CentralLocking/ExternalControl/WalkAway/HandleKeyInvalid/Timer_MaxTimeDetermin" /end GROUP
/begin GROUP CentralLockingMaster_CLM_Main_sys_CentralLocking_ExternalControl_WalkAway_HandleKeyInvalid_S_R_Flip_Flop "CentralLockingMaster/CLM_Main_sys/CentralLocking/ExternalControl/WalkAway/HandleKeyInvalid/S-R\r\nFlip-Flop" /end GROUP
/begin GROUP CentralLockingMaster_CLM_Main_sys_CentralLocking_ExternalControl_WalkAway_HandleKeyInvalid_ReTrigKeySearchINIV_sys "CentralLockingMaster/CLM_Main_sys/CentralLocking/ExternalControl/WalkAway/HandleKeyInvalid/ReTrigKeySearchINIV_sys" /begin REF_MEASUREMENT ReTrigKeySearchINIV /end REF_MEASUREMENT /end GROUP
/begin GROUP CentralLockingMaster_CLM_Main_sys_CentralLocking_ExternalControl_WalkAway_HandleKeyInvalid_N1 "CentralLockingMaster/CLM_Main_sys/CentralLocking/ExternalControl/WalkAway/HandleKeyInvalid/N1" /begin REF_CHARACTERISTIC N1 /end REF_CHARACTERISTIC /end GROUP
/begin GROUP CentralLockingMaster_CLM_Main_sys_CentralLocking_ExternalControl_WalkAway_HandleKeyInvalid_InitialValueJudge_CLM_SampleTi_P "CentralLockingMaster/CLM_Main_sys/CentralLocking/ExternalControl/WalkAway/HandleKeyInvalid/InitialValueJudge/CLM_SampleTi_P" /begin REF_CHARACTERISTIC CLM_SampleTi_P /end REF_CHARACTERISTIC /end GROUP
/begin GROUP CentralLockingMaster_CLM_Main_sys_CentralLocking_ExternalControl_WalkAway_HandleKeyInvalid_InitialValueJudge_CLM_IniTi_P "CentralLockingMaster/CLM_Main_sys/CentralLocking/ExternalControl/WalkAway/HandleKeyInvalid/InitialValueJudge/CLM_IniTi_P" /begin REF_CHARACTERISTIC CLM_IniTi_P /end REF_CHARACTERISTIC /end GROUP
/begin GROUP CentralLockingMaster_CLM_Main_sys_CentralLocking_ExternalControl_WalkAway_HandleKeyInvalid_InitialValueJudge "CentralLockingMaster/CLM_Main_sys/CentralLocking/ExternalControl/WalkAway/HandleKeyInvalid/InitialValueJudge"
 /begin SUB_GROUP CentralLockingMaster_CLM_Main_sys_CentralLocking_ExternalControl_WalkAway_HandleKeyInvalid_InitialValueJudge_CLM_IniTi_P CentralLockingMaster_CLM_Main_sys_CentralLocking_ExternalControl_WalkAway_HandleKeyInvalid_InitialValueJudge_CLM_SampleTi_P /end SUB_GROUP
/end GROUP
/begin GROUP CentralLockingMaster_CLM_Main_sys_CentralLocking_ExternalControl_WalkAway_HandleKeyInvalid_IRIV "CentralLockingMaster/CLM_Main_sys/CentralLocking/ExternalControl/WalkAway/HandleKeyInvalid/IRIV" /begin REF_CHARACTERISTIC IRIV /end REF_CHARACTERISTIC /end GROUP
/begin GROUP CentralLockingMaster_CLM_Main_sys_CentralLocking_ExternalControl_WalkAway_HandleKeyInvalid_EndFlgByKeyINIV_sys "CentralLockingMaster/CLM_Main_sys/CentralLocking/ExternalControl/WalkAway/HandleKeyInvalid/EndFlgByKeyINIV_sys" /begin REF_MEASUREMENT EndFlgByKeyINIV /end REF_MEASUREMENT /end GROUP
/begin GROUP CentralLockingMaster_CLM_Main_sys_CentralLocking_ExternalControl_WalkAway_HandleKeyInvalid_Detect_Increase "CentralLockingMaster/CLM_Main_sys/CentralLocking/ExternalControl/WalkAway/HandleKeyInvalid/Detect\r\nIncrease" /end GROUP
/begin GROUP CentralLockingMaster_CLM_Main_sys_CentralLocking_ExternalControl_WalkAway_HandleKeyInvalid_CLM_SampleTi_P "CentralLockingMaster/CLM_Main_sys/CentralLocking/ExternalControl/WalkAway/HandleKeyInvalid/CLM_SampleTi_P" /begin REF_CHARACTERISTIC CLM_SampleTi_P /end REF_CHARACTERISTIC /end GROUP
/begin GROUP CentralLockingMaster_CLM_Main_sys_CentralLocking_ExternalControl_WalkAway_HandleKeyInvalid "CentralLockingMaster/CLM_Main_sys/CentralLocking/ExternalControl/WalkAway/HandleKeyInvalid"
 /begin SUB_GROUP CentralLockingMaster_CLM_Main_sys_CentralLocking_ExternalControl_WalkAway_HandleKeyInvalid_CLM_SampleTi_P CentralLockingMaster_CLM_Main_sys_CentralLocking_ExternalControl_WalkAway_HandleKeyInvalid_Detect_Increase CentralLockingMaster_CLM_Main_sys_CentralLocking_ExternalControl_WalkAway_HandleKeyInvalid_EndFlgByKeyINIV_sys CentralLockingMaster_CLM_Main_sys_CentralLocking_ExternalControl_WalkAway_HandleKeyInvalid_IRIV CentralLockingMaster_CLM_Main_sys_CentralLocking_ExternalControl_WalkAway_HandleKeyInvalid_InitialValueJudge CentralLockingMaster_CLM_Main_sys_CentralLocking_ExternalControl_WalkAway_HandleKeyInvalid_N1 CentralLockingMaster_CLM_Main_sys_CentralLocking_ExternalControl_WalkAway_HandleKeyInvalid_ReTrigKeySearchINIV_sys CentralLockingMaster_CLM_Main_sys_CentralLocking_ExternalControl_WalkAway_HandleKeyInvalid_S_R_Flip_Flop CentralLockingMaster_CLM_Main_sys_CentralLocking_ExternalControl_WalkAway_HandleKeyInvalid_Timer_MaxTimeDetermin CentralLockingMaster_CLM_Main_sys_CentralLocking_ExternalControl_WalkAway_HandleKeyInvalid_TrigKeySearchByWalkAway_sys CentralLockingMaster_CLM_Main_sys_CentralLocking_ExternalControl_WalkAway_HandleKeyInvalid_UnitDelayRst CentralLockingMaster_CLM_Main_sys_CentralLocking_ExternalControl_WalkAway_HandleKeyInvalid_WalkKeyReserchCount_sys /end SUB_GROUP
 /begin REF_MEASUREMENT BCMFR_KeyFOBAuthenStatus /end REF_MEASUREMENT
/end GROUP
/begin GROUP CentralLockingMaster_CLM_Main_sys_CentralLocking_ExternalControl_WalkAway "CentralLockingMaster/CLM_Main_sys/CentralLocking/ExternalControl/WalkAway"
 /begin SUB_GROUP CentralLockingMaster_CLM_Main_sys_CentralLocking_ExternalControl_WalkAway_HandleKeyInvalid CentralLockingMaster_CLM_Main_sys_CentralLocking_ExternalControl_WalkAway_HandleKeyValid CentralLockingMaster_CLM_Main_sys_CentralLocking_ExternalControl_WalkAway_TranslateJudge CentralLockingMaster_CLM_Main_sys_CentralLocking_ExternalControl_WalkAway_WalkAwayFunctionSts_sys /end SUB_GROUP
/end GROUP
/begin GROUP CentralLockingMaster_CLM_Main_sys_CentralLocking_ExternalControl_PEButton_TurnOffDelay "CentralLockingMaster/CLM_Main_sys/CentralLocking/ExternalControl/PEButton/TurnOffDelay" /end GROUP
/begin GROUP CentralLockingMaster_CLM_Main_sys_CentralLocking_ExternalControl_PEButton_Detect_Rise_Positive3 "CentralLockingMaster/CLM_Main_sys/CentralLocking/ExternalControl/PEButton/Detect Rise\r\nPositive3" /end GROUP
/begin GROUP CentralLockingMaster_CLM_Main_sys_CentralLocking_ExternalControl_PEButton_Detect_Rise_Positive2 "CentralLockingMaster/CLM_Main_sys/CentralLocking/ExternalControl/PEButton/Detect Rise\r\nPositive2" /end GROUP
/begin GROUP CentralLockingMaster_CLM_Main_sys_CentralLocking_ExternalControl_PEButton_Detect_Rise_Positive1 "CentralLockingMaster/CLM_Main_sys/CentralLocking/ExternalControl/PEButton/Detect Rise\r\nPositive1" /end GROUP
/begin GROUP CentralLockingMaster_CLM_Main_sys_CentralLocking_ExternalControl_PEButton_CLM_SampleTi_P "CentralLockingMaster/CLM_Main_sys/CentralLocking/ExternalControl/PEButton/CLM_SampleTi_P" /begin REF_CHARACTERISTIC CLM_SampleTi_P /end REF_CHARACTERISTIC /end GROUP
/begin GROUP CentralLockingMaster_CLM_Main_sys_CentralLocking_ExternalControl_PEButton_CLM_PEDelayTd_P "CentralLockingMaster/CLM_Main_sys/CentralLocking/ExternalControl/PEButton/CLM_PEDelayTd_P" /begin REF_CHARACTERISTIC CLM_PEDelayTd_P /end REF_CHARACTERISTIC /end GROUP
/begin GROUP CentralLockingMaster_CLM_Main_sys_CentralLocking_ExternalControl_PEButton "CentralLockingMaster/CLM_Main_sys/CentralLocking/ExternalControl/PEButton"
 /begin SUB_GROUP CentralLockingMaster_CLM_Main_sys_CentralLocking_ExternalControl_PEButton_CLM_PEDelayTd_P CentralLockingMaster_CLM_Main_sys_CentralLocking_ExternalControl_PEButton_CLM_SampleTi_P CentralLockingMaster_CLM_Main_sys_CentralLocking_ExternalControl_PEButton_Detect_Rise_Positive1 CentralLockingMaster_CLM_Main_sys_CentralLocking_ExternalControl_PEButton_Detect_Rise_Positive2 CentralLockingMaster_CLM_Main_sys_CentralLocking_ExternalControl_PEButton_Detect_Rise_Positive3 CentralLockingMaster_CLM_Main_sys_CentralLocking_ExternalControl_PEButton_TurnOffDelay /end SUB_GROUP
 /begin REF_MEASUREMENT BCMFL_PassiveEntryButtonReq BCMFR_CentralLockLightStatus BCMFR_KeyFOBAuthenStatus BCMFR_KeyFOBPosition CVC_ACTGear TCM_VehicleOperationState /end REF_MEASUREMENT
/end GROUP
/begin GROUP CentralLockingMaster_CLM_Main_sys_CentralLocking_ExternalControl_MechanicalCtrl_RRDoorChangeJudge "CentralLockingMaster/CLM_Main_sys/CentralLocking/ExternalControl/MechanicalCtrl/RRDoorChangeJudge" /begin REF_MEASUREMENT BCMRE_DoorAjarStatusRR /end REF_MEASUREMENT /end GROUP
/begin GROUP CentralLockingMaster_CLM_Main_sys_CentralLocking_ExternalControl_MechanicalCtrl_RLDoorChangeJudge "CentralLockingMaster/CLM_Main_sys/CentralLocking/ExternalControl/MechanicalCtrl/RLDoorChangeJudge" /begin REF_MEASUREMENT BCMRE_DoorAjarStatusRL /end REF_MEASUREMENT /end GROUP
/begin GROUP CentralLockingMaster_CLM_Main_sys_CentralLocking_ExternalControl_MechanicalCtrl_PassDoorChangeJudge "CentralLockingMaster/CLM_Main_sys/CentralLocking/ExternalControl/MechanicalCtrl/PassDoorChangeJudge" /end GROUP
/begin GROUP CentralLockingMaster_CLM_Main_sys_CentralLocking_ExternalControl_MechanicalCtrl_DriverDoorChangeJudge "CentralLockingMaster/CLM_Main_sys/CentralLocking/ExternalControl/MechanicalCtrl/DriverDoorChangeJudge" /end GROUP
/begin GROUP CentralLockingMaster_CLM_Main_sys_CentralLocking_ExternalControl_MechanicalCtrl "CentralLockingMaster/CLM_Main_sys/CentralLocking/ExternalControl/MechanicalCtrl"
 /begin SUB_GROUP CentralLockingMaster_CLM_Main_sys_CentralLocking_ExternalControl_MechanicalCtrl_DriverDoorChangeJudge CentralLockingMaster_CLM_Main_sys_CentralLocking_ExternalControl_MechanicalCtrl_PassDoorChangeJudge CentralLockingMaster_CLM_Main_sys_CentralLocking_ExternalControl_MechanicalCtrl_RLDoorChangeJudge CentralLockingMaster_CLM_Main_sys_CentralLocking_ExternalControl_MechanicalCtrl_RRDoorChangeJudge /end SUB_GROUP
 /begin REF_MEASUREMENT TCM_VehicleOperationState /end REF_MEASUREMENT
/end GROUP
/begin GROUP CentralLockingMaster_CLM_Main_sys_CentralLocking_ExternalControl_LockUnlockFeedback_TurnOffDelay1 "CentralLockingMaster/CLM_Main_sys/CentralLocking/ExternalControl/LockUnlockFeedback/TurnOffDelay1" /end GROUP
/begin GROUP CentralLockingMaster_CLM_Main_sys_CentralLocking_ExternalControl_LockUnlockFeedback_TurnOffDelay "CentralLockingMaster/CLM_Main_sys/CentralLocking/ExternalControl/LockUnlockFeedback/TurnOffDelay" /end GROUP
/begin GROUP CentralLockingMaster_CLM_Main_sys_CentralLocking_ExternalControl_LockUnlockFeedback_Detect_Rise_Positive1 "CentralLockingMaster/CLM_Main_sys/CentralLocking/ExternalControl/LockUnlockFeedback/Detect Rise\r\nPositive1" /end GROUP
/begin GROUP CentralLockingMaster_CLM_Main_sys_CentralLocking_ExternalControl_LockUnlockFeedback_Detect_Rise_Positive "CentralLockingMaster/CLM_Main_sys/CentralLocking/ExternalControl/LockUnlockFeedback/Detect Rise\r\nPositive" /end GROUP
/begin GROUP CentralLockingMaster_CLM_Main_sys_CentralLocking_ExternalControl_LockUnlockFeedback_CLM_SampleTi_P1 "CentralLockingMaster/CLM_Main_sys/CentralLocking/ExternalControl/LockUnlockFeedback/CLM_SampleTi_P1" /begin REF_CHARACTERISTIC CLM_SampleTi_P /end REF_CHARACTERISTIC /end GROUP
/begin GROUP CentralLockingMaster_CLM_Main_sys_CentralLocking_ExternalControl_LockUnlockFeedback_CLM_SampleTi_P "CentralLockingMaster/CLM_Main_sys/CentralLocking/ExternalControl/LockUnlockFeedback/CLM_SampleTi_P" /begin REF_CHARACTERISTIC CLM_SampleTi_P /end REF_CHARACTERISTIC /end GROUP
/begin GROUP CentralLockingMaster_CLM_Main_sys_CentralLocking_ExternalControl_LockUnlockFeedback_CLM_ReminderDelayTd_P1 "CentralLockingMaster/CLM_Main_sys/CentralLocking/ExternalControl/LockUnlockFeedback/CLM_ReminderDelayTd_P1" /begin REF_CHARACTERISTIC CLM_ReminderDelayTd_P /end REF_CHARACTERISTIC /end GROUP
/begin GROUP CentralLockingMaster_CLM_Main_sys_CentralLocking_ExternalControl_LockUnlockFeedback_CLM_ReminderDelayTd_P "CentralLockingMaster/CLM_Main_sys/CentralLocking/ExternalControl/LockUnlockFeedback/CLM_ReminderDelayTd_P" /begin REF_CHARACTERISTIC CLM_ReminderDelayTd_P /end REF_CHARACTERISTIC /end GROUP
/begin GROUP CentralLockingMaster_CLM_Main_sys_CentralLocking_ExternalControl_LockUnlockFeedback "CentralLockingMaster/CLM_Main_sys/CentralLocking/ExternalControl/LockUnlockFeedback"
 /begin SUB_GROUP CentralLockingMaster_CLM_Main_sys_CentralLocking_ExternalControl_LockUnlockFeedback_CLM_ReminderDelayTd_P CentralLockingMaster_CLM_Main_sys_CentralLocking_ExternalControl_LockUnlockFeedback_CLM_ReminderDelayTd_P1 CentralLockingMaster_CLM_Main_sys_CentralLocking_ExternalControl_LockUnlockFeedback_CLM_SampleTi_P CentralLockingMaster_CLM_Main_sys_CentralLocking_ExternalControl_LockUnlockFeedback_CLM_SampleTi_P1 CentralLockingMaster_CLM_Main_sys_CentralLocking_ExternalControl_LockUnlockFeedback_Detect_Rise_Positive CentralLockingMaster_CLM_Main_sys_CentralLocking_ExternalControl_LockUnlockFeedback_Detect_Rise_Positive1 CentralLockingMaster_CLM_Main_sys_CentralLocking_ExternalControl_LockUnlockFeedback_TurnOffDelay CentralLockingMaster_CLM_Main_sys_CentralLocking_ExternalControl_LockUnlockFeedback_TurnOffDelay1 /end SUB_GROUP
/end GROUP
/begin GROUP CentralLockingMaster_CLM_Main_sys_CentralLocking_ExternalControl_KeyFob_Detect_Rise_Positive1 "CentralLockingMaster/CLM_Main_sys/CentralLocking/ExternalControl/KeyFob/Detect Rise\r\nPositive1" /end GROUP
/begin GROUP CentralLockingMaster_CLM_Main_sys_CentralLocking_ExternalControl_KeyFob_DetectRisePositive2 "CentralLockingMaster/CLM_Main_sys/CentralLocking/ExternalControl/KeyFob/DetectRisePositive2" /end GROUP
/begin GROUP CentralLockingMaster_CLM_Main_sys_CentralLocking_ExternalControl_KeyFob "CentralLockingMaster/CLM_Main_sys/CentralLocking/ExternalControl/KeyFob"
 /begin SUB_GROUP CentralLockingMaster_CLM_Main_sys_CentralLocking_ExternalControl_KeyFob_DetectRisePositive2 CentralLockingMaster_CLM_Main_sys_CentralLocking_ExternalControl_KeyFob_Detect_Rise_Positive1 /end SUB_GROUP
 /begin REF_MEASUREMENT BCMFR_KeyFOB_Request TCM_VehicleOperationState /end REF_MEASUREMENT
/end GROUP
/begin GROUP CentralLockingMaster_CLM_Main_sys_CentralLocking_ExternalControl_AutoRelock_Timer_MaxTimeDetermin "CentralLockingMaster/CLM_Main_sys/CentralLocking/ExternalControl/AutoRelock/Timer_MaxTimeDetermin" /end GROUP
/begin GROUP CentralLockingMaster_CLM_Main_sys_CentralLocking_ExternalControl_AutoRelock_S_R_Flip_Flop "CentralLockingMaster/CLM_Main_sys/CentralLocking/ExternalControl/AutoRelock/S-R\r\nFlip-Flop" /end GROUP
/begin GROUP CentralLockingMaster_CLM_Main_sys_CentralLocking_ExternalControl_AutoRelock_Detect_Rise_Positive1 "CentralLockingMaster/CLM_Main_sys/CentralLocking/ExternalControl/AutoRelock/Detect Rise\r\nPositive1" /end GROUP
/begin GROUP CentralLockingMaster_CLM_Main_sys_CentralLocking_ExternalControl_AutoRelock_Detect_Rise_Positive "CentralLockingMaster/CLM_Main_sys/CentralLocking/ExternalControl/AutoRelock/Detect Rise\r\nPositive" /end GROUP
/begin GROUP CentralLockingMaster_CLM_Main_sys_CentralLocking_ExternalControl_AutoRelock_Detect_Change "CentralLockingMaster/CLM_Main_sys/CentralLocking/ExternalControl/AutoRelock/Detect\r\nChange" /begin REF_MEASUREMENT TCM_VehicleOperationState /end REF_MEASUREMENT /end GROUP
/begin GROUP CentralLockingMaster_CLM_Main_sys_CentralLocking_ExternalControl_AutoRelock_CLM_SampleTi_P "CentralLockingMaster/CLM_Main_sys/CentralLocking/ExternalControl/AutoRelock/CLM_SampleTi_P" /begin REF_CHARACTERISTIC CLM_SampleTi_P /end REF_CHARACTERISTIC /end GROUP
/begin GROUP CentralLockingMaster_CLM_Main_sys_CentralLocking_ExternalControl_AutoRelock_CLM_IniTi_P "CentralLockingMaster/CLM_Main_sys/CentralLocking/ExternalControl/AutoRelock/CLM_IniTi_P" /begin REF_CHARACTERISTIC CLM_IniTi_P /end REF_CHARACTERISTIC /end GROUP
/begin GROUP CentralLockingMaster_CLM_Main_sys_CentralLocking_ExternalControl_AutoRelock_CLM_AutoRelockTime_P "CentralLockingMaster/CLM_Main_sys/CentralLocking/ExternalControl/AutoRelock/CLM_AutoRelockTime_P" /begin REF_CHARACTERISTIC CLM_AutoRelockTime_P /end REF_CHARACTERISTIC /end GROUP
/begin GROUP CentralLockingMaster_CLM_Main_sys_CentralLocking_ExternalControl_AutoRelock_CLM_AutoRelockCfg_P "CentralLockingMaster/CLM_Main_sys/CentralLocking/ExternalControl/AutoRelock/CLM_AutoRelockCfg_P" /begin REF_CHARACTERISTIC CLM_AutoRelockCfg_P /end REF_CHARACTERISTIC /end GROUP
/begin GROUP CentralLockingMaster_CLM_Main_sys_CentralLocking_ExternalControl_AutoRelock "CentralLockingMaster/CLM_Main_sys/CentralLocking/ExternalControl/AutoRelock"
 /begin SUB_GROUP CentralLockingMaster_CLM_Main_sys_CentralLocking_ExternalControl_AutoRelock_CLM_AutoRelockCfg_P CentralLockingMaster_CLM_Main_sys_CentralLocking_ExternalControl_AutoRelock_CLM_AutoRelockTime_P CentralLockingMaster_CLM_Main_sys_CentralLocking_ExternalControl_AutoRelock_CLM_IniTi_P CentralLockingMaster_CLM_Main_sys_CentralLocking_ExternalControl_AutoRelock_CLM_SampleTi_P CentralLockingMaster_CLM_Main_sys_CentralLocking_ExternalControl_AutoRelock_Detect_Change CentralLockingMaster_CLM_Main_sys_CentralLocking_ExternalControl_AutoRelock_Detect_Rise_Positive CentralLockingMaster_CLM_Main_sys_CentralLocking_ExternalControl_AutoRelock_Detect_Rise_Positive1 CentralLockingMaster_CLM_Main_sys_CentralLocking_ExternalControl_AutoRelock_S_R_Flip_Flop CentralLockingMaster_CLM_Main_sys_CentralLocking_ExternalControl_AutoRelock_Timer_MaxTimeDetermin /end SUB_GROUP
 /begin REF_MEASUREMENT TCM_VehicleOperationState /end REF_MEASUREMENT
/end GROUP
/begin GROUP CentralLockingMaster_CLM_Main_sys_CentralLocking_ExternalControl "CentralLockingMaster/CLM_Main_sys/CentralLocking/ExternalControl"
 /begin SUB_GROUP CentralLockingMaster_CLM_Main_sys_CentralLocking_ExternalControl_AutoRelock CentralLockingMaster_CLM_Main_sys_CentralLocking_ExternalControl_KeyFob CentralLockingMaster_CLM_Main_sys_CentralLocking_ExternalControl_LockUnlockFeedback CentralLockingMaster_CLM_Main_sys_CentralLocking_ExternalControl_MechanicalCtrl CentralLockingMaster_CLM_Main_sys_CentralLocking_ExternalControl_PEButton CentralLockingMaster_CLM_Main_sys_CentralLocking_ExternalControl_WalkAway /end SUB_GROUP
/end GROUP
/begin GROUP CentralLockingMaster_CLM_Main_sys_CentralLocking_DoorLockCtrl_PassDoorLockCtrl_CLM_DriverCfg_P "CentralLockingMaster/CLM_Main_sys/CentralLocking/DoorLockCtrl/PassDoorLockCtrl/CLM_DriverCfg_P" /begin REF_CHARACTERISTIC CLM_DriverCfg_P /end REF_CHARACTERISTIC /end GROUP
/begin GROUP CentralLockingMaster_CLM_Main_sys_CentralLocking_DoorLockCtrl_PassDoorLockCtrl "CentralLockingMaster/CLM_Main_sys/CentralLocking/DoorLockCtrl/PassDoorLockCtrl"
 /begin SUB_GROUP CentralLockingMaster_CLM_Main_sys_CentralLocking_DoorLockCtrl_PassDoorLockCtrl_CLM_DriverCfg_P /end SUB_GROUP
/end GROUP
/begin GROUP CentralLockingMaster_CLM_Main_sys_CentralLocking_DoorLockCtrl_LockControlAllocation_UnlockLockTypeTrigDelay_UnitDelayRst "CentralLockingMaster/CLM_Main_sys/CentralLocking/DoorLockCtrl/LockControlAllocation/UnlockLockTypeTrigDelay/UnitDelayRst" /end GROUP
/begin GROUP CentralLockingMaster_CLM_Main_sys_CentralLocking_DoorLockCtrl_LockControlAllocation_UnlockLockTypeTrigDelay_TurnOffDelay3 "CentralLockingMaster/CLM_Main_sys/CentralLocking/DoorLockCtrl/LockControlAllocation/UnlockLockTypeTrigDelay/TurnOffDelay3" /end GROUP
/begin GROUP CentralLockingMaster_CLM_Main_sys_CentralLocking_DoorLockCtrl_LockControlAllocation_UnlockLockTypeTrigDelay_Detect_Change "CentralLockingMaster/CLM_Main_sys/CentralLocking/DoorLockCtrl/LockControlAllocation/UnlockLockTypeTrigDelay/Detect\r\nChange" /end GROUP
/begin GROUP CentralLockingMaster_CLM_Main_sys_CentralLocking_DoorLockCtrl_LockControlAllocation_UnlockLockTypeTrigDelay_CLM_SampleTi_P3 "CentralLockingMaster/CLM_Main_sys/CentralLocking/DoorLockCtrl/LockControlAllocation/UnlockLockTypeTrigDelay/CLM_SampleTi_P3" /begin REF_CHARACTERISTIC CLM_SampleTi_P /end REF_CHARACTERISTIC /end GROUP
/begin GROUP CentralLockingMaster_CLM_Main_sys_CentralLocking_DoorLockCtrl_LockControlAllocation_UnlockLockTypeTrigDelay "CentralLockingMaster/CLM_Main_sys/CentralLocking/DoorLockCtrl/LockControlAllocation/UnlockLockTypeTrigDelay"
 /begin SUB_GROUP CentralLockingMaster_CLM_Main_sys_CentralLocking_DoorLockCtrl_LockControlAllocation_UnlockLockTypeTrigDelay_CLM_SampleTi_P3 CentralLockingMaster_CLM_Main_sys_CentralLocking_DoorLockCtrl_LockControlAllocation_UnlockLockTypeTrigDelay_Detect_Change CentralLockingMaster_CLM_Main_sys_CentralLocking_DoorLockCtrl_LockControlAllocation_UnlockLockTypeTrigDelay_TurnOffDelay3 CentralLockingMaster_CLM_Main_sys_CentralLocking_DoorLockCtrl_LockControlAllocation_UnlockLockTypeTrigDelay_UnitDelayRst /end SUB_GROUP
/end GROUP
/begin GROUP CentralLockingMaster_CLM_Main_sys_CentralLocking_DoorLockCtrl_LockControlAllocation_TurnOffDelay2 "CentralLockingMaster/CLM_Main_sys/CentralLocking/DoorLockCtrl/LockControlAllocation/TurnOffDelay2" /end GROUP
/begin GROUP CentralLockingMaster_CLM_Main_sys_CentralLocking_DoorLockCtrl_LockControlAllocation_TurnOffDelay1 "CentralLockingMaster/CLM_Main_sys/CentralLocking/DoorLockCtrl/LockControlAllocation/TurnOffDelay1" /end GROUP
/begin GROUP CentralLockingMaster_CLM_Main_sys_CentralLocking_DoorLockCtrl_LockControlAllocation_TurnOffDelay "CentralLockingMaster/CLM_Main_sys/CentralLocking/DoorLockCtrl/LockControlAllocation/TurnOffDelay" /end GROUP
/begin GROUP CentralLockingMaster_CLM_Main_sys_CentralLocking_DoorLockCtrl_LockControlAllocation_CLM_UnlockLockReqDelayTd_P2 "CentralLockingMaster/CLM_Main_sys/CentralLocking/DoorLockCtrl/LockControlAllocation/CLM_UnlockLockReqDelayTd_P2" /begin REF_CHARACTERISTIC CLM_UnlockLockReqDelayTd_P /end REF_CHARACTERISTIC /end GROUP
/begin GROUP CentralLockingMaster_CLM_Main_sys_CentralLocking_DoorLockCtrl_LockControlAllocation_CLM_UnlockLockReqDelayTd_P1 "CentralLockingMaster/CLM_Main_sys/CentralLocking/DoorLockCtrl/LockControlAllocation/CLM_UnlockLockReqDelayTd_P1" /begin REF_CHARACTERISTIC CLM_UnlockLockReqDelayTd_P /end REF_CHARACTERISTIC /end GROUP
/begin GROUP CentralLockingMaster_CLM_Main_sys_CentralLocking_DoorLockCtrl_LockControlAllocation_CLM_UnlockLockReqDelayTd_P "CentralLockingMaster/CLM_Main_sys/CentralLocking/DoorLockCtrl/LockControlAllocation/CLM_UnlockLockReqDelayTd_P" /begin REF_CHARACTERISTIC CLM_UnlockLockReqDelayTd_P /end REF_CHARACTERISTIC /end GROUP
/begin GROUP CentralLockingMaster_CLM_Main_sys_CentralLocking_DoorLockCtrl_LockControlAllocation_CLM_SampleTi_P2 "CentralLockingMaster/CLM_Main_sys/CentralLocking/DoorLockCtrl/LockControlAllocation/CLM_SampleTi_P2" /begin REF_CHARACTERISTIC CLM_SampleTi_P /end REF_CHARACTERISTIC /end GROUP
/begin GROUP CentralLockingMaster_CLM_Main_sys_CentralLocking_DoorLockCtrl_LockControlAllocation_CLM_SampleTi_P1 "CentralLockingMaster/CLM_Main_sys/CentralLocking/DoorLockCtrl/LockControlAllocation/CLM_SampleTi_P1" /begin REF_CHARACTERISTIC CLM_SampleTi_P /end REF_CHARACTERISTIC /end GROUP
/begin GROUP CentralLockingMaster_CLM_Main_sys_CentralLocking_DoorLockCtrl_LockControlAllocation_CLM_SampleTi_P "CentralLockingMaster/CLM_Main_sys/CentralLocking/DoorLockCtrl/LockControlAllocation/CLM_SampleTi_P" /begin REF_CHARACTERISTIC CLM_SampleTi_P /end REF_CHARACTERISTIC /end GROUP
/begin GROUP CentralLockingMaster_CLM_Main_sys_CentralLocking_DoorLockCtrl_LockControlAllocation "CentralLockingMaster/CLM_Main_sys/CentralLocking/DoorLockCtrl/LockControlAllocation"
 /begin SUB_GROUP CentralLockingMaster_CLM_Main_sys_CentralLocking_DoorLockCtrl_LockControlAllocation_CLM_SampleTi_P CentralLockingMaster_CLM_Main_sys_CentralLocking_DoorLockCtrl_LockControlAllocation_CLM_SampleTi_P1 CentralLockingMaster_CLM_Main_sys_CentralLocking_DoorLockCtrl_LockControlAllocation_CLM_SampleTi_P2 CentralLockingMaster_CLM_Main_sys_CentralLocking_DoorLockCtrl_LockControlAllocation_CLM_UnlockLockReqDelayTd_P CentralLockingMaster_CLM_Main_sys_CentralLocking_DoorLockCtrl_LockControlAllocation_CLM_UnlockLockReqDelayTd_P1 CentralLockingMaster_CLM_Main_sys_CentralLocking_DoorLockCtrl_LockControlAllocation_CLM_UnlockLockReqDelayTd_P2 CentralLockingMaster_CLM_Main_sys_CentralLocking_DoorLockCtrl_LockControlAllocation_TurnOffDelay CentralLockingMaster_CLM_Main_sys_CentralLocking_DoorLockCtrl_LockControlAllocation_TurnOffDelay1 CentralLockingMaster_CLM_Main_sys_CentralLocking_DoorLockCtrl_LockControlAllocation_TurnOffDelay2 CentralLockingMaster_CLM_Main_sys_CentralLocking_DoorLockCtrl_LockControlAllocation_UnlockLockTypeTrigDelay /end SUB_GROUP
 /begin REF_MEASUREMENT ACM_Crash_Sts /end REF_MEASUREMENT
/end GROUP
/begin GROUP CentralLockingMaster_CLM_Main_sys_CentralLocking_DoorLockCtrl_DrvDoorLockCtrl_CLM_DriverCfg_P "CentralLockingMaster/CLM_Main_sys/CentralLocking/DoorLockCtrl/DrvDoorLockCtrl/CLM_DriverCfg_P" /begin REF_CHARACTERISTIC CLM_DriverCfg_P /end REF_CHARACTERISTIC /end GROUP
/begin GROUP CentralLockingMaster_CLM_Main_sys_CentralLocking_DoorLockCtrl_DrvDoorLockCtrl "CentralLockingMaster/CLM_Main_sys/CentralLocking/DoorLockCtrl/DrvDoorLockCtrl"
 /begin SUB_GROUP CentralLockingMaster_CLM_Main_sys_CentralLocking_DoorLockCtrl_DrvDoorLockCtrl_CLM_DriverCfg_P /end SUB_GROUP
/end GROUP
/begin GROUP CentralLockingMaster_CLM_Main_sys_CentralLocking_DoorLockCtrl "CentralLockingMaster/CLM_Main_sys/CentralLocking/DoorLockCtrl"
 /begin SUB_GROUP CentralLockingMaster_CLM_Main_sys_CentralLocking_DoorLockCtrl_DrvDoorLockCtrl CentralLockingMaster_CLM_Main_sys_CentralLocking_DoorLockCtrl_LockControlAllocation CentralLockingMaster_CLM_Main_sys_CentralLocking_DoorLockCtrl_PassDoorLockCtrl /end SUB_GROUP
/end GROUP
/begin GROUP CentralLockingMaster_CLM_Main_sys_CentralLocking_DoorCtrl_DoorOpenWarning_CLM_VehMoveSpdThd_P "CentralLockingMaster/CLM_Main_sys/CentralLocking/DoorCtrl/DoorOpenWarning/CLM_VehMoveSpdThd_P" /begin REF_CHARACTERISTIC CLM_VehMoveSpdThd_P /end REF_CHARACTERISTIC /end GROUP
/begin GROUP CentralLockingMaster_CLM_Main_sys_CentralLocking_DoorCtrl_DoorOpenWarning_CLM_DoorOpenWarnCfg_P "CentralLockingMaster/CLM_Main_sys/CentralLocking/DoorCtrl/DoorOpenWarning/CLM_DoorOpenWarnCfg_P" /begin REF_CHARACTERISTIC CLM_DoorOpenWarnCfg_P /end REF_CHARACTERISTIC /end GROUP
/begin GROUP CentralLockingMaster_CLM_Main_sys_CentralLocking_DoorCtrl_DoorOpenWarning "CentralLockingMaster/CLM_Main_sys/CentralLocking/DoorCtrl/DoorOpenWarning"
 /begin SUB_GROUP CentralLockingMaster_CLM_Main_sys_CentralLocking_DoorCtrl_DoorOpenWarning_CLM_DoorOpenWarnCfg_P CentralLockingMaster_CLM_Main_sys_CentralLocking_DoorCtrl_DoorOpenWarning_CLM_VehMoveSpdThd_P /end SUB_GROUP
 /begin REF_MEASUREMENT IDB_VehicleSpd TCM_VehicleOperationState /end REF_MEASUREMENT
/end GROUP
/begin GROUP CentralLockingMaster_CLM_Main_sys_CentralLocking_DoorCtrl_DoorCtrl_RearDoorControl_TurnOffDelay4 "CentralLockingMaster/CLM_Main_sys/CentralLocking/DoorCtrl/DoorCtrl/RearDoorControl/TurnOffDelay4" /end GROUP
/begin GROUP CentralLockingMaster_CLM_Main_sys_CentralLocking_DoorCtrl_DoorCtrl_RearDoorControl_TurnOffDelay3 "CentralLockingMaster/CLM_Main_sys/CentralLocking/DoorCtrl/DoorCtrl/RearDoorControl/TurnOffDelay3" /end GROUP
/begin GROUP CentralLockingMaster_CLM_Main_sys_CentralLocking_DoorCtrl_DoorCtrl_RearDoorControl_Detect_Rise_Positive3 "CentralLockingMaster/CLM_Main_sys/CentralLocking/DoorCtrl/DoorCtrl/RearDoorControl/Detect Rise\r\nPositive3" /end GROUP
/begin GROUP CentralLockingMaster_CLM_Main_sys_CentralLocking_DoorCtrl_DoorCtrl_RearDoorControl_Detect_Rise_Positive2 "CentralLockingMaster/CLM_Main_sys/CentralLocking/DoorCtrl/DoorCtrl/RearDoorControl/Detect Rise\r\nPositive2" /end GROUP
/begin GROUP CentralLockingMaster_CLM_Main_sys_CentralLocking_DoorCtrl_DoorCtrl_RearDoorControl_CLM_SampleTi_P4 "CentralLockingMaster/CLM_Main_sys/CentralLocking/DoorCtrl/DoorCtrl/RearDoorControl/CLM_SampleTi_P4" /begin REF_CHARACTERISTIC CLM_SampleTi_P /end REF_CHARACTERISTIC /end GROUP
/begin GROUP CentralLockingMaster_CLM_Main_sys_CentralLocking_DoorCtrl_DoorCtrl_RearDoorControl_CLM_SampleTi_P3 "CentralLockingMaster/CLM_Main_sys/CentralLocking/DoorCtrl/DoorCtrl/RearDoorControl/CLM_SampleTi_P3" /begin REF_CHARACTERISTIC CLM_SampleTi_P /end REF_CHARACTERISTIC /end GROUP
/begin GROUP CentralLockingMaster_CLM_Main_sys_CentralLocking_DoorCtrl_DoorCtrl_RearDoorControl_CLM_DoorOpenReqDelayTd_P1 "CentralLockingMaster/CLM_Main_sys/CentralLocking/DoorCtrl/DoorCtrl/RearDoorControl/CLM_DoorOpenReqDelayTd_P1" /begin REF_CHARACTERISTIC CLM_DoorOpenReqDelayTd_P /end REF_CHARACTERISTIC /end GROUP
/begin GROUP CentralLockingMaster_CLM_Main_sys_CentralLocking_DoorCtrl_DoorCtrl_RearDoorControl_CLM_DoorOpenReqDelayTd_P "CentralLockingMaster/CLM_Main_sys/CentralLocking/DoorCtrl/DoorCtrl/RearDoorControl/CLM_DoorOpenReqDelayTd_P" /begin REF_CHARACTERISTIC CLM_DoorOpenReqDelayTd_P /end REF_CHARACTERISTIC /end GROUP
/begin GROUP CentralLockingMaster_CLM_Main_sys_CentralLocking_DoorCtrl_DoorCtrl_RearDoorControl_CLM_DisaRelsCfg_P3 "CentralLockingMaster/CLM_Main_sys/CentralLocking/DoorCtrl/DoorCtrl/RearDoorControl/CLM_DisaRelsCfg_P3" /begin REF_CHARACTERISTIC CLM_DisaRelsCfg_P /end REF_CHARACTERISTIC /end GROUP
/begin GROUP CentralLockingMaster_CLM_Main_sys_CentralLocking_DoorCtrl_DoorCtrl_RearDoorControl_CLM_DisaRelsCfg_P2 "CentralLockingMaster/CLM_Main_sys/CentralLocking/DoorCtrl/DoorCtrl/RearDoorControl/CLM_DisaRelsCfg_P2" /begin REF_CHARACTERISTIC CLM_DisaRelsCfg_P /end REF_CHARACTERISTIC /end GROUP
/begin GROUP CentralLockingMaster_CLM_Main_sys_CentralLocking_DoorCtrl_DoorCtrl_RearDoorControl "CentralLockingMaster/CLM_Main_sys/CentralLocking/DoorCtrl/DoorCtrl/RearDoorControl"
 /begin SUB_GROUP CentralLockingMaster_CLM_Main_sys_CentralLocking_DoorCtrl_DoorCtrl_RearDoorControl_CLM_DisaRelsCfg_P2 CentralLockingMaster_CLM_Main_sys_CentralLocking_DoorCtrl_DoorCtrl_RearDoorControl_CLM_DisaRelsCfg_P3 CentralLockingMaster_CLM_Main_sys_CentralLocking_DoorCtrl_DoorCtrl_RearDoorControl_CLM_DoorOpenReqDelayTd_P CentralLockingMaster_CLM_Main_sys_CentralLocking_DoorCtrl_DoorCtrl_RearDoorControl_CLM_DoorOpenReqDelayTd_P1 CentralLockingMaster_CLM_Main_sys_CentralLocking_DoorCtrl_DoorCtrl_RearDoorControl_CLM_SampleTi_P3 CentralLockingMaster_CLM_Main_sys_CentralLocking_DoorCtrl_DoorCtrl_RearDoorControl_CLM_SampleTi_P4 CentralLockingMaster_CLM_Main_sys_CentralLocking_DoorCtrl_DoorCtrl_RearDoorControl_Detect_Rise_Positive2 CentralLockingMaster_CLM_Main_sys_CentralLocking_DoorCtrl_DoorCtrl_RearDoorControl_Detect_Rise_Positive3 CentralLockingMaster_CLM_Main_sys_CentralLocking_DoorCtrl_DoorCtrl_RearDoorControl_TurnOffDelay3 CentralLockingMaster_CLM_Main_sys_CentralLocking_DoorCtrl_DoorCtrl_RearDoorControl_TurnOffDelay4 /end SUB_GROUP
 /begin REF_MEASUREMENT ACM_Crash_Sts BCMRE_DoorLockStatusRL BCMRE_DoorLockStatusRR BCMRE_DoorRLRelsButtonPress BCMRE_DoorRRRelsButtonPress CPD_WarningFlag4 TCM_VehicleOperationState /end REF_MEASUREMENT
/end GROUP
/begin GROUP CentralLockingMaster_CLM_Main_sys_CentralLocking_DoorCtrl_DoorCtrl_FrontDoorControl_TurnOffDelay2 "CentralLockingMaster/CLM_Main_sys/CentralLocking/DoorCtrl/DoorCtrl/FrontDoorControl/TurnOffDelay2" /end GROUP
/begin GROUP CentralLockingMaster_CLM_Main_sys_CentralLocking_DoorCtrl_DoorCtrl_FrontDoorControl_TurnOffDelay1 "CentralLockingMaster/CLM_Main_sys/CentralLocking/DoorCtrl/DoorCtrl/FrontDoorControl/TurnOffDelay1" /end GROUP
/begin GROUP CentralLockingMaster_CLM_Main_sys_CentralLocking_DoorCtrl_DoorCtrl_FrontDoorControl_Detect_Rise_Positive1 "CentralLockingMaster/CLM_Main_sys/CentralLocking/DoorCtrl/DoorCtrl/FrontDoorControl/Detect Rise\r\nPositive1" /end GROUP
/begin GROUP CentralLockingMaster_CLM_Main_sys_CentralLocking_DoorCtrl_DoorCtrl_FrontDoorControl_Detect_Rise_Positive "CentralLockingMaster/CLM_Main_sys/CentralLocking/DoorCtrl/DoorCtrl/FrontDoorControl/Detect Rise\r\nPositive" /end GROUP
/begin GROUP CentralLockingMaster_CLM_Main_sys_CentralLocking_DoorCtrl_DoorCtrl_FrontDoorControl_CLM_SampleTi_P2 "CentralLockingMaster/CLM_Main_sys/CentralLocking/DoorCtrl/DoorCtrl/FrontDoorControl/CLM_SampleTi_P2" /begin REF_CHARACTERISTIC CLM_SampleTi_P /end REF_CHARACTERISTIC /end GROUP
/begin GROUP CentralLockingMaster_CLM_Main_sys_CentralLocking_DoorCtrl_DoorCtrl_FrontDoorControl_CLM_SampleTi_P1 "CentralLockingMaster/CLM_Main_sys/CentralLocking/DoorCtrl/DoorCtrl/FrontDoorControl/CLM_SampleTi_P1" /begin REF_CHARACTERISTIC CLM_SampleTi_P /end REF_CHARACTERISTIC /end GROUP
/begin GROUP CentralLockingMaster_CLM_Main_sys_CentralLocking_DoorCtrl_DoorCtrl_FrontDoorControl_CLM_DoorOpenReqDelayTd_P1 "CentralLockingMaster/CLM_Main_sys/CentralLocking/DoorCtrl/DoorCtrl/FrontDoorControl/CLM_DoorOpenReqDelayTd_P1" /begin REF_CHARACTERISTIC CLM_DoorOpenReqDelayTd_P /end REF_CHARACTERISTIC /end GROUP
/begin GROUP CentralLockingMaster_CLM_Main_sys_CentralLocking_DoorCtrl_DoorCtrl_FrontDoorControl_CLM_DoorOpenReqDelayTd_P "CentralLockingMaster/CLM_Main_sys/CentralLocking/DoorCtrl/DoorCtrl/FrontDoorControl/CLM_DoorOpenReqDelayTd_P" /begin REF_CHARACTERISTIC CLM_DoorOpenReqDelayTd_P /end REF_CHARACTERISTIC /end GROUP
/begin GROUP CentralLockingMaster_CLM_Main_sys_CentralLocking_DoorCtrl_DoorCtrl_FrontDoorControl_CLM_DisaRelsCfg_P1 "CentralLockingMaster/CLM_Main_sys/CentralLocking/DoorCtrl/DoorCtrl/FrontDoorControl/CLM_DisaRelsCfg_P1" /begin REF_CHARACTERISTIC CLM_DisaRelsCfg_P /end REF_CHARACTERISTIC /end GROUP
/begin GROUP CentralLockingMaster_CLM_Main_sys_CentralLocking_DoorCtrl_DoorCtrl_FrontDoorControl_CLM_DisaRelsCfg_P "CentralLockingMaster/CLM_Main_sys/CentralLocking/DoorCtrl/DoorCtrl/FrontDoorControl/CLM_DisaRelsCfg_P" /begin REF_CHARACTERISTIC CLM_DisaRelsCfg_P /end REF_CHARACTERISTIC /end GROUP
/begin GROUP CentralLockingMaster_CLM_Main_sys_CentralLocking_DoorCtrl_DoorCtrl_FrontDoorControl "CentralLockingMaster/CLM_Main_sys/CentralLocking/DoorCtrl/DoorCtrl/FrontDoorControl"
 /begin SUB_GROUP CentralLockingMaster_CLM_Main_sys_CentralLocking_DoorCtrl_DoorCtrl_FrontDoorControl_CLM_DisaRelsCfg_P CentralLockingMaster_CLM_Main_sys_CentralLocking_DoorCtrl_DoorCtrl_FrontDoorControl_CLM_DisaRelsCfg_P1 CentralLockingMaster_CLM_Main_sys_CentralLocking_DoorCtrl_DoorCtrl_FrontDoorControl_CLM_DoorOpenReqDelayTd_P CentralLockingMaster_CLM_Main_sys_CentralLocking_DoorCtrl_DoorCtrl_FrontDoorControl_CLM_DoorOpenReqDelayTd_P1 CentralLockingMaster_CLM_Main_sys_CentralLocking_DoorCtrl_DoorCtrl_FrontDoorControl_CLM_SampleTi_P1 CentralLockingMaster_CLM_Main_sys_CentralLocking_DoorCtrl_DoorCtrl_FrontDoorControl_CLM_SampleTi_P2 CentralLockingMaster_CLM_Main_sys_CentralLocking_DoorCtrl_DoorCtrl_FrontDoorControl_Detect_Rise_Positive CentralLockingMaster_CLM_Main_sys_CentralLocking_DoorCtrl_DoorCtrl_FrontDoorControl_Detect_Rise_Positive1 CentralLockingMaster_CLM_Main_sys_CentralLocking_DoorCtrl_DoorCtrl_FrontDoorControl_TurnOffDelay1 CentralLockingMaster_CLM_Main_sys_CentralLocking_DoorCtrl_DoorCtrl_FrontDoorControl_TurnOffDelay2 /end SUB_GROUP
 /begin REF_MEASUREMENT BCMFL_DoorFLRelsButtonPress BCMFL_DoorLockStatusFL BCMFR_DoorFRRelsButtonPress BCMFR_DoorLockStatusFR /end REF_MEASUREMENT
/end GROUP
/begin GROUP CentralLockingMaster_CLM_Main_sys_CentralLocking_DoorCtrl_DoorCtrl "CentralLockingMaster/CLM_Main_sys/CentralLocking/DoorCtrl/DoorCtrl"
 /begin SUB_GROUP CentralLockingMaster_CLM_Main_sys_CentralLocking_DoorCtrl_DoorCtrl_FrontDoorControl CentralLockingMaster_CLM_Main_sys_CentralLocking_DoorCtrl_DoorCtrl_RearDoorControl /end SUB_GROUP
/end GROUP
/begin GROUP CentralLockingMaster_CLM_Main_sys_CentralLocking_DoorCtrl "CentralLockingMaster/CLM_Main_sys/CentralLocking/DoorCtrl"
 /begin SUB_GROUP CentralLockingMaster_CLM_Main_sys_CentralLocking_DoorCtrl_DoorCtrl CentralLockingMaster_CLM_Main_sys_CentralLocking_DoorCtrl_DoorOpenWarning /end SUB_GROUP
/end GROUP
/begin GROUP CentralLockingMaster_CLM_Main_sys_CentralLocking "CentralLockingMaster/CLM_Main_sys/CentralLocking"
 /begin SUB_GROUP CentralLockingMaster_CLM_Main_sys_CentralLocking_DoorCtrl CentralLockingMaster_CLM_Main_sys_CentralLocking_DoorLockCtrl CentralLockingMaster_CLM_Main_sys_CentralLocking_ExternalControl CentralLockingMaster_CLM_Main_sys_CentralLocking_InternalControl CentralLockingMaster_CLM_Main_sys_CentralLocking_KeyFobSearch CentralLockingMaster_CLM_Main_sys_CentralLocking_SettgStore CentralLockingMaster_CLM_Main_sys_CentralLocking_StatusJudge /end SUB_GROUP
/end GROUP
/begin GROUP CentralLockingMaster_CLM_Main_sys "CentralLockingMaster/CLM_Main_sys" /begin SUB_GROUP CentralLockingMaster_CLM_Main_sys_CentralLocking /end SUB_GROUP /end GROUP
/begin GROUP CentralLockingMaster "CentralLockingMaster" ROOT /begin SUB_GROUP CentralLockingMaster_CLM_Main_sys /end SUB_GROUP
 /begin REF_MEASUREMENT ACM_Crash_Sts ACM_DriverSeatBeltStatus ATA_KeyFOBSearchReq BCMFL_BonnetAjarStatus BCMFL_DoorAjarStatusFL BCMFL_DoorFLRelsButtonPress BCMFL_DoorLockStatusFL BCMFL_PassiveEntryButtonReq BCMFR_CentralLockLightStatus BCMFR_CentralLockingButton BCMFR_DoorAjarStatusFR BCMFR_DoorFRRelsButtonPress BCMFR_DoorLockStatusFR BCMFR_KeyFOBAuthenStatus BCMFR_KeyFOBPosition BCMFR_KeyFOB_Request BCMRE_DoorAjarStatusRL BCMRE_DoorAjarStatusRR BCMRE_DoorLockStatusRL BCMRE_DoorLockStatusRR BCMRE_DoorRLRelsButtonPress BCMRE_DoorRRRelsButtonPress BCMRE_TailgateAjarStatus CLM_ChildLockSet CLM_DoorFLLockReq CLM_DoorFLOpenReq CLM_DoorFRLockReq CLM_DoorFROpenReq CLM_DoorOpenWarningSet CLM_DoorRLLockReq CLM_DoorRLOpenReq CLM_DoorRRLockReq CLM_DoorRROpenReq CLM_DoorSpdSensingLock CLM_DoorUnlockOption CLM_KeyFOBSearchReq CLM_Nv_ChildModeSet CLM_Nv_DoorUnlockOptionSet CLM_Nv_FeedbackSignalsSet CLM_Nv_ParkUnlockSet CLM_Nv_SpeedLockSet CLM_Nv_WalkAwayLockSet CLM_UserSettingAutoUnlock CLM_UserSettingFeedback CPD_WarningFlag4 CVC_ACTGear IDB_BrakingSensorStatus IDB_VehicleSpd IMMO_KeyFOBSearchReq Nv_ChildModeSet Nv_DoorUnlockOptionSet Nv_FeedbackSignalsSet Nv_ParkUnlockSet Nv_SpeedLockSet Nv_WalkAwayLockSet S2S_ChildModeSet S2S_DoorUnlockOptionSet S2S_FeedbackSignalsSet S2S_ParkUnlockSet S2S_SpeedLockSet S2S_WalkAwayLockSet TCM_VehicleOperationState /end REF_MEASUREMENT
/end GROUP
/begin MEASUREMENT ACM_Crash_Sts "" UBYTE CM_uint8 0 0 0 255 ECU_ADDRESS 0x3434CA38 /* @ECU_Address@ACM_Crash_Sts@ */ /end MEASUREMENT
/begin MEASUREMENT ELM_WelcomeLightStatus "" UBYTE CM_uint8 0 0 0 255 ECU_ADDRESS 0x3434C9F7 /* @ECU_Address@ELM_WelcomeLightStatus@ */ /end MEASUREMENT
/begin MEASUREMENT ELM_RightReverseLampRequest "" UBYTE CM_uint8 0 0 0 255 ECU_ADDRESS 0x3434C9F8 /* @ECU_Address@ELM_RightReverseLampRequest@ */ /end MEASUREMENT
/begin MEASUREMENT ELM_RightBrakeLightRequest "" UBYTE CM_uint8 0 0 0 255 ECU_ADDRESS 0x3434C9F9 /* @ECU_Address@ELM_RightBrakeLightRequest@ */ /end MEASUREMENT
/begin MEASUREMENT ELM_RegenerativeBrakeLightSts "" UBYTE CM_uint8 0 0 0 255 ECU_ADDRESS 0x3434C9BC /* @ECU_Address@ELM_RegenerativeBrakeLightSts@ */ /end MEASUREMENT
/begin MEASUREMENT ELM_RearFogLightStatus "" UBYTE CM_uint8 0 0 0 255 ECU_ADDRESS 0x3434C9FA /* @ECU_Address@ELM_RearFogLightStatus@ */ /end MEASUREMENT
/begin MEASUREMENT ELM_RRTurnIndicatorRequest "" UBYTE CM_uint8 0 0 0 255 ECU_ADDRESS 0x3434C9FB /* @ECU_Address@ELM_RRTurnIndicatorRequest@ */ /end MEASUREMENT
/begin MEASUREMENT ELM_RRPosLightRequest "" UBYTE CM_uint8 0 0 0 255 ECU_ADDRESS 0x3434C9FC /* @ECU_Address@ELM_RRPosLightRequest@ */ /end MEASUREMENT
/begin MEASUREMENT ELM_RRFogLightRequest "" UBYTE CM_uint8 0 0 0 255 ECU_ADDRESS 0x3434C9FD /* @ECU_Address@ELM_RRFogLightRequest@ */ /end MEASUREMENT
/begin MEASUREMENT ELM_RLTurnIndicatorRequest "" UBYTE CM_uint8 0 0 0 255 ECU_ADDRESS 0x3434C9FE /* @ECU_Address@ELM_RLTurnIndicatorRequest@ */ /end MEASUREMENT
/begin MEASUREMENT ELM_RLPosLightRequest "" UBYTE CM_uint8 0 0 0 255 ECU_ADDRESS 0x3434C9FF /* @ECU_Address@ELM_RLPosLightRequest@ */ /end MEASUREMENT
/begin MEASUREMENT ELM_RLFogLightRequest "" UBYTE CM_uint8 0 0 0 255 ECU_ADDRESS 0x3434CA00 /* @ECU_Address@ELM_RLFogLightRequest@ */ /end MEASUREMENT
/begin MEASUREMENT ELM_Nv_WelcomeLightSet "" UBYTE CM_uint8 0 0 0 255 ECU_ADDRESS 0x3434CBA8 /* @ECU_Address@ELM_Nv_WelcomeLightSet@ */ /end MEASUREMENT
/begin MEASUREMENT ELM_Nv_RearFogLightSet "" UBYTE CM_uint8 0 0 0 255 ECU_ADDRESS 0x3434CBA7 /* @ECU_Address@ELM_Nv_RearFogLightSet@ */ /end MEASUREMENT
/begin MEASUREMENT ELM_Nv_FrontFogLightSet "" UBYTE CM_uint8 0 0 0 255 ECU_ADDRESS 0x3434CBA6 /* @ECU_Address@ELM_Nv_FrontFogLightSet@ */ /end MEASUREMENT
/begin MEASUREMENT ELM_Nv_FMHSet "" UBYTE CM_uint8 0 0 0 255 ECU_ADDRESS 0x3434CBA5 /* @ECU_Address@ELM_Nv_FMHSet@ */ /end MEASUREMENT
/begin MEASUREMENT ELM_Nv_ExteriorLightSet "" UBYTE CM_uint8 0 0 0 255 ECU_ADDRESS 0x3434CBA4 /* @ECU_Address@ELM_Nv_ExteriorLightSet@ */ /end MEASUREMENT
/begin MEASUREMENT ELM_LicensePlateLampRequest "" UBYTE CM_uint8 0 0 0 255 ECU_ADDRESS 0x3434CA01 /* @ECU_Address@ELM_LicensePlateLampRequest@ */ /end MEASUREMENT
/begin MEASUREMENT ELM_LeftReverseLampRequest "" UBYTE CM_uint8 0 0 0 255 ECU_ADDRESS 0x3434CA02 /* @ECU_Address@ELM_LeftReverseLampRequest@ */ /end MEASUREMENT
/begin MEASUREMENT ELM_LeftBrakeLightRequest "" UBYTE CM_uint8 0 0 0 255 ECU_ADDRESS 0x3434CA03 /* @ECU_Address@ELM_LeftBrakeLightRequest@ */ /end MEASUREMENT
/begin MEASUREMENT ELM_IndicatorLightMode "" UBYTE CM_uint8 0 0 0 255 ECU_ADDRESS 0x3434CA04 /* @ECU_Address@ELM_IndicatorLightMode@ */ /end MEASUREMENT
/begin MEASUREMENT ELM_FrontFogLightStatus "" UBYTE CM_uint8 0 0 0 255 ECU_ADDRESS 0x3434CA05 /* @ECU_Address@ELM_FrontFogLightStatus@ */ /end MEASUREMENT
/begin MEASUREMENT ELM_FRTurnIndicatorRequest "" UBYTE CM_uint8 0 0 0 255 ECU_ADDRESS 0x3434CA06 /* @ECU_Address@ELM_FRTurnIndicatorRequest@ */ /end MEASUREMENT
/begin MEASUREMENT ELM_FRPosLightRequest "" UBYTE CM_uint8 0 0 0 255 ECU_ADDRESS 0x3434CA07 /* @ECU_Address@ELM_FRPosLightRequest@ */ /end MEASUREMENT
/begin MEASUREMENT ELM_FRMirrorLEDRequest "" UBYTE CM_uint8 0 0 0 255 ECU_ADDRESS 0x3434CA08 /* @ECU_Address@ELM_FRMirrorLEDRequest@ */ /end MEASUREMENT
/begin MEASUREMENT ELM_FRLowBeamRequest "" UBYTE CM_uint8 0 0 0 255 ECU_ADDRESS 0x3434CA09 /* @ECU_Address@ELM_FRLowBeamRequest@ */ /end MEASUREMENT
/begin MEASUREMENT ELM_FRHighBeamRequest "" UBYTE CM_uint8 0 0 0 255 ECU_ADDRESS 0x3434CA0A /* @ECU_Address@ELM_FRHighBeamRequest@ */ /end MEASUREMENT
/begin MEASUREMENT ELM_FRFogLightRequest "" UBYTE CM_uint8 0 0 0 255 ECU_ADDRESS 0x3434CA0B /* @ECU_Address@ELM_FRFogLightRequest@ */ /end MEASUREMENT
/begin MEASUREMENT ELM_FRDRLRequest "" UBYTE CM_uint8 0 0 0 255 ECU_ADDRESS 0x3434CA0C /* @ECU_Address@ELM_FRDRLRequest@ */ /end MEASUREMENT
/begin MEASUREMENT ELM_FRAHLTargetPosition "" UWORD CM_uint16 0 0 0 65535 ECU_ADDRESS 0x3434CAB6 /* @ECU_Address@ELM_FRAHLTargetPosition@ */ /end MEASUREMENT
/begin MEASUREMENT ELM_FMHStatus "" UBYTE CM_uint8 0 0 0 255 ECU_ADDRESS 0x3434CA0E /* @ECU_Address@ELM_FMHStatus@ */ /end MEASUREMENT
/begin MEASUREMENT ELM_FLTurnIndicatorRequest "" UBYTE CM_uint8 0 0 0 255 ECU_ADDRESS 0x3434CA0F /* @ECU_Address@ELM_FLTurnIndicatorRequest@ */ /end MEASUREMENT
/begin MEASUREMENT ELM_FLPosLightRequest "" UBYTE CM_uint8 0 0 0 255 ECU_ADDRESS 0x3434CA10 /* @ECU_Address@ELM_FLPosLightRequest@ */ /end MEASUREMENT
/begin MEASUREMENT ELM_FLMirrorLEDRequest "" UBYTE CM_uint8 0 0 0 255 ECU_ADDRESS 0x3434CA11 /* @ECU_Address@ELM_FLMirrorLEDRequest@ */ /end MEASUREMENT
/begin MEASUREMENT ELM_FLLowBeamRequest "" UBYTE CM_uint8 0 0 0 255 ECU_ADDRESS 0x3434CA12 /* @ECU_Address@ELM_FLLowBeamRequest@ */ /end MEASUREMENT
/begin MEASUREMENT ELM_FLHighBeamRequest "" UBYTE CM_uint8 0 0 0 255 ECU_ADDRESS 0x3434CA13 /* @ECU_Address@ELM_FLHighBeamRequest@ */ /end MEASUREMENT
/begin MEASUREMENT ELM_FLFogLightRequest "" UBYTE CM_uint8 0 0 0 255 ECU_ADDRESS 0x3434CA14 /* @ECU_Address@ELM_FLFogLightRequest@ */ /end MEASUREMENT
/begin MEASUREMENT ELM_FLDRLRequest "" UBYTE CM_uint8 0 0 0 255 ECU_ADDRESS 0x3434CA15 /* @ECU_Address@ELM_FLDRLRequest@ */ /end MEASUREMENT
/begin MEASUREMENT ELM_FLAHLTargetPosition "" UWORD CM_uint16 0 0 0 65535 ECU_ADDRESS 0x3434CAB4 /* @ECU_Address@ELM_FLAHLTargetPosition@ */ /end MEASUREMENT
/begin MEASUREMENT ELM_ExteriorLightStatus "" UBYTE CM_uint8 0 0 0 255 ECU_ADDRESS 0x3434CA17 /* @ECU_Address@ELM_ExteriorLightStatus@ */ /end MEASUREMENT
/begin MEASUREMENT ELM_CMBrakeLightRequest "" UBYTE CM_uint8 0 0 0 255 ECU_ADDRESS 0x3434CA18 /* @ECU_Address@ELM_CMBrakeLightRequest@ */ /end MEASUREMENT
/begin MEASUREMENT ELM_AHLWorkingMode "" UBYTE CM_uint8 0 0 0 255 ECU_ADDRESS 0x3434CA19 /* @ECU_Address@ELM_AHLWorkingMode@ */ /end MEASUREMENT
/begin MEASUREMENT ELM_AHLPitchAngle "" FLOAT32_IEEE CM_single 0 0 -3.4E+38 3.4E+38 ECU_ADDRESS 0x3434CB0C /* @ECU_Address@ELM_AHLPitchAngle@ */ /end MEASUREMENT
/begin MEASUREMENT ELM_AHBStatus "" UBYTE CM_uint8 0 0 0 255 ECU_ADDRESS 0x3434CBA3 /* @ECU_Address@ELM_AHBStatus@ */ /end MEASUREMENT
/begin MEASUREMENT ELM_AHBRightHBStatus "" UBYTE CM_uint8 0 0 0 255 ECU_ADDRESS 0x3434CBA2 /* @ECU_Address@ELM_AHBRightHBStatus@ */ /end MEASUREMENT
/begin MEASUREMENT ELM_AHBOverrideSts "" UBYTE CM_uint8 0 0 0 255 ECU_ADDRESS 0x3434CBA1 /* @ECU_Address@ELM_AHBOverrideSts@ */ /end MEASUREMENT
/begin MEASUREMENT ELM_AHBLeftHBStatus "" UBYTE CM_uint8 0 0 0 255 ECU_ADDRESS 0x3434CBA0 /* @ECU_Address@ELM_AHBLeftHBStatus@ */ /end MEASUREMENT
/begin MEASUREMENT ELM_AHBIcon "" UBYTE CM_uint8 0 0 0 255 ECU_ADDRESS 0x3434CA1B /* @ECU_Address@ELM_AHBIcon@ */ /end MEASUREMENT
/begin MEASUREMENT COM_FRMirrorLEDSts "" UBYTE CM_uint8 0 0 0 255 ECU_ADDRESS 0x3434CA9F /* @ECU_Address@COM_FRMirrorLEDSts@ */ /end MEASUREMENT
/begin MEASUREMENT COM_FLMirrorLEDSts "" UBYTE CM_uint8 0 0 0 255 ECU_ADDRESS 0x3434CAA0 /* @ECU_Address@COM_FLMirrorLEDSts@ */ /end MEASUREMENT
/begin MEASUREMENT CLM_LampONReminder "" UBYTE CM_uint8 0 0 0 255 ECU_ADDRESS 0x3434CB67 /* @ECU_Address@CLM_LampONReminder@ */ /end MEASUREMENT
/begin MEASUREMENT WalkKeyReserchCount "" FLOAT32_IEEE CM_single 0 0 -3.4E+38 3.4E+38 ECU_ADDRESS 0x3434C778 /* @ECU_Address@WalkKeyReserchCount@ */ /end MEASUREMENT
/begin MEASUREMENT WalkAwayFunctionTrigger "" UBYTE CM_boolean 0 0 0 1 ECU_ADDRESS 0x3434C787 /* @ECU_Address@WalkAwayFunctionTrigger@ */ /end MEASUREMENT
/begin MEASUREMENT WalkAwayFunctionSts "" UBYTE CM_uint8 0 0 0 255 ECU_ADDRESS 0x3434C786 /* @ECU_Address@WalkAwayFunctionSts@ */ /end MEASUREMENT
/begin MEASUREMENT TrigSearchKeyToHandleKeyValid "" UBYTE CM_boolean 0 0 0 1 ECU_ADDRESS 0x3434C785 /* @ECU_Address@TrigSearchKeyToHandleKeyValid@ */ /end MEASUREMENT
/begin MEASUREMENT TrigKeySearchCyclic "" UBYTE CM_boolean 0 0 0 1 ECU_ADDRESS 0x3434C784 /* @ECU_Address@TrigKeySearchCyclic@ */ /end MEASUREMENT
/begin MEASUREMENT TrigKeySearchByWalkAway "" UBYTE CM_boolean 0 0 0 1 ECU_ADDRESS 0x3434C783 /* @ECU_Address@TrigKeySearchByWalkAway@ */ /end MEASUREMENT
/begin MEASUREMENT TCM_VehicleOperationState "" UBYTE CM_uint8 0 0 0 255 ECU_ADDRESS 0x3434C9BD /* @ECU_Address@TCM_VehicleOperationState@ */ /end MEASUREMENT
/begin MEASUREMENT S2S_WalkAwayLockSet "" UBYTE CM_uint8 0 0 0 255 ECU_ADDRESS 0x3434C796 /* @ECU_Address@S2S_WalkAwayLockSet@ */ /end MEASUREMENT
/begin MEASUREMENT S2S_SpeedLockSet "" UBYTE CM_uint8 0 0 0 255 ECU_ADDRESS 0x3434C795 /* @ECU_Address@S2S_SpeedLockSet@ */ /end MEASUREMENT
/begin MEASUREMENT S2S_ParkUnlockSet "" UBYTE CM_uint8 0 0 0 255 ECU_ADDRESS 0x3434C794 /* @ECU_Address@S2S_ParkUnlockSet@ */ /end MEASUREMENT
/begin MEASUREMENT S2S_FeedbackSignalsSet "" UBYTE CM_uint8 0 0 0 255 ECU_ADDRESS 0x3434C798 /* @ECU_Address@S2S_FeedbackSignalsSet@ */ /end MEASUREMENT
/begin MEASUREMENT S2S_DoorUnlockOptionSet "" UBYTE CM_uint8 0 0 0 255 ECU_ADDRESS 0x3434C797 /* @ECU_Address@S2S_DoorUnlockOptionSet@ */ /end MEASUREMENT
/begin MEASUREMENT S2S_ChildModeSet "" UBYTE CM_uint8 0 0 0 255 ECU_ADDRESS 0x3434C799 /* @ECU_Address@S2S_ChildModeSet@ */ /end MEASUREMENT
/begin MEASUREMENT RestartToHandleKeyValid "" UBYTE CM_boolean 0 0 0 1 ECU_ADDRESS 0x3434C782 /* @ECU_Address@RestartToHandleKeyValid@ */ /end MEASUREMENT
/begin MEASUREMENT RestartFunctionFlg "" UBYTE CM_boolean 0 0 0 1 ECU_ADDRESS 0x3434C781 /* @ECU_Address@RestartFunctionFlg@ */ /end MEASUREMENT
/begin MEASUREMENT ReTrigKeySearchINIV "" UBYTE CM_boolean 0 0 0 1 ECU_ADDRESS 0x3434C780 /* @ECU_Address@ReTrigKeySearchINIV@ */ /end MEASUREMENT
/begin MEASUREMENT Nv_WalkAwayLockSet "" UBYTE CM_uint8 0 0 0 255 ECU_ADDRESS 0x3434C79C /* @ECU_Address@Nv_WalkAwayLockSet@ */ /end MEASUREMENT
/begin MEASUREMENT Nv_SpeedLockSet "" UBYTE CM_uint8 0 0 0 255 ECU_ADDRESS 0x3434C79B /* @ECU_Address@Nv_SpeedLockSet@ */ /end MEASUREMENT
/begin MEASUREMENT Nv_ParkUnlockSet "" UBYTE CM_uint8 0 0 0 255 ECU_ADDRESS 0x3434C79A /* @ECU_Address@Nv_ParkUnlockSet@ */ /end MEASUREMENT
/begin MEASUREMENT Nv_FeedbackSignalsSet "" UBYTE CM_uint8 0 0 0 255 ECU_ADDRESS 0x3434C79E /* @ECU_Address@Nv_FeedbackSignalsSet@ */ /end MEASUREMENT
/begin MEASUREMENT Nv_DoorUnlockOptionSet "" UBYTE CM_uint8 0 0 0 255 ECU_ADDRESS 0x3434C79D /* @ECU_Address@Nv_DoorUnlockOptionSet@ */ /end MEASUREMENT
/begin MEASUREMENT Nv_ChildModeSet "" UBYTE CM_uint8 0 0 0 255 ECU_ADDRESS 0x3434C79F /* @ECU_Address@Nv_ChildModeSet@ */ /end MEASUREMENT
/begin MEASUREMENT IMMO_KeyFOBSearchReq "" UBYTE CM_uint8 0 0 0 255 ECU_ADDRESS 0x3434CB68 /* @ECU_Address@IMMO_KeyFOBSearchReq@ */ /end MEASUREMENT
/begin MEASUREMENT IDB_VehicleSpd "" FLOAT32_IEEE CM_single 0 0 -3.4E+38 3.4E+38 ECU_ADDRESS 0x3434CAF8 /* @ECU_Address@IDB_VehicleSpd@ */ /end MEASUREMENT
/begin MEASUREMENT IDB_BrakingSensorStatus "" UBYTE CM_uint8 0 0 0 255 ECU_ADDRESS 0x3434C7A6 /* @ECU_Address@IDB_BrakingSensorStatus@ */ /end MEASUREMENT
/begin MEASUREMENT ExitFunctionFlg "" UBYTE CM_boolean 0 0 0 1 ECU_ADDRESS 0x3434C77F /* @ECU_Address@ExitFunctionFlg@ */ /end MEASUREMENT
/begin MEASUREMENT EndFlgByKeyINIV "" UBYTE CM_boolean 0 0 0 1 ECU_ADDRESS 0x3434C77E /* @ECU_Address@EndFlgByKeyINIV@ */ /end MEASUREMENT
/begin MEASUREMENT EndFlgByKeyARIV "" UBYTE CM_boolean 0 0 0 1 ECU_ADDRESS 0x3434C77D /* @ECU_Address@EndFlgByKeyARIV@ */ /end MEASUREMENT
/begin MEASUREMENT CVC_ACTGear "" UBYTE CM_uint8 0 0 0 255 ECU_ADDRESS 0x3434C7B0 /* @ECU_Address@CVC_ACTGear@ */ /end MEASUREMENT
/begin MEASUREMENT CPD_WarningFlag4 "" UBYTE CM_uint8 0 0 0 255 ECU_ADDRESS 0x3434CA6A /* @ECU_Address@CPD_WarningFlag4@ */ /end MEASUREMENT
/begin MEASUREMENT CLM_UserSettingFeedback "" UBYTE CM_uint8 0 0 0 255 ECU_ADDRESS 0x3434CA21 /* @ECU_Address@CLM_UserSettingFeedback@ */ /end MEASUREMENT
/begin MEASUREMENT CLM_UserSettingAutoUnlock "" UBYTE CM_uint8 0 0 0 255 ECU_ADDRESS 0x3434CA22 /* @ECU_Address@CLM_UserSettingAutoUnlock@ */ /end MEASUREMENT
/begin MEASUREMENT CLM_Nv_WalkAwayLockSet "" UBYTE CM_uint8 0 0 0 255 ECU_ADDRESS 0x3434CB9F /* @ECU_Address@CLM_Nv_WalkAwayLockSet@ */ /end MEASUREMENT
/begin MEASUREMENT CLM_Nv_SpeedLockSet "" UBYTE CM_uint8 0 0 0 255 ECU_ADDRESS 0x3434CB9E /* @ECU_Address@CLM_Nv_SpeedLockSet@ */ /end MEASUREMENT
/begin MEASUREMENT CLM_Nv_ParkUnlockSet "" UBYTE CM_uint8 0 0 0 255 ECU_ADDRESS 0x3434CB9D /* @ECU_Address@CLM_Nv_ParkUnlockSet@ */ /end MEASUREMENT
/begin MEASUREMENT CLM_Nv_FeedbackSignalsSet "" UBYTE CM_uint8 0 0 0 255 ECU_ADDRESS 0x3434CB9C /* @ECU_Address@CLM_Nv_FeedbackSignalsSet@ */ /end MEASUREMENT
/begin MEASUREMENT CLM_Nv_DoorUnlockOptionSet "" UBYTE CM_uint8 0 0 0 255 ECU_ADDRESS 0x3434CB9B /* @ECU_Address@CLM_Nv_DoorUnlockOptionSet@ */ /end MEASUREMENT
/begin MEASUREMENT CLM_Nv_ChildModeSet "" UBYTE CM_uint8 0 0 0 255 ECU_ADDRESS 0x3434CB9A /* @ECU_Address@CLM_Nv_ChildModeSet@ */ /end MEASUREMENT
/begin MEASUREMENT CLM_KeyFOBSearchReq "" UBYTE CM_uint8 0 0 0 255 ECU_ADDRESS 0x3434CA1C /* @ECU_Address@CLM_KeyFOBSearchReq@ */ /end MEASUREMENT
/begin MEASUREMENT CLM_DoorUnlockOption "" UBYTE CM_uint8 0 0 0 255 ECU_ADDRESS 0x3434CA23 /* @ECU_Address@CLM_DoorUnlockOption@ */ /end MEASUREMENT
/begin MEASUREMENT CLM_DoorSpdSensingLock "" UBYTE CM_uint8 0 0 0 255 ECU_ADDRESS 0x3434CA24 /* @ECU_Address@CLM_DoorSpdSensingLock@ */ /end MEASUREMENT
/begin MEASUREMENT CLM_DoorRROpenReq "" UBYTE CM_uint8 0 0 0 255 ECU_ADDRESS 0x3434CB99 /* @ECU_Address@CLM_DoorRROpenReq@ */ /end MEASUREMENT
/begin MEASUREMENT CLM_DoorRRLockReq "" UBYTE CM_uint8 0 0 0 255 ECU_ADDRESS 0x3434CA1D /* @ECU_Address@CLM_DoorRRLockReq@ */ /end MEASUREMENT
/begin MEASUREMENT CLM_DoorRLOpenReq "" UBYTE CM_uint8 0 0 0 255 ECU_ADDRESS 0x3434CB98 /* @ECU_Address@CLM_DoorRLOpenReq@ */ /end MEASUREMENT
/begin MEASUREMENT CLM_DoorRLLockReq "" UBYTE CM_uint8 0 0 0 255 ECU_ADDRESS 0x3434CA1E /* @ECU_Address@CLM_DoorRLLockReq@ */ /end MEASUREMENT
/begin MEASUREMENT CLM_DoorOpenWarningSet "" UBYTE CM_uint8 0 0 0 255 ECU_ADDRESS 0x3434CB97 /* @ECU_Address@CLM_DoorOpenWarningSet@ */ /end MEASUREMENT
/begin MEASUREMENT CLM_DoorFROpenReq "" UBYTE CM_uint8 0 0 0 255 ECU_ADDRESS 0x3434CB96 /* @ECU_Address@CLM_DoorFROpenReq@ */ /end MEASUREMENT
/begin MEASUREMENT CLM_DoorFRLockReq "" UBYTE CM_uint8 0 0 0 255 ECU_ADDRESS 0x3434CA1F /* @ECU_Address@CLM_DoorFRLockReq@ */ /end MEASUREMENT
/begin MEASUREMENT CLM_DoorFLOpenReq "" UBYTE CM_uint8 0 0 0 255 ECU_ADDRESS 0x3434CB95 /* @ECU_Address@CLM_DoorFLOpenReq@ */ /end MEASUREMENT
/begin MEASUREMENT CLM_DoorFLLockReq "" UBYTE CM_uint8 0 0 0 255 ECU_ADDRESS 0x3434CA20 /* @ECU_Address@CLM_DoorFLLockReq@ */ /end MEASUREMENT
/begin MEASUREMENT CLM_ChildLockSet "" UBYTE CM_uint8 0 0 0 255 ECU_ADDRESS 0x3434CB94 /* @ECU_Address@CLM_ChildLockSet@ */ /end MEASUREMENT
/begin MEASUREMENT BCMRE_TailgateAjarStatus "" UBYTE CM_uint8 0 0 0 255 ECU_ADDRESS 0x3434CA69 /* @ECU_Address@BCMRE_TailgateAjarStatus@ */ /end MEASUREMENT
/begin MEASUREMENT BCMRE_DoorRRRelsButtonPress "" UBYTE CM_uint8 0 0 0 255 ECU_ADDRESS 0x3434CB6D /* @ECU_Address@BCMRE_DoorRRRelsButtonPress@ */ /end MEASUREMENT
/begin MEASUREMENT BCMRE_DoorRLRelsButtonPress "" UBYTE CM_uint8 0 0 0 255 ECU_ADDRESS 0x3434CB6E /* @ECU_Address@BCMRE_DoorRLRelsButtonPress@ */ /end MEASUREMENT
/begin MEASUREMENT BCMRE_DoorLockStatusRR "" UBYTE CM_uint8 0 0 0 255 ECU_ADDRESS 0x3434CA66 /* @ECU_Address@BCMRE_DoorLockStatusRR@ */ /end MEASUREMENT
/begin MEASUREMENT BCMRE_DoorLockStatusRL "" UBYTE CM_uint8 0 0 0 255 ECU_ADDRESS 0x3434CA65 /* @ECU_Address@BCMRE_DoorLockStatusRL@ */ /end MEASUREMENT
/begin MEASUREMENT BCMRE_DoorAjarStatusRR "" UBYTE CM_uint8 0 0 0 255 ECU_ADDRESS 0x3434CA16 /* @ECU_Address@BCMRE_DoorAjarStatusRR@ */ /end MEASUREMENT
/begin MEASUREMENT BCMRE_DoorAjarStatusRL "" UBYTE CM_uint8 0 0 0 255 ECU_ADDRESS 0x3434CA62 /* @ECU_Address@BCMRE_DoorAjarStatusRL@ */ /end MEASUREMENT
/begin MEASUREMENT BCMFR_KeyFOB_Request "" UBYTE CM_uint8 0 0 0 255 ECU_ADDRESS 0x3434CA5E /* @ECU_Address@BCMFR_KeyFOB_Request@ */ /end MEASUREMENT
/begin MEASUREMENT BCMFR_KeyFOBPosition "" UBYTE CM_uint8 0 0 0 255 ECU_ADDRESS 0x3434CA48 /* @ECU_Address@BCMFR_KeyFOBPosition@ */ /end MEASUREMENT
/begin MEASUREMENT BCMFR_KeyFOBAuthenStatus "" UBYTE CM_uint8 0 0 0 255 ECU_ADDRESS 0x3434CA46 /* @ECU_Address@BCMFR_KeyFOBAuthenStatus@ */ /end MEASUREMENT
/begin MEASUREMENT BCMFR_DoorLockStatusFR "" UBYTE CM_uint8 0 0 0 255 ECU_ADDRESS 0x3434CA36 /* @ECU_Address@BCMFR_DoorLockStatusFR@ */ /end MEASUREMENT
/begin MEASUREMENT BCMFR_DoorFRRelsButtonPress "" UBYTE CM_uint8 0 0 0 255 ECU_ADDRESS 0x3434CB65 /* @ECU_Address@BCMFR_DoorFRRelsButtonPress@ */ /end MEASUREMENT
/begin MEASUREMENT BCMFR_DoorAjarStatusFR "" UBYTE CM_uint8 0 0 0 255 ECU_ADDRESS 0x3434CA35 /* @ECU_Address@BCMFR_DoorAjarStatusFR@ */ /end MEASUREMENT
/begin MEASUREMENT BCMFR_CentralLockingButton "" UBYTE CM_uint8 0 0 0 255 ECU_ADDRESS 0x3434CA32 /* @ECU_Address@BCMFR_CentralLockingButton@ */ /end MEASUREMENT
/begin MEASUREMENT BCMFR_CentralLockLightStatus "" UBYTE CM_uint8 0 0 0 255 ECU_ADDRESS 0x3434CA29 /* @ECU_Address@BCMFR_CentralLockLightStatus@ */ /end MEASUREMENT
/begin MEASUREMENT BCMFL_PassiveEntryButtonReq "" UBYTE CM_uint8 0 0 0 255 ECU_ADDRESS 0x3434CA28 /* @ECU_Address@BCMFL_PassiveEntryButtonReq@ */ /end MEASUREMENT
/begin MEASUREMENT BCMFL_DoorLockStatusFL "" UBYTE CM_uint8 0 0 0 255 ECU_ADDRESS 0x3434CA1A /* @ECU_Address@BCMFL_DoorLockStatusFL@ */ /end MEASUREMENT
/begin MEASUREMENT BCMFL_DoorFLRelsButtonPress "" UBYTE CM_uint8 0 0 0 255 ECU_ADDRESS 0x3434CB5E /* @ECU_Address@BCMFL_DoorFLRelsButtonPress@ */ /end MEASUREMENT
/begin MEASUREMENT BCMFL_DoorAjarStatusFL "" UBYTE CM_uint8 0 0 0 255 ECU_ADDRESS 0x3434C9E4 /* @ECU_Address@BCMFL_DoorAjarStatusFL@ */ /end MEASUREMENT
/begin MEASUREMENT BCMFL_BonnetAjarStatus "" UBYTE CM_uint8 0 0 0 255 ECU_ADDRESS 0x3434C9C3 /* @ECU_Address@BCMFL_BonnetAjarStatus@ */ /end MEASUREMENT
/begin MEASUREMENT ATA_KeyFOBSearchReq "" UBYTE CM_uint8 0 0 0 255 ECU_ADDRESS 0x3434CB6C /* @ECU_Address@ATA_KeyFOBSearchReq@ */ /end MEASUREMENT
/begin MEASUREMENT ARWalkAwayTimeFlag "" UBYTE CM_boolean 0 0 0 1 ECU_ADDRESS 0x3434C77C /* @ECU_Address@ARWalkAwayTimeFlag@ */ /end MEASUREMENT
/begin MEASUREMENT ACM_DriverSeatBeltStatus "" UBYTE CM_uint8 0 0 0 255 ECU_ADDRESS 0x3434CA37 /* @ECU_Address@ACM_DriverSeatBeltStatus@ */ /end MEASUREMENT
/end MODULE
/end PROJECT
