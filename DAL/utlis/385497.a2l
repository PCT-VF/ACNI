ASAP2_VERSION 1 71
/begin PROJECT ProjectName "Project Comment Goes Here"
/begin HEADER "Header Comments go here" /end HEADER
/begin MODULE ModuleName "Module Comment Goes Here"
/begin MOD_COMMON "Common definitions" BYTE_ORDER MSB_LAST ALIGNMENT_BYTE 1 ALIGNMENT_WORD 2 ALIGNMENT_LONG 4 ALIGNMENT_FLOAT32_IEEE 4 ALIGNMENT_FLOAT64_IEEE 8 /end MOD_COMMON
/begin MOD_COMMON "Mod Common Comment Here" BYTE_ORDER MSB_LAST ALIGNMENT_BYTE 1 ALIGNMENT_WORD 2 ALIGNMENT_LONG 4 ALIGNMENT_FLOAT32_IEEE 4 ALIGNMENT_FLOAT64_IEEE 8 ALIGNMENT_INT64 8 /end MOD_COMMON
/begin CHARACTERISTIC WELCOME_LIGHT_TIMER "Duration for welcome light" VALUE 0x34703654 /* @ECU_Address@WELCOME_LIGHT_TIMER@ */ Record_FLOAT32_IEEE 0 CM_single -3.4E+38 3.4E+38 /end CHARACTERISTIC
/begin CHARACTERISTIC TURN_LIGHT_FREQUENCY_IN_EMERGENCY "Flashing Hazard light frequency" VALUE 0x34703650 /* @ECU_Address@TURN_LIGHT_FREQUENCY_IN_EMERGENCY@ */ Record_FLOAT32_IEEE 0 CM_single -3.4E+38 3.4E+38 /end CHARACTERISTIC
/begin CHARACTERISTIC TURN_LIGHT_FREQUENCY "Flashing turn light frequency" VALUE 0x3470364C /* @ECU_Address@TURN_LIGHT_FREQUENCY@ */ Record_FLOAT32_IEEE 0 CM_single -3.4E+38 3.4E+38 /end CHARACTERISTIC
/begin CHARACTERISTIC TURN_LIGHT_DUTY_CYCLE "Flashing turn light duty cycle" VALUE 0x34703648 /* @ECU_Address@TURN_LIGHT_DUTY_CYCLE@ */ Record_FLOAT32_IEEE 0 CM_single -3.4E+38 3.4E+38 /end CHARACTERISTIC
/begin CHARACTERISTIC TARGET_POSITION_UPPER_LIMIT "" VALUE 0x34703640 /* @ECU_Address@TARGET_POSITION_UPPER_LIMIT@ */ Record_FLOAT32_IEEE 0 CM_single -3.4E+38 3.4E+38 /end CHARACTERISTIC
/begin CHARACTERISTIC TARGET_POSITION_LOWER_LIMIT "" VALUE 0x3470363C /* @ECU_Address@TARGET_POSITION_LOWER_LIMIT@ */ Record_FLOAT32_IEEE 0 CM_single -3.4E+38 3.4E+38 /end CHARACTERISTIC
/begin CHARACTERISTIC TARGET_POSITION_INITIAL "" VALUE 0x34703638 /* @ECU_Address@TARGET_POSITION_INITIAL@ */ Record_FLOAT32_IEEE 0 CM_single -3.4E+38 3.4E+38 /end CHARACTERISTIC
/begin CHARACTERISTIC TAILGATE_OPERATING_WARNING_LIGHT_FLASHING_FREQUENCY "" VALUE 0x34703634 /* @ECU_Address@TAILGATE_OPERATING_WARNING_LIGHT_FLASHING_FREQUENCY@ */ Record_FLOAT32_IEEE 0 CM_single -3.4E+38 3.4E+38 /end CHARACTERISTIC
/begin CHARACTERISTIC TAILGATE_OPERATING_WARNING_LIGHT_DUTY_CYCLE "" VALUE 0x34703630 /* @ECU_Address@TAILGATE_OPERATING_WARNING_LIGHT_DUTY_CYCLE@ */ Record_FLOAT32_IEEE 0 CM_single -3.4E+38 3.4E+38 /end CHARACTERISTIC
/begin CHARACTERISTIC STANDSTILL_VELOCITY_THRESHOLD "" VALUE 0x3470362C /* @ECU_Address@STANDSTILL_VELOCITY_THRESHOLD@ */ Record_FLOAT32_IEEE 0 CM_single -3.4E+38 3.4E+38 /end CHARACTERISTIC
/begin CHARACTERISTIC STALK_SWITCH_HOLD_TIMER "User holds stalk switch for more than 2 seconds to deactivate FMH" VALUE 0x34703628 /* @ECU_Address@STALK_SWITCH_HOLD_TIMER@ */ Record_FLOAT32_IEEE 0 CM_single -3.4E+38 3.4E+38 /end CHARACTERISTIC
/begin CHARACTERISTIC SAME_DIRECTION_ANGLE_THRESHOLD "The threshold angle need to be reached to turn off indicator when steering wheel back to center." VALUE 0x34703624 /* @ECU_Address@SAME_DIRECTION_ANGLE_THRESHOLD@ */ Record_FLOAT32_IEEE 0 CM_single -3.4E+38 3.4E+38 /end CHARACTERISTIC
/begin CHARACTERISTIC OPPOSITE_OFFSET_ANGLE "The additional angle need to be reached to deactivated indicator, if activating turn indicator in opposite direction when in over threshold degree." VALUE 0x34703620 /* @ECU_Address@OPPOSITE_OFFSET_ANGLE@ */ Record_FLOAT32_IEEE 0 CM_single -3.4E+38 3.4E+38 /end CHARACTERISTIC
/begin CHARACTERISTIC OPPOSITE_ANGLE_THRESHOLD "The angle to opposite direction turn indicator shall be deactivated" VALUE 0x3470361C /* @ECU_Address@OPPOSITE_ANGLE_THRESHOLD@ */ Record_FLOAT32_IEEE 0 CM_single -3.4E+38 3.4E+38 /end CHARACTERISTIC
/begin CHARACTERISTIC MIRROR_LED_FREQUENCY "" VALUE 0x34703618 /* @ECU_Address@MIRROR_LED_FREQUENCY@ */ Record_FLOAT32_IEEE 0 CM_single -3.4E+38 3.4E+38 /end CHARACTERISTIC
/begin CHARACTERISTIC K2_REAR_HEIGHT_SENSOR_PARAMETER_VF8 "The calibration parameter of front height sensor" VALUE 0x34703610 /* @ECU_Address@K2_REAR_HEIGHT_SENSOR_PARAMETER_VF8@ */ Record_FLOAT32_IEEE 0 CM_single -3.4E+38 3.4E+38 /end CHARACTERISTIC
/begin CHARACTERISTIC K1_FRONT_HEIGHT_SENSOR_PARAMETER_VF8 "The calibration parameter of front height sensor" VALUE 0x3470360C /* @ECU_Address@K1_FRONT_HEIGHT_SENSOR_PARAMETER_VF8@ */ Record_FLOAT32_IEEE 0 CM_single -3.4E+38 3.4E+38 /end CHARACTERISTIC
/begin CHARACTERISTIC INITIAL_REAR_HEIGHT_SENSOR_VOLTAGE_VF8 "" VALUE 0x34703608 /* @ECU_Address@INITIAL_REAR_HEIGHT_SENSOR_VOLTAGE_VF8@ */ Record_FLOAT32_IEEE 0 CM_single -3.4E+38 3.4E+38 /end CHARACTERISTIC
/begin CHARACTERISTIC INITIAL_FRONT_HEIGHT_SENSOR_VOLTAGE_VF8 "" VALUE 0x34703604 /* @ECU_Address@INITIAL_FRONT_HEIGHT_SENSOR_VOLTAGE_VF8@ */ Record_FLOAT32_IEEE 0 CM_single -3.4E+38 3.4E+38 /end CHARACTERISTIC
/begin CHARACTERISTIC FOLLOW_ME_HOME_MAXIMUM_DURATION_TIME "Duration can be increased up to 270 sec." VALUE 0x347035FC /* @ECU_Address@FOLLOW_ME_HOME_MAXIMUM_DURATION_TIME@ */ Record_FLOAT32_IEEE 0 CM_single -3.4E+38 3.4E+38 /end CHARACTERISTIC
/begin CHARACTERISTIC FOLLOW_ME_HOME_INCREASED_DURATION_TIME "Duration will increase by 30 seconds every time user pulls stalk switch to high beam position." VALUE 0x347035F8 /* @ECU_Address@FOLLOW_ME_HOME_INCREASED_DURATION_TIME@ */ Record_FLOAT32_IEEE 0 CM_single -3.4E+38 3.4E+38 /end CHARACTERISTIC
/begin CHARACTERISTIC FLASH_TURN_LIGHT_DURATION "Flash Turn Light Duration" VALUE 0x347035F4 /* @ECU_Address@FLASH_TURN_LIGHT_DURATION@ */ Record_FLOAT32_IEEE 0 CM_single -3.4E+38 3.4E+38 /end CHARACTERISTIC
/begin CHARACTERISTIC FAILURE_TURN_LIGHT_FREQUENCY "Flashing turn light frequency in case of failure of turn light." VALUE 0x347035EC /* @ECU_Address@FAILURE_TURN_LIGHT_FREQUENCY@ */ Record_FLOAT32_IEEE 0 CM_single -3.4E+38 3.4E+38 /end CHARACTERISTIC
/begin CHARACTERISTIC ELM_Ts_P "Sampling time" VALUE 0x347035E8 /* @ECU_Address@ELM_Ts_P@ */ Record_FLOAT32_IEEE 0 CM_single -3.4E+38 3.4E+38 /end CHARACTERISTIC
/begin CHARACTERISTIC DISTANCE_FRONT_REAR_AXLE "The distance between front and rear sensor" VALUE 0x347035E4 /* @ECU_Address@DISTANCE_FRONT_REAR_AXLE@ */ Record_FLOAT32_IEEE 0 CM_single -3.4E+38 3.4E+38 /end CHARACTERISTIC
/begin CHARACTERISTIC CORNERING_LIGHT_VEHICLE_SPEED_THD "Vehicle speed threshold value for cornering light active" VALUE 0x347035DC /* @ECU_Address@CORNERING_LIGHT_VEHICLE_SPEED_THD@ */ Record_FLOAT32_IEEE 0 CM_single -3.4E+38 3.4E+38 /end CHARACTERISTIC
/begin CHARACTERISTIC CORNERING_LIGHT_VEHICLE_SPEED_DEACTIVE_THD "Vehicle speed threshold value for cornering light inactive" VALUE 0x347035D8 /* @ECU_Address@CORNERING_LIGHT_VEHICLE_SPEED_DEACTIVE_THD@ */ Record_FLOAT32_IEEE 0 CM_single -3.4E+38 3.4E+38 /end CHARACTERISTIC
/begin CHARACTERISTIC CORNERING_LIGHT_STEERING_ANGLE_DEACTIVE_THD "Steering Angle threshold value to deactivate cornering light" VALUE 0x347035D4 /* @ECU_Address@CORNERING_LIGHT_STEERING_ANGLE_DEACTIVE_THD@ */ Record_FLOAT32_IEEE 0 CM_single -3.4E+38 3.4E+38 /end CHARACTERISTIC
/begin CHARACTERISTIC CORNERING_LIGHT_STEERING_ANGLE_ACTIVE_THD "Steering Angle threshold value to activate cornering light" VALUE 0x347035D0 /* @ECU_Address@CORNERING_LIGHT_STEERING_ANGLE_ACTIVE_THD@ */ Record_FLOAT32_IEEE 0 CM_single -3.4E+38 3.4E+38 /end CHARACTERISTIC
/begin CHARACTERISTIC CENTER_POSITION_THRESHOLD "The center domain position of the steering angle." VALUE 0x347035CC /* @ECU_Address@CENTER_POSITION_THRESHOLD@ */ Record_FLOAT32_IEEE 0 CM_single -3.4E+38 3.4E+38 /end CHARACTERISTIC
/begin CHARACTERISTIC BYPASS_REQUEST_REVERSE_LIGHT "" VALUE 0x34700108 /* @ECU_Address@BYPASS_REQUEST_REVERSE_LIGHT@ */ Record_UBYTE 0 CM_uint8 0 255 /end CHARACTERISTIC
/begin CHARACTERISTIC BYPASS_REQUEST_REAR_POSITION_LIGHT "" VALUE 0x34700107 /* @ECU_Address@BYPASS_REQUEST_REAR_POSITION_LIGHT@ */ Record_UBYTE 0 CM_uint8 0 255 /end CHARACTERISTIC
/begin CHARACTERISTIC BYPASS_REQUEST_REAR_FOG_LIGHT "" VALUE 0x34700106 /* @ECU_Address@BYPASS_REQUEST_REAR_FOG_LIGHT@ */ Record_UBYTE 0 CM_uint8 0 255 /end CHARACTERISTIC
/begin CHARACTERISTIC BYPASS_REQUEST_OUTSIDE_MIRROR_LED "" VALUE 0x34700105 /* @ECU_Address@BYPASS_REQUEST_OUTSIDE_MIRROR_LED@ */ Record_UBYTE 0 CM_uint8 0 255 /end CHARACTERISTIC
/begin CHARACTERISTIC BYPASS_REQUEST_LOW_BEAM "" VALUE 0x34700104 /* @ECU_Address@BYPASS_REQUEST_LOW_BEAM@ */ Record_UBYTE 0 CM_uint8 0 255 /end CHARACTERISTIC
/begin CHARACTERISTIC BYPASS_REQUEST_LICENSE_PLATE_LIGHT "" VALUE 0x34700103 /* @ECU_Address@BYPASS_REQUEST_LICENSE_PLATE_LIGHT@ */ Record_UBYTE 0 CM_uint8 0 255 /end CHARACTERISTIC
/begin CHARACTERISTIC BYPASS_REQUEST_HIGH_BEAM "" VALUE 0x34700101 /* @ECU_Address@BYPASS_REQUEST_HIGH_BEAM@ */ Record_UBYTE 0 CM_uint8 0 255 /end CHARACTERISTIC
/begin CHARACTERISTIC BYPASS_REQUEST_FRONT_POSITION_LIGHT "" VALUE 0x34700100 /* @ECU_Address@BYPASS_REQUEST_FRONT_POSITION_LIGHT@ */ Record_UBYTE 0 CM_uint8 0 255 /end CHARACTERISTIC
/begin CHARACTERISTIC BYPASS_REQUEST_FRONT_FOG_LIGHT "" VALUE 0x347000FF /* @ECU_Address@BYPASS_REQUEST_FRONT_FOG_LIGHT@ */ Record_UBYTE 0 CM_uint8 0 255 /end CHARACTERISTIC
/begin CHARACTERISTIC BYPASS_REQUEST_DAYTIME_RUNNING_LIGHT "" VALUE 0x347000FE /* @ECU_Address@BYPASS_REQUEST_DAYTIME_RUNNING_LIGHT@ */ Record_UBYTE 0 CM_uint8 0 255 /end CHARACTERISTIC
/begin CHARACTERISTIC BYPASS_REQUEST_BRAKE_LIGHT "" VALUE 0x347000FD /* @ECU_Address@BYPASS_REQUEST_BRAKE_LIGHT@ */ Record_UBYTE 0 CM_uint8 0 255 /end CHARACTERISTIC
/begin CHARACTERISTIC BYPASS_CONTROL_CONSTANT_REVERSE_LIGHT "" VALUE 0x347000FB /* @ECU_Address@BYPASS_CONTROL_CONSTANT_REVERSE_LIGHT@ */ Record_BOOLEAN 0 CM_boolean 0 1 /end CHARACTERISTIC
/begin CHARACTERISTIC BYPASS_CONTROL_CONSTANT_REAR_POSITION_LIGHT "" VALUE 0x347000FA /* @ECU_Address@BYPASS_CONTROL_CONSTANT_REAR_POSITION_LIGHT@ */ Record_BOOLEAN 0 CM_boolean 0 1 /end CHARACTERISTIC
/begin CHARACTERISTIC BYPASS_CONTROL_CONSTANT_REAR_FOG_LIGHT "" VALUE 0x347000F9 /* @ECU_Address@BYPASS_CONTROL_CONSTANT_REAR_FOG_LIGHT@ */ Record_BOOLEAN 0 CM_boolean 0 1 /end CHARACTERISTIC
/begin CHARACTERISTIC BYPASS_CONTROL_CONSTANT_OUTSIDE_MIRROR_LED "" VALUE 0x347000F8 /* @ECU_Address@BYPASS_CONTROL_CONSTANT_OUTSIDE_MIRROR_LED@ */ Record_BOOLEAN 0 CM_boolean 0 1 /end CHARACTERISTIC
/begin CHARACTERISTIC BYPASS_CONTROL_CONSTANT_LOW_BEAM "" VALUE 0x347000F7 /* @ECU_Address@BYPASS_CONTROL_CONSTANT_LOW_BEAM@ */ Record_BOOLEAN 0 CM_boolean 0 1 /end CHARACTERISTIC
/begin CHARACTERISTIC BYPASS_CONTROL_CONSTANT_LICENSE_PLATE_LIGHT "" VALUE 0x347000F6 /* @ECU_Address@BYPASS_CONTROL_CONSTANT_LICENSE_PLATE_LIGHT@ */ Record_BOOLEAN 0 CM_boolean 0 1 /end CHARACTERISTIC
/begin CHARACTERISTIC BYPASS_CONTROL_CONSTANT_HIGH_BEAM "" VALUE 0x347000F4 /* @ECU_Address@BYPASS_CONTROL_CONSTANT_HIGH_BEAM@ */ Record_BOOLEAN 0 CM_boolean 0 1 /end CHARACTERISTIC
/begin CHARACTERISTIC BYPASS_CONTROL_CONSTANT_FRONT_POSITION_LIGHT "" VALUE 0x347000F3 /* @ECU_Address@BYPASS_CONTROL_CONSTANT_FRONT_POSITION_LIGHT@ */ Record_BOOLEAN 0 CM_boolean 0 1 /end CHARACTERISTIC
/begin CHARACTERISTIC BYPASS_CONTROL_CONSTANT_FRONT_FOG_LIGHT "" VALUE 0x347000F2 /* @ECU_Address@BYPASS_CONTROL_CONSTANT_FRONT_FOG_LIGHT@ */ Record_BOOLEAN 0 CM_boolean 0 1 /end CHARACTERISTIC
/begin CHARACTERISTIC BYPASS_CONTROL_CONSTANT_DAYTIME_RUNNING_LIGHT "" VALUE 0x347000F1 /* @ECU_Address@BYPASS_CONTROL_CONSTANT_DAYTIME_RUNNING_LIGHT@ */ Record_BOOLEAN 0 CM_boolean 0 1 /end CHARACTERISTIC
/begin CHARACTERISTIC BYPASS_CONTROL_CONSTANT_BRAKE_LIGHT "" VALUE 0x347000F0 /* @ECU_Address@BYPASS_CONTROL_CONSTANT_BRAKE_LIGHT@ */ Record_BOOLEAN 0 CM_boolean 0 1 /end CHARACTERISTIC
/begin CHARACTERISTIC BRAKE_LIGHT_ON_DECCELERATION_THD "Deceleration threshold to turn ON brake light." VALUE 0x347035C8 /* @ECU_Address@BRAKE_LIGHT_ON_DECCELERATION_THD@ */ Record_FLOAT32_IEEE 0 CM_single -3.4E+38 3.4E+38 /end CHARACTERISTIC
/begin CHARACTERISTIC BRAKE_LIGHT_OFF_DECCELERATION_THD "Deceleration threshold to turn OFF brake light." VALUE 0x347035C4 /* @ECU_Address@BRAKE_LIGHT_OFF_DECCELERATION_THD@ */ Record_FLOAT32_IEEE 0 CM_single -3.4E+38 3.4E+38 /end CHARACTERISTIC
/begin COMPU_METHOD CM_uint8 "Q = V" IDENTICAL "%3.0" "" /end COMPU_METHOD
/begin COMPU_METHOD CM_single "Q = V" IDENTICAL "%8.6" "" /end COMPU_METHOD
/begin COMPU_METHOD CM_logical "Q = V" IDENTICAL "%1.0" "" /end COMPU_METHOD
/begin COMPU_METHOD CM_int32 "Q = V" IDENTICAL "%10.0" "" /end COMPU_METHOD
/begin COMPU_METHOD CM_boolean "Q = V" IDENTICAL "%1.0" "" /end COMPU_METHOD
/begin RECORD_LAYOUT Record_UBYTE FNC_VALUES 1 UBYTE COLUMN_DIR DIRECT /end RECORD_LAYOUT
/begin RECORD_LAYOUT Record_FLOAT32_IEEE FNC_VALUES 1 FLOAT32_IEEE COLUMN_DIR DIRECT /end RECORD_LAYOUT
/begin RECORD_LAYOUT Record_BOOLEAN FNC_VALUES 1 UBYTE COLUMN_DIR DIRECT /end RECORD_LAYOUT
/begin GROUP ExteriorLightManager_ELM_Main_sys_ELM_Main_LightActuator_TurnIndicatorLightActuator "ExteriorLightManager/ELM_Main_sys/ELM_Main/LightActuator/TurnIndicatorLightActuator"
 /begin SUB_GROUP ExteriorLightManager_ELM_Main_sys_ELM_Main_LightActuator_TurnIndicatorLightActuator_BYPASS_CONTROL_CONSTANT_ALL_LIGHT1 ExteriorLightManager_ELM_Main_sys_ELM_Main_LightActuator_TurnIndicatorLightActuator_BYPASS_CONTROL_CONSTANT_INDICATOR_LIGHT1 ExteriorLightManager_ELM_Main_sys_ELM_Main_LightActuator_TurnIndicatorLightActuator_BYPASS_REQUEST_ALL_LIGHT ExteriorLightManager_ELM_Main_sys_ELM_Main_LightActuator_TurnIndicatorLightActuator_BYPASS_REQUEST_INDICATOR_LIGHT /end SUB_GROUP
/end GROUP
/begin GROUP ExteriorLightManager_ELM_Main_sys_ELM_Main_LightActuator_ReverseLampActuator_S_R_Flip_Flop1 "ExteriorLightManager/ELM_Main_sys/ELM_Main/LightActuator/ReverseLampActuator/S-R\r\nFlip-Flop1" /end GROUP
/begin GROUP ExteriorLightManager_ELM_Main_sys_ELM_Main_LightActuator_ReverseLampActuator_S_R_Flip_Flop "ExteriorLightManager/ELM_Main_sys/ELM_Main/LightActuator/ReverseLampActuator/S-R\r\nFlip-Flop" /end GROUP
/begin GROUP ExteriorLightManager_ELM_Main_sys_ELM_Main_LightActuator_ReverseLampActuator_BYPASS_REQUEST_REVERSE_LIGHT "ExteriorLightManager/ELM_Main_sys/ELM_Main/LightActuator/ReverseLampActuator/BYPASS_REQUEST_REVERSE_LIGHT" /begin REF_CHARACTERISTIC BYPASS_REQUEST_REVERSE_LIGHT /end REF_CHARACTERISTIC /end GROUP
/begin GROUP ExteriorLightManager_ELM_Main_sys_ELM_Main_LightActuator_ReverseLampActuator_BYPASS_CONTROL_CONSTANT_REVERSE_LIGHT1 "ExteriorLightManager/ELM_Main_sys/ELM_Main/LightActuator/ReverseLampActuator/BYPASS_CONTROL_CONSTANT_REVERSE_LIGHT1" /begin REF_CHARACTERISTIC BYPASS_CONTROL_CONSTANT_REVERSE_LIGHT /end REF_CHARACTERISTIC /end GROUP
/begin GROUP ExteriorLightManager_ELM_Main_sys_ELM_Main_LightActuator_ReverseLampActuator "ExteriorLightManager/ELM_Main_sys/ELM_Main/LightActuator/ReverseLampActuator"
 /begin SUB_GROUP ExteriorLightManager_ELM_Main_sys_ELM_Main_LightActuator_ReverseLampActuator_BYPASS_CONTROL_CONSTANT_ALL_LIGHT1 ExteriorLightManager_ELM_Main_sys_ELM_Main_LightActuator_ReverseLampActuator_BYPASS_CONTROL_CONSTANT_REVERSE_LIGHT1 ExteriorLightManager_ELM_Main_sys_ELM_Main_LightActuator_ReverseLampActuator_BYPASS_REQUEST_ALL_LIGHT ExteriorLightManager_ELM_Main_sys_ELM_Main_LightActuator_ReverseLampActuator_BYPASS_REQUEST_REVERSE_LIGHT ExteriorLightManager_ELM_Main_sys_ELM_Main_LightActuator_ReverseLampActuator_S_R_Flip_Flop ExteriorLightManager_ELM_Main_sys_ELM_Main_LightActuator_ReverseLampActuator_S_R_Flip_Flop1 /end SUB_GROUP
/end GROUP
/begin GROUP ExteriorLightManager_ELM_Main_sys_ELM_Main_LightActuator_PositionLightActuator_S_R_Flip_Flop3 "ExteriorLightManager/ELM_Main_sys/ELM_Main/LightActuator/PositionLightActuator/S-R\r\nFlip-Flop3" /end GROUP
/begin GROUP ExteriorLightManager_ELM_Main_sys_ELM_Main_LightActuator_PositionLightActuator_S_R_Flip_Flop2 "ExteriorLightManager/ELM_Main_sys/ELM_Main/LightActuator/PositionLightActuator/S-R\r\nFlip-Flop2" /end GROUP
/begin GROUP ExteriorLightManager_ELM_Main_sys_ELM_Main_LightActuator_PositionLightActuator_S_R_Flip_Flop1 "ExteriorLightManager/ELM_Main_sys/ELM_Main/LightActuator/PositionLightActuator/S-R\r\nFlip-Flop1" /end GROUP
/begin GROUP ExteriorLightManager_ELM_Main_sys_ELM_Main_LightActuator_PositionLightActuator_S_R_Flip_Flop "ExteriorLightManager/ELM_Main_sys/ELM_Main/LightActuator/PositionLightActuator/S-R\r\nFlip-Flop" /end GROUP
/begin GROUP ExteriorLightManager_ELM_Main_sys_ELM_Main_LightActuator_PositionLightActuator_BYPASS_REQUEST_REAR_POSITION_LIGHT2 "ExteriorLightManager/ELM_Main_sys/ELM_Main/LightActuator/PositionLightActuator/BYPASS_REQUEST_REAR_POSITION_LIGHT2" /begin REF_CHARACTERISTIC BYPASS_REQUEST_REAR_POSITION_LIGHT /end REF_CHARACTERISTIC /end GROUP
/begin GROUP ExteriorLightManager_ELM_Main_sys_ELM_Main_LightActuator_PositionLightActuator_BYPASS_REQUEST_REAR_POSITION_LIGHT1 "ExteriorLightManager/ELM_Main_sys/ELM_Main/LightActuator/PositionLightActuator/BYPASS_REQUEST_REAR_POSITION_LIGHT1" /begin REF_CHARACTERISTIC BYPASS_REQUEST_REAR_POSITION_LIGHT /end REF_CHARACTERISTIC /end GROUP
/begin GROUP ExteriorLightManager_ELM_Main_sys_ELM_Main_LightActuator_PositionLightActuator_BYPASS_REQUEST_FRONT_POSITION_LIGHT2 "ExteriorLightManager/ELM_Main_sys/ELM_Main/LightActuator/PositionLightActuator/BYPASS_REQUEST_FRONT_POSITION_LIGHT2" /begin REF_CHARACTERISTIC BYPASS_REQUEST_FRONT_POSITION_LIGHT /end REF_CHARACTERISTIC /end GROUP
/begin GROUP ExteriorLightManager_ELM_Main_sys_ELM_Main_LightActuator_PositionLightActuator_BYPASS_REQUEST_FRONT_POSITION_LIGHT1 "ExteriorLightManager/ELM_Main_sys/ELM_Main/LightActuator/PositionLightActuator/BYPASS_REQUEST_FRONT_POSITION_LIGHT1" /begin REF_CHARACTERISTIC BYPASS_REQUEST_FRONT_POSITION_LIGHT /end REF_CHARACTERISTIC /end GROUP
/begin GROUP ExteriorLightManager_ELM_Main_sys_ELM_Main_LightActuator_PositionLightActuator_BYPASS_CONTROL_CONSTANT_REAR_POSITION_LIGHT2 "ExteriorLightManager/ELM_Main_sys/ELM_Main/LightActuator/PositionLightActuator/BYPASS_CONTROL_CONSTANT_REAR_POSITION_LIGHT2" /begin REF_CHARACTERISTIC BYPASS_CONTROL_CONSTANT_REAR_POSITION_LIGHT /end REF_CHARACTERISTIC /end GROUP
/begin GROUP ExteriorLightManager_ELM_Main_sys_ELM_Main_LightActuator_PositionLightActuator_BYPASS_CONTROL_CONSTANT_REAR_POSITION_LIGHT1 "ExteriorLightManager/ELM_Main_sys/ELM_Main/LightActuator/PositionLightActuator/BYPASS_CONTROL_CONSTANT_REAR_POSITION_LIGHT1" /begin REF_CHARACTERISTIC BYPASS_CONTROL_CONSTANT_REAR_POSITION_LIGHT /end REF_CHARACTERISTIC /end GROUP
/begin GROUP ExteriorLightManager_ELM_Main_sys_ELM_Main_LightActuator_PositionLightActuator_BYPASS_CONTROL_CONSTANT_FRONT_POSITION_LIGHT2 "ExteriorLightManager/ELM_Main_sys/ELM_Main/LightActuator/PositionLightActuator/BYPASS_CONTROL_CONSTANT_FRONT_POSITION_LIGHT2" /begin REF_CHARACTERISTIC BYPASS_CONTROL_CONSTANT_FRONT_POSITION_LIGHT /end REF_CHARACTERISTIC /end GROUP
/begin GROUP ExteriorLightManager_ELM_Main_sys_ELM_Main_LightActuator_PositionLightActuator_BYPASS_CONTROL_CONSTANT_FRONT_POSITION_LIGHT1 "ExteriorLightManager/ELM_Main_sys/ELM_Main/LightActuator/PositionLightActuator/BYPASS_CONTROL_CONSTANT_FRONT_POSITION_LIGHT1" /begin REF_CHARACTERISTIC BYPASS_CONTROL_CONSTANT_FRONT_POSITION_LIGHT /end REF_CHARACTERISTIC /end GROUP
/begin GROUP ExteriorLightManager_ELM_Main_sys_ELM_Main_LightActuator_PositionLightActuator "ExteriorLightManager/ELM_Main_sys/ELM_Main/LightActuator/PositionLightActuator"
 /begin SUB_GROUP ExteriorLightManager_ELM_Main_sys_ELM_Main_LightActuator_PositionLightActuator_BYPASS_CONTROL_CONSTANT_ALL_LIGHT1 ExteriorLightManager_ELM_Main_sys_ELM_Main_LightActuator_PositionLightActuator_BYPASS_CONTROL_CONSTANT_FRONT_POSITION_LIGHT1 ExteriorLightManager_ELM_Main_sys_ELM_Main_LightActuator_PositionLightActuator_BYPASS_CONTROL_CONSTANT_FRONT_POSITION_LIGHT2 ExteriorLightManager_ELM_Main_sys_ELM_Main_LightActuator_PositionLightActuator_BYPASS_CONTROL_CONSTANT_REAR_POSITION_LIGHT1 ExteriorLightManager_ELM_Main_sys_ELM_Main_LightActuator_PositionLightActuator_BYPASS_CONTROL_CONSTANT_REAR_POSITION_LIGHT2 ExteriorLightManager_ELM_Main_sys_ELM_Main_LightActuator_PositionLightActuator_BYPASS_REQUEST_ALL_LIGHT ExteriorLightManager_ELM_Main_sys_ELM_Main_LightActuator_PositionLightActuator_BYPASS_REQUEST_FRONT_POSITION_LIGHT1 ExteriorLightManager_ELM_Main_sys_ELM_Main_LightActuator_PositionLightActuator_BYPASS_REQUEST_FRONT_POSITION_LIGHT2 ExteriorLightManager_ELM_Main_sys_ELM_Main_LightActuator_PositionLightActuator_BYPASS_REQUEST_REAR_POSITION_LIGHT1 ExteriorLightManager_ELM_Main_sys_ELM_Main_LightActuator_PositionLightActuator_BYPASS_REQUEST_REAR_POSITION_LIGHT2 ExteriorLightManager_ELM_Main_sys_ELM_Main_LightActuator_PositionLightActuator_S_R_Flip_Flop ExteriorLightManager_ELM_Main_sys_ELM_Main_LightActuator_PositionLightActuator_S_R_Flip_Flop1 ExteriorLightManager_ELM_Main_sys_ELM_Main_LightActuator_PositionLightActuator_S_R_Flip_Flop2 ExteriorLightManager_ELM_Main_sys_ELM_Main_LightActuator_PositionLightActuator_S_R_Flip_Flop3 /end SUB_GROUP
/end GROUP
/begin GROUP ExteriorLightManager_ELM_Main_sys_ELM_Main_LightActuator_MirrorLEDActuator_BYPASS_REQUEST_OUTSIDE_MIRROR_LED "ExteriorLightManager/ELM_Main_sys/ELM_Main/LightActuator/MirrorLEDActuator/BYPASS_REQUEST_OUTSIDE_MIRROR_LED" /begin REF_CHARACTERISTIC BYPASS_REQUEST_OUTSIDE_MIRROR_LED /end REF_CHARACTERISTIC /end GROUP
/begin GROUP ExteriorLightManager_ELM_Main_sys_ELM_Main_LightActuator_MirrorLEDActuator_BYPASS_CONTROL_CONSTANT_OUTSIDE_MIRROR_LED1 "ExteriorLightManager/ELM_Main_sys/ELM_Main/LightActuator/MirrorLEDActuator/BYPASS_CONTROL_CONSTANT_OUTSIDE_MIRROR_LED1" /begin REF_CHARACTERISTIC BYPASS_CONTROL_CONSTANT_OUTSIDE_MIRROR_LED /end REF_CHARACTERISTIC /end GROUP
/begin GROUP ExteriorLightManager_ELM_Main_sys_ELM_Main_LightActuator_MirrorLEDActuator "ExteriorLightManager/ELM_Main_sys/ELM_Main/LightActuator/MirrorLEDActuator"
 /begin SUB_GROUP ExteriorLightManager_ELM_Main_sys_ELM_Main_LightActuator_MirrorLEDActuator_BYPASS_CONTROL_CONSTANT_ALL_LIGHT1 ExteriorLightManager_ELM_Main_sys_ELM_Main_LightActuator_MirrorLEDActuator_BYPASS_CONTROL_CONSTANT_OUTSIDE_MIRROR_LED1 ExteriorLightManager_ELM_Main_sys_ELM_Main_LightActuator_MirrorLEDActuator_BYPASS_REQUEST_ALL_LIGHT ExteriorLightManager_ELM_Main_sys_ELM_Main_LightActuator_MirrorLEDActuator_BYPASS_REQUEST_OUTSIDE_MIRROR_LED /end SUB_GROUP
/end GROUP
/begin GROUP ExteriorLightManager_ELM_Main_sys_ELM_Main_LightActuator_LowBeamLightActuator_S_R_Flip_Flop1 "ExteriorLightManager/ELM_Main_sys/ELM_Main/LightActuator/LowBeamLightActuator/S-R\r\nFlip-Flop1" /end GROUP
/begin GROUP ExteriorLightManager_ELM_Main_sys_ELM_Main_LightActuator_LowBeamLightActuator_S_R_Flip_Flop "ExteriorLightManager/ELM_Main_sys/ELM_Main/LightActuator/LowBeamLightActuator/S-R\r\nFlip-Flop" /end GROUP
/begin GROUP ExteriorLightManager_ELM_Main_sys_ELM_Main_LightActuator_LowBeamLightActuator_BYPASS_REQUEST_LOW_BEAM "ExteriorLightManager/ELM_Main_sys/ELM_Main/LightActuator/LowBeamLightActuator/BYPASS_REQUEST_LOW_BEAM" /begin REF_CHARACTERISTIC BYPASS_REQUEST_LOW_BEAM /end REF_CHARACTERISTIC /end GROUP
/begin GROUP ExteriorLightManager_ELM_Main_sys_ELM_Main_LightActuator_LowBeamLightActuator_BYPASS_CONTROL_CONSTANT_LOW_BEAM1 "ExteriorLightManager/ELM_Main_sys/ELM_Main/LightActuator/LowBeamLightActuator/BYPASS_CONTROL_CONSTANT_LOW_BEAM1" /begin REF_CHARACTERISTIC BYPASS_CONTROL_CONSTANT_LOW_BEAM /end REF_CHARACTERISTIC /end GROUP
/begin GROUP ExteriorLightManager_ELM_Main_sys_ELM_Main_LightActuator_LowBeamLightActuator "ExteriorLightManager/ELM_Main_sys/ELM_Main/LightActuator/LowBeamLightActuator"
 /begin SUB_GROUP ExteriorLightManager_ELM_Main_sys_ELM_Main_LightActuator_LowBeamLightActuator_BYPASS_CONTROL_CONSTANT_ALL_LIGHT1 ExteriorLightManager_ELM_Main_sys_ELM_Main_LightActuator_LowBeamLightActuator_BYPASS_CONTROL_CONSTANT_LOW_BEAM1 ExteriorLightManager_ELM_Main_sys_ELM_Main_LightActuator_LowBeamLightActuator_BYPASS_REQUEST_ALL_LIGHT ExteriorLightManager_ELM_Main_sys_ELM_Main_LightActuator_LowBeamLightActuator_BYPASS_REQUEST_LOW_BEAM ExteriorLightManager_ELM_Main_sys_ELM_Main_LightActuator_LowBeamLightActuator_S_R_Flip_Flop ExteriorLightManager_ELM_Main_sys_ELM_Main_LightActuator_LowBeamLightActuator_S_R_Flip_Flop1 /end SUB_GROUP
/end GROUP
/begin GROUP ExteriorLightManager_ELM_Main_sys_ELM_Main_LightActuator_LicensePlateLampActuator_S_R_Flip_Flop "ExteriorLightManager/ELM_Main_sys/ELM_Main/LightActuator/LicensePlateLampActuator/S-R\r\nFlip-Flop" /end GROUP
/begin GROUP ExteriorLightManager_ELM_Main_sys_ELM_Main_LightActuator_LicensePlateLampActuator_BYPASS_REQUEST_LICENSE_PLATE_LIGHT "ExteriorLightManager/ELM_Main_sys/ELM_Main/LightActuator/LicensePlateLampActuator/BYPASS_REQUEST_LICENSE_PLATE_LIGHT" /begin REF_CHARACTERISTIC BYPASS_REQUEST_LICENSE_PLATE_LIGHT /end REF_CHARACTERISTIC /end GROUP
/begin GROUP ExteriorLightManager_ELM_Main_sys_ELM_Main_LightActuator_LicensePlateLampActuator_BYPASS_CONTROL_CONSTANT_LICENSE_PLATE_LIGHT1 "ExteriorLightManager/ELM_Main_sys/ELM_Main/LightActuator/LicensePlateLampActuator/BYPASS_CONTROL_CONSTANT_LICENSE_PLATE_LIGHT1" /begin REF_CHARACTERISTIC BYPASS_CONTROL_CONSTANT_LICENSE_PLATE_LIGHT /end REF_CHARACTERISTIC /end GROUP
/begin GROUP ExteriorLightManager_ELM_Main_sys_ELM_Main_LightActuator_LicensePlateLampActuator "ExteriorLightManager/ELM_Main_sys/ELM_Main/LightActuator/LicensePlateLampActuator"
 /begin SUB_GROUP ExteriorLightManager_ELM_Main_sys_ELM_Main_LightActuator_LicensePlateLampActuator_BYPASS_CONTROL_CONSTANT_ALL_LIGHT1 ExteriorLightManager_ELM_Main_sys_ELM_Main_LightActuator_LicensePlateLampActuator_BYPASS_CONTROL_CONSTANT_LICENSE_PLATE_LIGHT1 ExteriorLightManager_ELM_Main_sys_ELM_Main_LightActuator_LicensePlateLampActuator_BYPASS_REQUEST_ALL_LIGHT ExteriorLightManager_ELM_Main_sys_ELM_Main_LightActuator_LicensePlateLampActuator_BYPASS_REQUEST_LICENSE_PLATE_LIGHT ExteriorLightManager_ELM_Main_sys_ELM_Main_LightActuator_LicensePlateLampActuator_S_R_Flip_Flop /end SUB_GROUP
/end GROUP
/begin GROUP ExteriorLightManager_ELM_Main_sys_ELM_Main_LightActuator_HighBeamLightActuator_S_R_Flip_Flop2 "ExteriorLightManager/ELM_Main_sys/ELM_Main/LightActuator/HighBeamLightActuator/S-R\r\nFlip-Flop2" /end GROUP
/begin GROUP ExteriorLightManager_ELM_Main_sys_ELM_Main_LightActuator_HighBeamLightActuator_S_R_Flip_Flop1 "ExteriorLightManager/ELM_Main_sys/ELM_Main/LightActuator/HighBeamLightActuator/S-R\r\nFlip-Flop1" /end GROUP
/begin GROUP ExteriorLightManager_ELM_Main_sys_ELM_Main_LightActuator_HighBeamLightActuator_BYPASS_REQUEST_HIGH_BEAM "ExteriorLightManager/ELM_Main_sys/ELM_Main/LightActuator/HighBeamLightActuator/BYPASS_REQUEST_HIGH_BEAM" /begin REF_CHARACTERISTIC BYPASS_REQUEST_HIGH_BEAM /end REF_CHARACTERISTIC /end GROUP
/begin GROUP ExteriorLightManager_ELM_Main_sys_ELM_Main_LightActuator_HighBeamLightActuator_BYPASS_CONTROL_CONSTANT_HIGH_BEAM "ExteriorLightManager/ELM_Main_sys/ELM_Main/LightActuator/HighBeamLightActuator/BYPASS_CONTROL_CONSTANT_HIGH_BEAM" /begin REF_CHARACTERISTIC BYPASS_CONTROL_CONSTANT_HIGH_BEAM /end REF_CHARACTERISTIC /end GROUP
/begin GROUP ExteriorLightManager_ELM_Main_sys_ELM_Main_LightActuator_HighBeamLightActuator "ExteriorLightManager/ELM_Main_sys/ELM_Main/LightActuator/HighBeamLightActuator"
 /begin SUB_GROUP ExteriorLightManager_ELM_Main_sys_ELM_Main_LightActuator_HighBeamLightActuator_BYPASS_CONTROL_CONSTANT_ALL_LIGHT1 ExteriorLightManager_ELM_Main_sys_ELM_Main_LightActuator_HighBeamLightActuator_BYPASS_CONTROL_CONSTANT_HIGH_BEAM ExteriorLightManager_ELM_Main_sys_ELM_Main_LightActuator_HighBeamLightActuator_BYPASS_REQUEST_ALL_LIGHT ExteriorLightManager_ELM_Main_sys_ELM_Main_LightActuator_HighBeamLightActuator_BYPASS_REQUEST_HIGH_BEAM ExteriorLightManager_ELM_Main_sys_ELM_Main_LightActuator_HighBeamLightActuator_S_R_Flip_Flop1 ExteriorLightManager_ELM_Main_sys_ELM_Main_LightActuator_HighBeamLightActuator_S_R_Flip_Flop2 /end SUB_GROUP
/end GROUP
/begin GROUP ExteriorLightManager_ELM_Main_sys_ELM_Main_LightActuator_FogLightActuator_S_R_Flip_Flop3 "ExteriorLightManager/ELM_Main_sys/ELM_Main/LightActuator/FogLightActuator/S-R\r\nFlip-Flop3" /end GROUP
/begin GROUP ExteriorLightManager_ELM_Main_sys_ELM_Main_LightActuator_FogLightActuator_S_R_Flip_Flop2 "ExteriorLightManager/ELM_Main_sys/ELM_Main/LightActuator/FogLightActuator/S-R\r\nFlip-Flop2" /end GROUP
/begin GROUP ExteriorLightManager_ELM_Main_sys_ELM_Main_LightActuator_FogLightActuator_S_R_Flip_Flop1 "ExteriorLightManager/ELM_Main_sys/ELM_Main/LightActuator/FogLightActuator/S-R\r\nFlip-Flop1" /end GROUP
/begin GROUP ExteriorLightManager_ELM_Main_sys_ELM_Main_LightActuator_FogLightActuator_S_R_Flip_Flop "ExteriorLightManager/ELM_Main_sys/ELM_Main/LightActuator/FogLightActuator/S-R\r\nFlip-Flop" /end GROUP
/begin GROUP ExteriorLightManager_ELM_Main_sys_ELM_Main_LightActuator_FogLightActuator_BYPASS_REQUEST_REAR_FOG_LIGHT "ExteriorLightManager/ELM_Main_sys/ELM_Main/LightActuator/FogLightActuator/BYPASS_REQUEST_REAR_FOG_LIGHT" /begin REF_CHARACTERISTIC BYPASS_REQUEST_REAR_FOG_LIGHT /end REF_CHARACTERISTIC /end GROUP
/begin GROUP ExteriorLightManager_ELM_Main_sys_ELM_Main_LightActuator_FogLightActuator_BYPASS_REQUEST_FRONT_FOG_LIGHT "ExteriorLightManager/ELM_Main_sys/ELM_Main/LightActuator/FogLightActuator/BYPASS_REQUEST_FRONT_FOG_LIGHT" /begin REF_CHARACTERISTIC BYPASS_REQUEST_FRONT_FOG_LIGHT /end REF_CHARACTERISTIC /end GROUP
/begin GROUP ExteriorLightManager_ELM_Main_sys_ELM_Main_LightActuator_FogLightActuator_BYPASS_CONTROL_CONSTANT_REAR_FOG_LIGHT1 "ExteriorLightManager/ELM_Main_sys/ELM_Main/LightActuator/FogLightActuator/BYPASS_CONTROL_CONSTANT_REAR_FOG_LIGHT1" /begin REF_CHARACTERISTIC BYPASS_CONTROL_CONSTANT_REAR_FOG_LIGHT /end REF_CHARACTERISTIC /end GROUP
/begin GROUP ExteriorLightManager_ELM_Main_sys_ELM_Main_LightActuator_FogLightActuator_BYPASS_CONTROL_CONSTANT_FRONT_FOG_LIGHT1 "ExteriorLightManager/ELM_Main_sys/ELM_Main/LightActuator/FogLightActuator/BYPASS_CONTROL_CONSTANT_FRONT_FOG_LIGHT1" /begin REF_CHARACTERISTIC BYPASS_CONTROL_CONSTANT_FRONT_FOG_LIGHT /end REF_CHARACTERISTIC /end GROUP
/begin GROUP ExteriorLightManager_ELM_Main_sys_ELM_Main_LightActuator_FogLightActuator "ExteriorLightManager/ELM_Main_sys/ELM_Main/LightActuator/FogLightActuator"
 /begin SUB_GROUP ExteriorLightManager_ELM_Main_sys_ELM_Main_LightActuator_FogLightActuator_BYPASS_CONTROL_CONSTANT_ALL_LIGHT1 ExteriorLightManager_ELM_Main_sys_ELM_Main_LightActuator_FogLightActuator_BYPASS_CONTROL_CONSTANT_FRONT_FOG_LIGHT1 ExteriorLightManager_ELM_Main_sys_ELM_Main_LightActuator_FogLightActuator_BYPASS_CONTROL_CONSTANT_REAR_FOG_LIGHT1 ExteriorLightManager_ELM_Main_sys_ELM_Main_LightActuator_FogLightActuator_BYPASS_REQUEST_ALL_LIGHT ExteriorLightManager_ELM_Main_sys_ELM_Main_LightActuator_FogLightActuator_BYPASS_REQUEST_FRONT_FOG_LIGHT ExteriorLightManager_ELM_Main_sys_ELM_Main_LightActuator_FogLightActuator_BYPASS_REQUEST_REAR_FOG_LIGHT ExteriorLightManager_ELM_Main_sys_ELM_Main_LightActuator_FogLightActuator_S_R_Flip_Flop ExteriorLightManager_ELM_Main_sys_ELM_Main_LightActuator_FogLightActuator_S_R_Flip_Flop1 ExteriorLightManager_ELM_Main_sys_ELM_Main_LightActuator_FogLightActuator_S_R_Flip_Flop2 ExteriorLightManager_ELM_Main_sys_ELM_Main_LightActuator_FogLightActuator_S_R_Flip_Flop3 /end SUB_GROUP
/end GROUP
/begin GROUP ExteriorLightManager_ELM_Main_sys_ELM_Main_LightActuator_DaytimeRunningLightActuator_S_R_Flip_Flop1 "ExteriorLightManager/ELM_Main_sys/ELM_Main/LightActuator/DaytimeRunningLightActuator/S-R\r\nFlip-Flop1" /end GROUP
/begin GROUP ExteriorLightManager_ELM_Main_sys_ELM_Main_LightActuator_DaytimeRunningLightActuator_S_R_Flip_Flop "ExteriorLightManager/ELM_Main_sys/ELM_Main/LightActuator/DaytimeRunningLightActuator/S-R\r\nFlip-Flop" /end GROUP
/begin GROUP ExteriorLightManager_ELM_Main_sys_ELM_Main_LightActuator_DaytimeRunningLightActuator_BYPASS_REQUEST_DAYTIME_RUNNING_LIGHT "ExteriorLightManager/ELM_Main_sys/ELM_Main/LightActuator/DaytimeRunningLightActuator/BYPASS_REQUEST_DAYTIME_RUNNING_LIGHT" /begin REF_CHARACTERISTIC BYPASS_REQUEST_DAYTIME_RUNNING_LIGHT /end REF_CHARACTERISTIC /end GROUP
/begin GROUP ExteriorLightManager_ELM_Main_sys_ELM_Main_LightActuator_DaytimeRunningLightActuator_BYPASS_CONTROL_CONSTANT_DAYTIME_RUNNING_LIGHT "ExteriorLightManager/ELM_Main_sys/ELM_Main/LightActuator/DaytimeRunningLightActuator/BYPASS_CONTROL_CONSTANT_DAYTIME_RUNNING_LIGHT" /begin REF_CHARACTERISTIC BYPASS_CONTROL_CONSTANT_DAYTIME_RUNNING_LIGHT /end REF_CHARACTERISTIC /end GROUP
/begin GROUP ExteriorLightManager_ELM_Main_sys_ELM_Main_LightActuator_DaytimeRunningLightActuator "ExteriorLightManager/ELM_Main_sys/ELM_Main/LightActuator/DaytimeRunningLightActuator"
 /begin SUB_GROUP ExteriorLightManager_ELM_Main_sys_ELM_Main_LightActuator_DaytimeRunningLightActuator_BYPASS_CONTROL_CONSTANT_ALL_LIGHT1 ExteriorLightManager_ELM_Main_sys_ELM_Main_LightActuator_DaytimeRunningLightActuator_BYPASS_CONTROL_CONSTANT_DAYTIME_RUNNING_LIGHT ExteriorLightManager_ELM_Main_sys_ELM_Main_LightActuator_DaytimeRunningLightActuator_BYPASS_REQUEST_ALL_LIGHT ExteriorLightManager_ELM_Main_sys_ELM_Main_LightActuator_DaytimeRunningLightActuator_BYPASS_REQUEST_DAYTIME_RUNNING_LIGHT ExteriorLightManager_ELM_Main_sys_ELM_Main_LightActuator_DaytimeRunningLightActuator_S_R_Flip_Flop ExteriorLightManager_ELM_Main_sys_ELM_Main_LightActuator_DaytimeRunningLightActuator_S_R_Flip_Flop1 /end SUB_GROUP
 /begin REF_MEASUREMENT BCMFL_FLDRLStatus BCMFR_FRDRLStatus /end REF_MEASUREMENT
/end GROUP
/begin GROUP ExteriorLightManager_ELM_Main_sys_ELM_Main_LightActuator_BrakeLightActuator_S_R_Flip_Flop2 "ExteriorLightManager/ELM_Main_sys/ELM_Main/LightActuator/BrakeLightActuator/S-R\r\nFlip-Flop2" /end GROUP
/begin GROUP ExteriorLightManager_ELM_Main_sys_ELM_Main_LightActuator_BrakeLightActuator_S_R_Flip_Flop1 "ExteriorLightManager/ELM_Main_sys/ELM_Main/LightActuator/BrakeLightActuator/S-R\r\nFlip-Flop1" /end GROUP
/begin GROUP ExteriorLightManager_ELM_Main_sys_ELM_Main_LightActuator_BrakeLightActuator_S_R_Flip_Flop "ExteriorLightManager/ELM_Main_sys/ELM_Main/LightActuator/BrakeLightActuator/S-R\r\nFlip-Flop" /end GROUP
/begin GROUP ExteriorLightManager_ELM_Main_sys_ELM_Main_LightActuator_BrakeLightActuator_BYPASS_REQUEST_BRAKE_LIGHT "ExteriorLightManager/ELM_Main_sys/ELM_Main/LightActuator/BrakeLightActuator/BYPASS_REQUEST_BRAKE_LIGHT" /begin REF_CHARACTERISTIC BYPASS_REQUEST_BRAKE_LIGHT /end REF_CHARACTERISTIC /end GROUP
/begin GROUP ExteriorLightManager_ELM_Main_sys_ELM_Main_LightActuator_BrakeLightActuator_BYPASS_CONTROL_CONSTANT_BRAKE_LIGHT1 "ExteriorLightManager/ELM_Main_sys/ELM_Main/LightActuator/BrakeLightActuator/BYPASS_CONTROL_CONSTANT_BRAKE_LIGHT1" /begin REF_CHARACTERISTIC BYPASS_CONTROL_CONSTANT_BRAKE_LIGHT /end REF_CHARACTERISTIC /end GROUP
/begin GROUP ExteriorLightManager_ELM_Main_sys_ELM_Main_LightActuator_BrakeLightActuator "ExteriorLightManager/ELM_Main_sys/ELM_Main/LightActuator/BrakeLightActuator"
 /begin SUB_GROUP ExteriorLightManager_ELM_Main_sys_ELM_Main_LightActuator_BrakeLightActuator_BYPASS_CONTROL_CONSTANT_ALL_LIGHT1 ExteriorLightManager_ELM_Main_sys_ELM_Main_LightActuator_BrakeLightActuator_BYPASS_CONTROL_CONSTANT_BRAKE_LIGHT1 ExteriorLightManager_ELM_Main_sys_ELM_Main_LightActuator_BrakeLightActuator_BYPASS_REQUEST_ALL_LIGHT ExteriorLightManager_ELM_Main_sys_ELM_Main_LightActuator_BrakeLightActuator_BYPASS_REQUEST_BRAKE_LIGHT ExteriorLightManager_ELM_Main_sys_ELM_Main_LightActuator_BrakeLightActuator_S_R_Flip_Flop ExteriorLightManager_ELM_Main_sys_ELM_Main_LightActuator_BrakeLightActuator_S_R_Flip_Flop1 ExteriorLightManager_ELM_Main_sys_ELM_Main_LightActuator_BrakeLightActuator_S_R_Flip_Flop2 /end SUB_GROUP
/end GROUP
/begin GROUP ExteriorLightManager_ELM_Main_sys_ELM_Main_LightActuator "ExteriorLightManager/ELM_Main_sys/ELM_Main/LightActuator"
 /begin SUB_GROUP ExteriorLightManager_ELM_Main_sys_ELM_Main_LightActuator_BrakeLightActuator ExteriorLightManager_ELM_Main_sys_ELM_Main_LightActuator_DaytimeRunningLightActuator ExteriorLightManager_ELM_Main_sys_ELM_Main_LightActuator_FogLightActuator ExteriorLightManager_ELM_Main_sys_ELM_Main_LightActuator_HighBeamLightActuator ExteriorLightManager_ELM_Main_sys_ELM_Main_LightActuator_LicensePlateLampActuator ExteriorLightManager_ELM_Main_sys_ELM_Main_LightActuator_LowBeamLightActuator ExteriorLightManager_ELM_Main_sys_ELM_Main_LightActuator_MirrorLEDActuator ExteriorLightManager_ELM_Main_sys_ELM_Main_LightActuator_PositionLightActuator ExteriorLightManager_ELM_Main_sys_ELM_Main_LightActuator_ReverseLampActuator ExteriorLightManager_ELM_Main_sys_ELM_Main_LightActuator_TurnIndicatorLightActuator /end SUB_GROUP
/end GROUP
/begin GROUP ExteriorLightManager_ELM_Main_sys_ELM_Main_LeftStalkStsDetmn_Bit_Upack "ExteriorLightManager/ELM_Main_sys/ELM_Main/LeftStalkStsDetmn/Bit Upack" /begin REF_MEASUREMENT SCM_LeftStalkSwitchStatus /end REF_MEASUREMENT /end GROUP
/begin GROUP ExteriorLightManager_ELM_Main_sys_ELM_Main_LeftStalkStsDetmn "ExteriorLightManager/ELM_Main_sys/ELM_Main/LeftStalkStsDetmn"
 /begin SUB_GROUP ExteriorLightManager_ELM_Main_sys_ELM_Main_LeftStalkStsDetmn_Bit_Upack /end SUB_GROUP
/end GROUP
/begin GROUP ExteriorLightManager_ELM_Main_sys_ELM_Main_IntelligentExteriorLightingControl_WelcomeLight_WelcomeLightSetting "ExteriorLightManager/ELM_Main_sys/ELM_Main/IntelligentExteriorLightingControl/WelcomeLight/WelcomeLightSetting" /begin REF_MEASUREMENT Nv_WelcomeLightSet S2S_WelcomeLightSet /end REF_MEASUREMENT /end GROUP
/begin GROUP ExteriorLightManager_ELM_Main_sys_ELM_Main_IntelligentExteriorLightingControl_WelcomeLight_WelcomeLightOperation_WELCOME_LIGHT_TIMER "ExteriorLightManager/ELM_Main_sys/ELM_Main/IntelligentExteriorLightingControl/WelcomeLight/WelcomeLightOperation/WELCOME_LIGHT_TIMER" /begin REF_CHARACTERISTIC WELCOME_LIGHT_TIMER /end REF_CHARACTERISTIC /end GROUP
/begin GROUP ExteriorLightManager_ELM_Main_sys_ELM_Main_IntelligentExteriorLightingControl_WelcomeLight_WelcomeLightOperation_Timer "ExteriorLightManager/ELM_Main_sys/ELM_Main/IntelligentExteriorLightingControl/WelcomeLight/WelcomeLightOperation/Timer" /end GROUP
/begin GROUP ExteriorLightManager_ELM_Main_sys_ELM_Main_IntelligentExteriorLightingControl_WelcomeLight_WelcomeLightOperation_S_R_Flip_Flop "ExteriorLightManager/ELM_Main_sys/ELM_Main/IntelligentExteriorLightingControl/WelcomeLight/WelcomeLightOperation/S-R\r\nFlip-Flop" /end GROUP
/begin GROUP ExteriorLightManager_ELM_Main_sys_ELM_Main_IntelligentExteriorLightingControl_WelcomeLight_WelcomeLightOperation_ELM_Ts_P "ExteriorLightManager/ELM_Main_sys/ELM_Main/IntelligentExteriorLightingControl/WelcomeLight/WelcomeLightOperation/ELM_Ts_P" /begin REF_CHARACTERISTIC ELM_Ts_P /end REF_CHARACTERISTIC /end GROUP
/begin GROUP ExteriorLightManager_ELM_Main_sys_ELM_Main_IntelligentExteriorLightingControl_WelcomeLight_WelcomeLightOperation_Detect_Rise_Positive2 "ExteriorLightManager/ELM_Main_sys/ELM_Main/IntelligentExteriorLightingControl/WelcomeLight/WelcomeLightOperation/Detect Rise\r\nPositive2" /end GROUP
/begin GROUP ExteriorLightManager_ELM_Main_sys_ELM_Main_IntelligentExteriorLightingControl_WelcomeLight_WelcomeLightOperation_Detect_Rise_Positive1 "ExteriorLightManager/ELM_Main_sys/ELM_Main/IntelligentExteriorLightingControl/WelcomeLight/WelcomeLightOperation/Detect Rise\r\nPositive1" /end GROUP
/begin GROUP ExteriorLightManager_ELM_Main_sys_ELM_Main_IntelligentExteriorLightingControl_WelcomeLight_WelcomeLightOperation "ExteriorLightManager/ELM_Main_sys/ELM_Main/IntelligentExteriorLightingControl/WelcomeLight/WelcomeLightOperation"
 /begin SUB_GROUP ExteriorLightManager_ELM_Main_sys_ELM_Main_IntelligentExteriorLightingControl_WelcomeLight_WelcomeLightOperation_Detect_Rise_Positive1 ExteriorLightManager_ELM_Main_sys_ELM_Main_IntelligentExteriorLightingControl_WelcomeLight_WelcomeLightOperation_Detect_Rise_Positive2 ExteriorLightManager_ELM_Main_sys_ELM_Main_IntelligentExteriorLightingControl_WelcomeLight_WelcomeLightOperation_ELM_Ts_P ExteriorLightManager_ELM_Main_sys_ELM_Main_IntelligentExteriorLightingControl_WelcomeLight_WelcomeLightOperation_S_R_Flip_Flop ExteriorLightManager_ELM_Main_sys_ELM_Main_IntelligentExteriorLightingControl_WelcomeLight_WelcomeLightOperation_Timer ExteriorLightManager_ELM_Main_sys_ELM_Main_IntelligentExteriorLightingControl_WelcomeLight_WelcomeLightOperation_WELCOME_LIGHT_TIMER /end SUB_GROUP
 /begin REF_MEASUREMENT CLM_DoorLockUnlockType /end REF_MEASUREMENT
/end GROUP
/begin GROUP ExteriorLightManager_ELM_Main_sys_ELM_Main_IntelligentExteriorLightingControl_WelcomeLight "ExteriorLightManager/ELM_Main_sys/ELM_Main/IntelligentExteriorLightingControl/WelcomeLight"
 /begin SUB_GROUP ExteriorLightManager_ELM_Main_sys_ELM_Main_IntelligentExteriorLightingControl_WelcomeLight_WelcomeLightOperation ExteriorLightManager_ELM_Main_sys_ELM_Main_IntelligentExteriorLightingControl_WelcomeLight_WelcomeLightSetting /end SUB_GROUP
/end GROUP
/begin GROUP ExteriorLightManager_ELM_Main_sys_ELM_Main_IntelligentExteriorLightingControl_OutsideMirrorLedWarningControl_MirrorLedWarningPreconditionDetmn "ExteriorLightManager/ELM_Main_sys/ELM_Main/IntelligentExteriorLightingControl/OutsideMirrorLedWarningControl/MirrorLedWarningPreconditionDetmn" /end GROUP
/begin GROUP ExteriorLightManager_ELM_Main_sys_ELM_Main_IntelligentExteriorLightingControl_OutsideMirrorLedWarningControl_MirrorLedWarningFR "ExteriorLightManager/ELM_Main_sys/ELM_Main/IntelligentExteriorLightingControl/OutsideMirrorLedWarningControl/MirrorLedWarningFR"
 /begin REF_MEASUREMENT FCAM_FRBSDWarningRequest FCAM_FRDOWWarningRequest FCAM_FRRCTAWarningRequest /end REF_MEASUREMENT
/end GROUP
/begin GROUP ExteriorLightManager_ELM_Main_sys_ELM_Main_IntelligentExteriorLightingControl_OutsideMirrorLedWarningControl_MirrorLedWarningFL "ExteriorLightManager/ELM_Main_sys/ELM_Main/IntelligentExteriorLightingControl/OutsideMirrorLedWarningControl/MirrorLedWarningFL"
 /begin REF_MEASUREMENT FCAM_FLBSDWarningRequest FCAM_FLDOWWarningRequest IF_FCAM_FLRCTAWarningRequest /end REF_MEASUREMENT
/end GROUP
/begin GROUP ExteriorLightManager_ELM_Main_sys_ELM_Main_IntelligentExteriorLightingControl_OutsideMirrorLedWarningControl_MirrorLEDRequestGenerator_Level2WarningReqGenerator_TURN_LIGHT_DUTY_CYCLE "ExteriorLightManager/ELM_Main_sys/ELM_Main/IntelligentExteriorLightingControl/OutsideMirrorLedWarningControl/MirrorLEDRequestGenerator/Level2WarningReqGenerator/TURN_LIGHT_DUTY_CYCLE" /begin REF_CHARACTERISTIC TURN_LIGHT_DUTY_CYCLE /end REF_CHARACTERISTIC /end GROUP
/begin GROUP ExteriorLightManager_ELM_Main_sys_ELM_Main_IntelligentExteriorLightingControl_OutsideMirrorLedWarningControl_MirrorLEDRequestGenerator_Level2WarningReqGenerator_PWMGenerator "ExteriorLightManager/ELM_Main_sys/ELM_Main/IntelligentExteriorLightingControl/OutsideMirrorLedWarningControl/MirrorLEDRequestGenerator/Level2WarningReqGenerator/PWMGenerator" /end GROUP
/begin GROUP ExteriorLightManager_ELM_Main_sys_ELM_Main_IntelligentExteriorLightingControl_OutsideMirrorLedWarningControl_MirrorLEDRequestGenerator_Level2WarningReqGenerator_MIRROR_LED_FREQUENCY "ExteriorLightManager/ELM_Main_sys/ELM_Main/IntelligentExteriorLightingControl/OutsideMirrorLedWarningControl/MirrorLEDRequestGenerator/Level2WarningReqGenerator/MIRROR_LED_FREQUENCY" /begin REF_CHARACTERISTIC MIRROR_LED_FREQUENCY /end REF_CHARACTERISTIC /end GROUP
/begin GROUP ExteriorLightManager_ELM_Main_sys_ELM_Main_IntelligentExteriorLightingControl_OutsideMirrorLedWarningControl_MirrorLEDRequestGenerator_Level2WarningReqGenerator_ELM_Ts_P "ExteriorLightManager/ELM_Main_sys/ELM_Main/IntelligentExteriorLightingControl/OutsideMirrorLedWarningControl/MirrorLEDRequestGenerator/Level2WarningReqGenerator/ELM_Ts_P" /begin REF_CHARACTERISTIC ELM_Ts_P /end REF_CHARACTERISTIC /end GROUP
/begin GROUP ExteriorLightManager_ELM_Main_sys_ELM_Main_IntelligentExteriorLightingControl_OutsideMirrorLedWarningControl_MirrorLEDRequestGenerator_Level2WarningReqGenerator "ExteriorLightManager/ELM_Main_sys/ELM_Main/IntelligentExteriorLightingControl/OutsideMirrorLedWarningControl/MirrorLEDRequestGenerator/Level2WarningReqGenerator"
 /begin SUB_GROUP ExteriorLightManager_ELM_Main_sys_ELM_Main_IntelligentExteriorLightingControl_OutsideMirrorLedWarningControl_MirrorLEDRequestGenerator_Level2WarningReqGenerator_ELM_Ts_P ExteriorLightManager_ELM_Main_sys_ELM_Main_IntelligentExteriorLightingControl_OutsideMirrorLedWarningControl_MirrorLEDRequestGenerator_Level2WarningReqGenerator_MIRROR_LED_FREQUENCY ExteriorLightManager_ELM_Main_sys_ELM_Main_IntelligentExteriorLightingControl_OutsideMirrorLedWarningControl_MirrorLEDRequestGenerator_Level2WarningReqGenerator_PWMGenerator ExteriorLightManager_ELM_Main_sys_ELM_Main_IntelligentExteriorLightingControl_OutsideMirrorLedWarningControl_MirrorLEDRequestGenerator_Level2WarningReqGenerator_TURN_LIGHT_DUTY_CYCLE /end SUB_GROUP
/end GROUP
/begin GROUP ExteriorLightManager_ELM_Main_sys_ELM_Main_IntelligentExteriorLightingControl_OutsideMirrorLedWarningControl_MirrorLEDRequestGenerator "ExteriorLightManager/ELM_Main_sys/ELM_Main/IntelligentExteriorLightingControl/OutsideMirrorLedWarningControl/MirrorLEDRequestGenerator"
 /begin SUB_GROUP ExteriorLightManager_ELM_Main_sys_ELM_Main_IntelligentExteriorLightingControl_OutsideMirrorLedWarningControl_MirrorLEDRequestGenerator_Level2WarningReqGenerator /end SUB_GROUP
/end GROUP
/begin GROUP ExteriorLightManager_ELM_Main_sys_ELM_Main_IntelligentExteriorLightingControl_OutsideMirrorLedWarningControl "ExteriorLightManager/ELM_Main_sys/ELM_Main/IntelligentExteriorLightingControl/OutsideMirrorLedWarningControl"
 /begin SUB_GROUP ExteriorLightManager_ELM_Main_sys_ELM_Main_IntelligentExteriorLightingControl_OutsideMirrorLedWarningControl_MirrorLEDRequestGenerator ExteriorLightManager_ELM_Main_sys_ELM_Main_IntelligentExteriorLightingControl_OutsideMirrorLedWarningControl_MirrorLedWarningFL ExteriorLightManager_ELM_Main_sys_ELM_Main_IntelligentExteriorLightingControl_OutsideMirrorLedWarningControl_MirrorLedWarningFR ExteriorLightManager_ELM_Main_sys_ELM_Main_IntelligentExteriorLightingControl_OutsideMirrorLedWarningControl_MirrorLedWarningPreconditionDetmn /end SUB_GROUP
/end GROUP
/begin GROUP ExteriorLightManager_ELM_Main_sys_ELM_Main_IntelligentExteriorLightingControl_FollowmeHomeLight_FollowmeHomeLightSetting "ExteriorLightManager/ELM_Main_sys/ELM_Main/IntelligentExteriorLightingControl/FollowmeHomeLight/FollowmeHomeLightSetting" /begin REF_MEASUREMENT Nv_FMHSet S2S_FMHSet /end REF_MEASUREMENT /end GROUP
/begin GROUP ExteriorLightManager_ELM_Main_sys_ELM_Main_IntelligentExteriorLightingControl_FollowmeHomeLight_FollowmeHomeLightControl_Timer1 "ExteriorLightManager/ELM_Main_sys/ELM_Main/IntelligentExteriorLightingControl/FollowmeHomeLight/FollowmeHomeLightControl/Timer1" /end GROUP
/begin GROUP ExteriorLightManager_ELM_Main_sys_ELM_Main_IntelligentExteriorLightingControl_FollowmeHomeLight_FollowmeHomeLightControl_Timer "ExteriorLightManager/ELM_Main_sys/ELM_Main/IntelligentExteriorLightingControl/FollowmeHomeLight/FollowmeHomeLightControl/Timer" /end GROUP
/begin GROUP ExteriorLightManager_ELM_Main_sys_ELM_Main_IntelligentExteriorLightingControl_FollowmeHomeLight_FollowmeHomeLightControl_S_R_Flip_Flop "ExteriorLightManager/ELM_Main_sys/ELM_Main/IntelligentExteriorLightingControl/FollowmeHomeLight/FollowmeHomeLightControl/S-R\r\nFlip-Flop" /end GROUP
/begin GROUP ExteriorLightManager_ELM_Main_sys_ELM_Main_IntelligentExteriorLightingControl_FollowmeHomeLight_FollowmeHomeLightControl_STALK_SWITCH_HOLD_TIMER "ExteriorLightManager/ELM_Main_sys/ELM_Main/IntelligentExteriorLightingControl/FollowmeHomeLight/FollowmeHomeLightControl/STALK_SWITCH_HOLD_TIMER" /begin REF_CHARACTERISTIC STALK_SWITCH_HOLD_TIMER /end REF_CHARACTERISTIC /end GROUP
/begin GROUP ExteriorLightManager_ELM_Main_sys_ELM_Main_IntelligentExteriorLightingControl_FollowmeHomeLight_FollowmeHomeLightControl_FollowmeHomeActivationTriggerDetect "ExteriorLightManager/ELM_Main_sys/ELM_Main/IntelligentExteriorLightingControl/FollowmeHomeLight/FollowmeHomeLightControl/FollowmeHomeActivationTriggerDetect" /end GROUP
/begin GROUP ExteriorLightManager_ELM_Main_sys_ELM_Main_IntelligentExteriorLightingControl_FollowmeHomeLight_FollowmeHomeLightControl_FollowmeHomeActivationPreconditionDetmn_Timer "ExteriorLightManager/ELM_Main_sys/ELM_Main/IntelligentExteriorLightingControl/FollowmeHomeLight/FollowmeHomeLightControl/FollowmeHomeActivationPreconditionDetmn/Timer" /end GROUP
/begin GROUP ExteriorLightManager_ELM_Main_sys_ELM_Main_IntelligentExteriorLightingControl_FollowmeHomeLight_FollowmeHomeLightControl_FollowmeHomeActivationPreconditionDetmn_S_R_Flip_Flop "ExteriorLightManager/ELM_Main_sys/ELM_Main/IntelligentExteriorLightingControl/FollowmeHomeLight/FollowmeHomeLightControl/FollowmeHomeActivationPreconditionDetmn/S-R\r\nFlip-Flop" /end GROUP
/begin GROUP ExteriorLightManager_ELM_Main_sys_ELM_Main_IntelligentExteriorLightingControl_FollowmeHomeLight_FollowmeHomeLightControl_FollowmeHomeActivationPreconditionDetmn_STALK_SWITCH_HOLD_TIMER "ExteriorLightManager/ELM_Main_sys/ELM_Main/IntelligentExteriorLightingControl/FollowmeHomeLight/FollowmeHomeLightControl/FollowmeHomeActivationPreconditionDetmn/STALK_SWITCH_HOLD_TIMER" /begin REF_CHARACTERISTIC STALK_SWITCH_HOLD_TIMER /end REF_CHARACTERISTIC /end GROUP
/begin GROUP ExteriorLightManager_ELM_Main_sys_ELM_Main_IntelligentExteriorLightingControl_FollowmeHomeLight_FollowmeHomeLightControl_FollowmeHomeActivationPreconditionDetmn_ELM_Ts_P "ExteriorLightManager/ELM_Main_sys/ELM_Main/IntelligentExteriorLightingControl/FollowmeHomeLight/FollowmeHomeLightControl/FollowmeHomeActivationPreconditionDetmn/ELM_Ts_P" /begin REF_CHARACTERISTIC ELM_Ts_P /end REF_CHARACTERISTIC /end GROUP
/begin GROUP ExteriorLightManager_ELM_Main_sys_ELM_Main_IntelligentExteriorLightingControl_FollowmeHomeLight_FollowmeHomeLightControl_FollowmeHomeActivationPreconditionDetmn_Detect_Rise_Positive "ExteriorLightManager/ELM_Main_sys/ELM_Main/IntelligentExteriorLightingControl/FollowmeHomeLight/FollowmeHomeLightControl/FollowmeHomeActivationPreconditionDetmn/Detect Rise\r\nPositive" /end GROUP
/begin GROUP ExteriorLightManager_ELM_Main_sys_ELM_Main_IntelligentExteriorLightingControl_FollowmeHomeLight_FollowmeHomeLightControl_FollowmeHomeActivationPreconditionDetmn_Detect_Decrease "ExteriorLightManager/ELM_Main_sys/ELM_Main/IntelligentExteriorLightingControl/FollowmeHomeLight/FollowmeHomeLightControl/FollowmeHomeActivationPreconditionDetmn/Detect\r\nDecrease" /end GROUP
/begin GROUP ExteriorLightManager_ELM_Main_sys_ELM_Main_IntelligentExteriorLightingControl_FollowmeHomeLight_FollowmeHomeLightControl_FollowmeHomeActivationPreconditionDetmn "ExteriorLightManager/ELM_Main_sys/ELM_Main/IntelligentExteriorLightingControl/FollowmeHomeLight/FollowmeHomeLightControl/FollowmeHomeActivationPreconditionDetmn"
 /begin SUB_GROUP ExteriorLightManager_ELM_Main_sys_ELM_Main_IntelligentExteriorLightingControl_FollowmeHomeLight_FollowmeHomeLightControl_FollowmeHomeActivationPreconditionDetmn_Detect_Decrease ExteriorLightManager_ELM_Main_sys_ELM_Main_IntelligentExteriorLightingControl_FollowmeHomeLight_FollowmeHomeLightControl_FollowmeHomeActivationPreconditionDetmn_Detect_Rise_Positive ExteriorLightManager_ELM_Main_sys_ELM_Main_IntelligentExteriorLightingControl_FollowmeHomeLight_FollowmeHomeLightControl_FollowmeHomeActivationPreconditionDetmn_ELM_Ts_P ExteriorLightManager_ELM_Main_sys_ELM_Main_IntelligentExteriorLightingControl_FollowmeHomeLight_FollowmeHomeLightControl_FollowmeHomeActivationPreconditionDetmn_STALK_SWITCH_HOLD_TIMER ExteriorLightManager_ELM_Main_sys_ELM_Main_IntelligentExteriorLightingControl_FollowmeHomeLight_FollowmeHomeLightControl_FollowmeHomeActivationPreconditionDetmn_S_R_Flip_Flop ExteriorLightManager_ELM_Main_sys_ELM_Main_IntelligentExteriorLightingControl_FollowmeHomeLight_FollowmeHomeLightControl_FollowmeHomeActivationPreconditionDetmn_Timer /end SUB_GROUP
/end GROUP
/begin GROUP ExteriorLightManager_ELM_Main_sys_ELM_Main_IntelligentExteriorLightingControl_FollowmeHomeLight_FollowmeHomeLightControl_FollowmeHomeActivationDurationTimeClcn_FOLLOW_ME_HOME_MAXIMUM_DURATION_TIME "ExteriorLightManager/ELM_Main_sys/ELM_Main/IntelligentExteriorLightingControl/FollowmeHomeLight/FollowmeHomeLightControl/FollowmeHomeActivationDurationTimeClcn/FOLLOW_ME_HOME_MAXIMUM_DURATION_TIME" /begin REF_CHARACTERISTIC FOLLOW_ME_HOME_MAXIMUM_DURATION_TIME /end REF_CHARACTERISTIC /end GROUP
/begin GROUP ExteriorLightManager_ELM_Main_sys_ELM_Main_IntelligentExteriorLightingControl_FollowmeHomeLight_FollowmeHomeLightControl_FollowmeHomeActivationDurationTimeClcn_FOLLOW_ME_HOME_INCREASED_DURATION_TIME "ExteriorLightManager/ELM_Main_sys/ELM_Main/IntelligentExteriorLightingControl/FollowmeHomeLight/FollowmeHomeLightControl/FollowmeHomeActivationDurationTimeClcn/FOLLOW_ME_HOME_INCREASED_DURATION_TIME" /begin REF_CHARACTERISTIC FOLLOW_ME_HOME_INCREASED_DURATION_TIME /end REF_CHARACTERISTIC /end GROUP
/begin GROUP ExteriorLightManager_ELM_Main_sys_ELM_Main_IntelligentExteriorLightingControl_FollowmeHomeLight_FollowmeHomeLightControl_FollowmeHomeActivationDurationTimeClcn_Detect_Increase "ExteriorLightManager/ELM_Main_sys/ELM_Main/IntelligentExteriorLightingControl/FollowmeHomeLight/FollowmeHomeLightControl/FollowmeHomeActivationDurationTimeClcn/Detect\r\nIncrease" /end GROUP
/begin GROUP ExteriorLightManager_ELM_Main_sys_ELM_Main_IntelligentExteriorLightingControl_FollowmeHomeLight_FollowmeHomeLightControl_FollowmeHomeActivationDurationTimeClcn "ExteriorLightManager/ELM_Main_sys/ELM_Main/IntelligentExteriorLightingControl/FollowmeHomeLight/FollowmeHomeLightControl/FollowmeHomeActivationDurationTimeClcn"
 /begin SUB_GROUP ExteriorLightManager_ELM_Main_sys_ELM_Main_IntelligentExteriorLightingControl_FollowmeHomeLight_FollowmeHomeLightControl_FollowmeHomeActivationDurationTimeClcn_Detect_Increase ExteriorLightManager_ELM_Main_sys_ELM_Main_IntelligentExteriorLightingControl_FollowmeHomeLight_FollowmeHomeLightControl_FollowmeHomeActivationDurationTimeClcn_FOLLOW_ME_HOME_INCREASED_DURATION_TIME ExteriorLightManager_ELM_Main_sys_ELM_Main_IntelligentExteriorLightingControl_FollowmeHomeLight_FollowmeHomeLightControl_FollowmeHomeActivationDurationTimeClcn_FOLLOW_ME_HOME_MAXIMUM_DURATION_TIME /end SUB_GROUP
/end GROUP
/begin GROUP ExteriorLightManager_ELM_Main_sys_ELM_Main_IntelligentExteriorLightingControl_FollowmeHomeLight_FollowmeHomeLightControl_ELM_Ts_P1 "ExteriorLightManager/ELM_Main_sys/ELM_Main/IntelligentExteriorLightingControl/FollowmeHomeLight/FollowmeHomeLightControl/ELM_Ts_P1" /begin REF_CHARACTERISTIC ELM_Ts_P /end REF_CHARACTERISTIC /end GROUP
/begin GROUP ExteriorLightManager_ELM_Main_sys_ELM_Main_IntelligentExteriorLightingControl_FollowmeHomeLight_FollowmeHomeLightControl_ELM_Ts_P "ExteriorLightManager/ELM_Main_sys/ELM_Main/IntelligentExteriorLightingControl/FollowmeHomeLight/FollowmeHomeLightControl/ELM_Ts_P" /begin REF_CHARACTERISTIC ELM_Ts_P /end REF_CHARACTERISTIC /end GROUP
/begin GROUP ExteriorLightManager_ELM_Main_sys_ELM_Main_IntelligentExteriorLightingControl_FollowmeHomeLight_FollowmeHomeLightControl_Detect_Rise_Positive1 "ExteriorLightManager/ELM_Main_sys/ELM_Main/IntelligentExteriorLightingControl/FollowmeHomeLight/FollowmeHomeLightControl/Detect Rise\r\nPositive1" /end GROUP
/begin GROUP ExteriorLightManager_ELM_Main_sys_ELM_Main_IntelligentExteriorLightingControl_FollowmeHomeLight_FollowmeHomeLightControl_Detect_Rise_Positive "ExteriorLightManager/ELM_Main_sys/ELM_Main/IntelligentExteriorLightingControl/FollowmeHomeLight/FollowmeHomeLightControl/Detect Rise\r\nPositive" /end GROUP
/begin GROUP ExteriorLightManager_ELM_Main_sys_ELM_Main_IntelligentExteriorLightingControl_FollowmeHomeLight_FollowmeHomeLightControl "ExteriorLightManager/ELM_Main_sys/ELM_Main/IntelligentExteriorLightingControl/FollowmeHomeLight/FollowmeHomeLightControl"
 /begin SUB_GROUP ExteriorLightManager_ELM_Main_sys_ELM_Main_IntelligentExteriorLightingControl_FollowmeHomeLight_FollowmeHomeLightControl_Detect_Rise_Positive ExteriorLightManager_ELM_Main_sys_ELM_Main_IntelligentExteriorLightingControl_FollowmeHomeLight_FollowmeHomeLightControl_Detect_Rise_Positive1 ExteriorLightManager_ELM_Main_sys_ELM_Main_IntelligentExteriorLightingControl_FollowmeHomeLight_FollowmeHomeLightControl_ELM_Ts_P ExteriorLightManager_ELM_Main_sys_ELM_Main_IntelligentExteriorLightingControl_FollowmeHomeLight_FollowmeHomeLightControl_ELM_Ts_P1 ExteriorLightManager_ELM_Main_sys_ELM_Main_IntelligentExteriorLightingControl_FollowmeHomeLight_FollowmeHomeLightControl_FollowmeHomeActivationDurationTimeClcn ExteriorLightManager_ELM_Main_sys_ELM_Main_IntelligentExteriorLightingControl_FollowmeHomeLight_FollowmeHomeLightControl_FollowmeHomeActivationPreconditionDetmn ExteriorLightManager_ELM_Main_sys_ELM_Main_IntelligentExteriorLightingControl_FollowmeHomeLight_FollowmeHomeLightControl_FollowmeHomeActivationTriggerDetect ExteriorLightManager_ELM_Main_sys_ELM_Main_IntelligentExteriorLightingControl_FollowmeHomeLight_FollowmeHomeLightControl_STALK_SWITCH_HOLD_TIMER ExteriorLightManager_ELM_Main_sys_ELM_Main_IntelligentExteriorLightingControl_FollowmeHomeLight_FollowmeHomeLightControl_S_R_Flip_Flop ExteriorLightManager_ELM_Main_sys_ELM_Main_IntelligentExteriorLightingControl_FollowmeHomeLight_FollowmeHomeLightControl_Timer ExteriorLightManager_ELM_Main_sys_ELM_Main_IntelligentExteriorLightingControl_FollowmeHomeLight_FollowmeHomeLightControl_Timer1 /end SUB_GROUP
/end GROUP
/begin GROUP ExteriorLightManager_ELM_Main_sys_ELM_Main_IntelligentExteriorLightingControl_FollowmeHomeLight "ExteriorLightManager/ELM_Main_sys/ELM_Main/IntelligentExteriorLightingControl/FollowmeHomeLight"
 /begin SUB_GROUP ExteriorLightManager_ELM_Main_sys_ELM_Main_IntelligentExteriorLightingControl_FollowmeHomeLight_FollowmeHomeLightControl ExteriorLightManager_ELM_Main_sys_ELM_Main_IntelligentExteriorLightingControl_FollowmeHomeLight_FollowmeHomeLightSetting /end SUB_GROUP
/end GROUP
/begin GROUP ExteriorLightManager_ELM_Main_sys_ELM_Main_IntelligentExteriorLightingControl_AutoLevellingHeadlamp_HeadLampTargetPositionControl_TargetPositionCalculation_TARGET_POSITION_UPPER_LIMIT1 "ExteriorLightManager/ELM_Main_sys/ELM_Main/IntelligentExteriorLightingControl/AutoLevellingHeadlamp/HeadLampTargetPositionControl/TargetPositionCalculation/TARGET_POSITION_UPPER_LIMIT1" /begin REF_CHARACTERISTIC TARGET_POSITION_UPPER_LIMIT /end REF_CHARACTERISTIC /end GROUP
/begin GROUP ExteriorLightManager_ELM_Main_sys_ELM_Main_IntelligentExteriorLightingControl_AutoLevellingHeadlamp_HeadLampTargetPositionControl_TargetPositionCalculation_TARGET_POSITION_LOWER_LIMIT1 "ExteriorLightManager/ELM_Main_sys/ELM_Main/IntelligentExteriorLightingControl/AutoLevellingHeadlamp/HeadLampTargetPositionControl/TargetPositionCalculation/TARGET_POSITION_LOWER_LIMIT1" /begin REF_CHARACTERISTIC TARGET_POSITION_LOWER_LIMIT /end REF_CHARACTERISTIC /end GROUP
/begin GROUP ExteriorLightManager_ELM_Main_sys_ELM_Main_IntelligentExteriorLightingControl_AutoLevellingHeadlamp_HeadLampTargetPositionControl_TargetPositionCalculation_TARGET_POSITION_INITIAL1 "ExteriorLightManager/ELM_Main_sys/ELM_Main/IntelligentExteriorLightingControl/AutoLevellingHeadlamp/HeadLampTargetPositionControl/TargetPositionCalculation/TARGET_POSITION_INITIAL1" /begin REF_CHARACTERISTIC TARGET_POSITION_INITIAL /end REF_CHARACTERISTIC /end GROUP
/begin GROUP ExteriorLightManager_ELM_Main_sys_ELM_Main_IntelligentExteriorLightingControl_AutoLevellingHeadlamp_HeadLampTargetPositionControl_TargetPositionCalculation "ExteriorLightManager/ELM_Main_sys/ELM_Main/IntelligentExteriorLightingControl/AutoLevellingHeadlamp/HeadLampTargetPositionControl/TargetPositionCalculation"
 /begin SUB_GROUP ExteriorLightManager_ELM_Main_sys_ELM_Main_IntelligentExteriorLightingControl_AutoLevellingHeadlamp_HeadLampTargetPositionControl_TargetPositionCalculation_TARGET_POSITION_INITIAL1 ExteriorLightManager_ELM_Main_sys_ELM_Main_IntelligentExteriorLightingControl_AutoLevellingHeadlamp_HeadLampTargetPositionControl_TargetPositionCalculation_TARGET_POSITION_LOWER_LIMIT1 ExteriorLightManager_ELM_Main_sys_ELM_Main_IntelligentExteriorLightingControl_AutoLevellingHeadlamp_HeadLampTargetPositionControl_TargetPositionCalculation_TARGET_POSITION_UPPER_LIMIT1 /end SUB_GROUP
/end GROUP
/begin GROUP ExteriorLightManager_ELM_Main_sys_ELM_Main_IntelligentExteriorLightingControl_AutoLevellingHeadlamp_HeadLampTargetPositionControl_Subsystem_STANDSTILL_VELOCITY_THRESHOLD "ExteriorLightManager/ELM_Main_sys/ELM_Main/IntelligentExteriorLightingControl/AutoLevellingHeadlamp/HeadLampTargetPositionControl/Subsystem/STANDSTILL_VELOCITY_THRESHOLD" /begin REF_CHARACTERISTIC STANDSTILL_VELOCITY_THRESHOLD /end REF_CHARACTERISTIC /end GROUP
/begin GROUP ExteriorLightManager_ELM_Main_sys_ELM_Main_IntelligentExteriorLightingControl_AutoLevellingHeadlamp_HeadLampTargetPositionControl_Subsystem_K2_REAR_HEIGHT_SENSOR_PARAMETER_VF8 "ExteriorLightManager/ELM_Main_sys/ELM_Main/IntelligentExteriorLightingControl/AutoLevellingHeadlamp/HeadLampTargetPositionControl/Subsystem/K2_REAR_HEIGHT_SENSOR_PARAMETER_VF8" /begin REF_CHARACTERISTIC K2_REAR_HEIGHT_SENSOR_PARAMETER_VF8 /end REF_CHARACTERISTIC /end GROUP
/begin GROUP ExteriorLightManager_ELM_Main_sys_ELM_Main_IntelligentExteriorLightingControl_AutoLevellingHeadlamp_HeadLampTargetPositionControl_Subsystem_K1_FRONT_HEIGHT_SENSOR_PARAMETER_VF8 "ExteriorLightManager/ELM_Main_sys/ELM_Main/IntelligentExteriorLightingControl/AutoLevellingHeadlamp/HeadLampTargetPositionControl/Subsystem/K1_FRONT_HEIGHT_SENSOR_PARAMETER_VF8" /begin REF_CHARACTERISTIC K1_FRONT_HEIGHT_SENSOR_PARAMETER_VF8 /end REF_CHARACTERISTIC /end GROUP
/begin GROUP ExteriorLightManager_ELM_Main_sys_ELM_Main_IntelligentExteriorLightingControl_AutoLevellingHeadlamp_HeadLampTargetPositionControl_Subsystem_INITIAL_REAR_HEIGHT_SENSOR_VOLTAGE_VF8 "ExteriorLightManager/ELM_Main_sys/ELM_Main/IntelligentExteriorLightingControl/AutoLevellingHeadlamp/HeadLampTargetPositionControl/Subsystem/INITIAL_REAR_HEIGHT_SENSOR_VOLTAGE_VF8" /begin REF_CHARACTERISTIC INITIAL_REAR_HEIGHT_SENSOR_VOLTAGE_VF8 /end REF_CHARACTERISTIC /end GROUP
/begin GROUP ExteriorLightManager_ELM_Main_sys_ELM_Main_IntelligentExteriorLightingControl_AutoLevellingHeadlamp_HeadLampTargetPositionControl_Subsystem_INITIAL_FRONT_HEIGHT_SENSOR_VOLTAGE_VF8 "ExteriorLightManager/ELM_Main_sys/ELM_Main/IntelligentExteriorLightingControl/AutoLevellingHeadlamp/HeadLampTargetPositionControl/Subsystem/INITIAL_FRONT_HEIGHT_SENSOR_VOLTAGE_VF8" /begin REF_CHARACTERISTIC INITIAL_FRONT_HEIGHT_SENSOR_VOLTAGE_VF8 /end REF_CHARACTERISTIC /end GROUP
/begin GROUP ExteriorLightManager_ELM_Main_sys_ELM_Main_IntelligentExteriorLightingControl_AutoLevellingHeadlamp_HeadLampTargetPositionControl_Subsystem_DISTANCE_FRONT_REAR_AXLE "ExteriorLightManager/ELM_Main_sys/ELM_Main/IntelligentExteriorLightingControl/AutoLevellingHeadlamp/HeadLampTargetPositionControl/Subsystem/DISTANCE_FRONT_REAR_AXLE" /begin REF_CHARACTERISTIC DISTANCE_FRONT_REAR_AXLE /end REF_CHARACTERISTIC /end GROUP
/begin GROUP ExteriorLightManager_ELM_Main_sys_ELM_Main_IntelligentExteriorLightingControl_AutoLevellingHeadlamp_HeadLampTargetPositionControl_Subsystem "ExteriorLightManager/ELM_Main_sys/ELM_Main/IntelligentExteriorLightingControl/AutoLevellingHeadlamp/HeadLampTargetPositionControl/Subsystem"
 /begin SUB_GROUP ExteriorLightManager_ELM_Main_sys_ELM_Main_IntelligentExteriorLightingControl_AutoLevellingHeadlamp_HeadLampTargetPositionControl_Subsystem_DISTANCE_FRONT_REAR_AXLE ExteriorLightManager_ELM_Main_sys_ELM_Main_IntelligentExteriorLightingControl_AutoLevellingHeadlamp_HeadLampTargetPositionControl_Subsystem_INITIAL_FRONT_HEIGHT_SENSOR_VOLTAGE_VF8 ExteriorLightManager_ELM_Main_sys_ELM_Main_IntelligentExteriorLightingControl_AutoLevellingHeadlamp_HeadLampTargetPositionControl_Subsystem_INITIAL_REAR_HEIGHT_SENSOR_VOLTAGE_VF8 ExteriorLightManager_ELM_Main_sys_ELM_Main_IntelligentExteriorLightingControl_AutoLevellingHeadlamp_HeadLampTargetPositionControl_Subsystem_K1_FRONT_HEIGHT_SENSOR_PARAMETER_VF8 ExteriorLightManager_ELM_Main_sys_ELM_Main_IntelligentExteriorLightingControl_AutoLevellingHeadlamp_HeadLampTargetPositionControl_Subsystem_K2_REAR_HEIGHT_SENSOR_PARAMETER_VF8 ExteriorLightManager_ELM_Main_sys_ELM_Main_IntelligentExteriorLightingControl_AutoLevellingHeadlamp_HeadLampTargetPositionControl_Subsystem_STANDSTILL_VELOCITY_THRESHOLD /end SUB_GROUP
 /begin REF_MEASUREMENT BCMFL_FrntHeightSnsrVolt BCMRE_ReHeightSnsrVolt /end REF_MEASUREMENT
/end GROUP
/begin GROUP ExteriorLightManager_ELM_Main_sys_ELM_Main_IntelligentExteriorLightingControl_AutoLevellingHeadlamp_HeadLampTargetPositionControl "ExteriorLightManager/ELM_Main_sys/ELM_Main/IntelligentExteriorLightingControl/AutoLevellingHeadlamp/HeadLampTargetPositionControl"
 /begin SUB_GROUP ExteriorLightManager_ELM_Main_sys_ELM_Main_IntelligentExteriorLightingControl_AutoLevellingHeadlamp_HeadLampTargetPositionControl_Subsystem ExteriorLightManager_ELM_Main_sys_ELM_Main_IntelligentExteriorLightingControl_AutoLevellingHeadlamp_HeadLampTargetPositionControl_TargetPositionCalculation /end SUB_GROUP
/end GROUP
/begin GROUP ExteriorLightManager_ELM_Main_sys_ELM_Main_IntelligentExteriorLightingControl_AutoLevellingHeadlamp_AHLWorkingModeDetmn "ExteriorLightManager/ELM_Main_sys/ELM_Main/IntelligentExteriorLightingControl/AutoLevellingHeadlamp/AHLWorkingModeDetmn"
 /begin REF_MEASUREMENT BCMFL_FrontHeightSensorStatus BCMRE_RearHeightSensorStatus HLML_MotorTemperatureInfo HLMR_MotorTemperatureInfo /end REF_MEASUREMENT
/end GROUP
/begin GROUP ExteriorLightManager_ELM_Main_sys_ELM_Main_IntelligentExteriorLightingControl_AutoLevellingHeadlamp "ExteriorLightManager/ELM_Main_sys/ELM_Main/IntelligentExteriorLightingControl/AutoLevellingHeadlamp"
 /begin SUB_GROUP ExteriorLightManager_ELM_Main_sys_ELM_Main_IntelligentExteriorLightingControl_AutoLevellingHeadlamp_AHLWorkingModeDetmn ExteriorLightManager_ELM_Main_sys_ELM_Main_IntelligentExteriorLightingControl_AutoLevellingHeadlamp_HeadLampTargetPositionControl /end SUB_GROUP
/end GROUP
/begin GROUP ExteriorLightManager_ELM_Main_sys_ELM_Main_IntelligentExteriorLightingControl_AutoHighBeam_S_R_Flip_Flop1 "ExteriorLightManager/ELM_Main_sys/ELM_Main/IntelligentExteriorLightingControl/AutoHighBeam/S-R\r\nFlip-Flop1" /end GROUP
/begin GROUP ExteriorLightManager_ELM_Main_sys_ELM_Main_IntelligentExteriorLightingControl_AutoHighBeam_S_R_Flip_Flop "ExteriorLightManager/ELM_Main_sys/ELM_Main/IntelligentExteriorLightingControl/AutoHighBeam/S-R\r\nFlip-Flop" /end GROUP
/begin GROUP ExteriorLightManager_ELM_Main_sys_ELM_Main_IntelligentExteriorLightingControl_AutoHighBeam_If_Action_Subsystem3_If_Action_Subsystem1_If_Action_Subsystem1_If_Action_Subsystem1 "ExteriorLightManager/ELM_Main_sys/ELM_Main/IntelligentExteriorLightingControl/AutoHighBeam/If Action\r\nSubsystem3/If Action\r\nSubsystem1/If Action\r\nSubsystem1/If Action\r\nSubsystem1" /end GROUP
/begin GROUP ExteriorLightManager_ELM_Main_sys_ELM_Main_IntelligentExteriorLightingControl_AutoHighBeam_If_Action_Subsystem3_If_Action_Subsystem1_If_Action_Subsystem1_If_Action_Subsystem "ExteriorLightManager/ELM_Main_sys/ELM_Main/IntelligentExteriorLightingControl/AutoHighBeam/If Action\r\nSubsystem3/If Action\r\nSubsystem1/If Action\r\nSubsystem1/If Action\r\nSubsystem" /end GROUP
/begin GROUP ExteriorLightManager_ELM_Main_sys_ELM_Main_IntelligentExteriorLightingControl_AutoHighBeam_If_Action_Subsystem3_If_Action_Subsystem1_If_Action_Subsystem1 "ExteriorLightManager/ELM_Main_sys/ELM_Main/IntelligentExteriorLightingControl/AutoHighBeam/If Action\r\nSubsystem3/If Action\r\nSubsystem1/If Action\r\nSubsystem1"
 /begin SUB_GROUP ExteriorLightManager_ELM_Main_sys_ELM_Main_IntelligentExteriorLightingControl_AutoHighBeam_If_Action_Subsystem3_If_Action_Subsystem1_If_Action_Subsystem1_If_Action_Subsystem ExteriorLightManager_ELM_Main_sys_ELM_Main_IntelligentExteriorLightingControl_AutoHighBeam_If_Action_Subsystem3_If_Action_Subsystem1_If_Action_Subsystem1_If_Action_Subsystem1 /end SUB_GROUP
/end GROUP
/begin GROUP ExteriorLightManager_ELM_Main_sys_ELM_Main_IntelligentExteriorLightingControl_AutoHighBeam_If_Action_Subsystem3_If_Action_Subsystem1_If_Action_Subsystem "ExteriorLightManager/ELM_Main_sys/ELM_Main/IntelligentExteriorLightingControl/AutoHighBeam/If Action\r\nSubsystem3/If Action\r\nSubsystem1/If Action\r\nSubsystem" /end GROUP
/begin GROUP ExteriorLightManager_ELM_Main_sys_ELM_Main_IntelligentExteriorLightingControl_AutoHighBeam_If_Action_Subsystem3_If_Action_Subsystem1 "ExteriorLightManager/ELM_Main_sys/ELM_Main/IntelligentExteriorLightingControl/AutoHighBeam/If Action\r\nSubsystem3/If Action\r\nSubsystem1"
 /begin SUB_GROUP ExteriorLightManager_ELM_Main_sys_ELM_Main_IntelligentExteriorLightingControl_AutoHighBeam_If_Action_Subsystem3_If_Action_Subsystem1_If_Action_Subsystem ExteriorLightManager_ELM_Main_sys_ELM_Main_IntelligentExteriorLightingControl_AutoHighBeam_If_Action_Subsystem3_If_Action_Subsystem1_If_Action_Subsystem1 /end SUB_GROUP
/end GROUP
/begin GROUP ExteriorLightManager_ELM_Main_sys_ELM_Main_IntelligentExteriorLightingControl_AutoHighBeam_If_Action_Subsystem3_If_Action_Subsystem "ExteriorLightManager/ELM_Main_sys/ELM_Main/IntelligentExteriorLightingControl/AutoHighBeam/If Action\r\nSubsystem3/If Action\r\nSubsystem" /end GROUP
/begin GROUP ExteriorLightManager_ELM_Main_sys_ELM_Main_IntelligentExteriorLightingControl_AutoHighBeam_If_Action_Subsystem3 "ExteriorLightManager/ELM_Main_sys/ELM_Main/IntelligentExteriorLightingControl/AutoHighBeam/If Action\r\nSubsystem3"
 /begin SUB_GROUP ExteriorLightManager_ELM_Main_sys_ELM_Main_IntelligentExteriorLightingControl_AutoHighBeam_If_Action_Subsystem3_If_Action_Subsystem ExteriorLightManager_ELM_Main_sys_ELM_Main_IntelligentExteriorLightingControl_AutoHighBeam_If_Action_Subsystem3_If_Action_Subsystem1 /end SUB_GROUP
/end GROUP
/begin GROUP ExteriorLightManager_ELM_Main_sys_ELM_Main_IntelligentExteriorLightingControl_AutoHighBeam_Detect_Rise_Positive2 "ExteriorLightManager/ELM_Main_sys/ELM_Main/IntelligentExteriorLightingControl/AutoHighBeam/Detect Rise\r\nPositive2" /end GROUP
/begin GROUP ExteriorLightManager_ELM_Main_sys_ELM_Main_IntelligentExteriorLightingControl_AutoHighBeam_Detect_Rise_Positive1 "ExteriorLightManager/ELM_Main_sys/ELM_Main/IntelligentExteriorLightingControl/AutoHighBeam/Detect Rise\r\nPositive1" /end GROUP
/begin GROUP ExteriorLightManager_ELM_Main_sys_ELM_Main_IntelligentExteriorLightingControl_AutoHighBeam_Detect_Rise_Positive "ExteriorLightManager/ELM_Main_sys/ELM_Main/IntelligentExteriorLightingControl/AutoHighBeam/Detect Rise\r\nPositive" /end GROUP
/begin GROUP ExteriorLightManager_ELM_Main_sys_ELM_Main_IntelligentExteriorLightingControl_AutoHighBeam_Detect_Decrease "ExteriorLightManager/ELM_Main_sys/ELM_Main/IntelligentExteriorLightingControl/AutoHighBeam/Detect\r\nDecrease" /end GROUP
/begin GROUP ExteriorLightManager_ELM_Main_sys_ELM_Main_IntelligentExteriorLightingControl_AutoHighBeam_AutoHighBeamPreconditionDetmn "ExteriorLightManager/ELM_Main_sys/ELM_Main/IntelligentExteriorLightingControl/AutoHighBeam/AutoHighBeamPreconditionDetmn" /begin REF_MEASUREMENT S2S_AHBSet /end REF_MEASUREMENT /end GROUP
/begin GROUP ExteriorLightManager_ELM_Main_sys_ELM_Main_IntelligentExteriorLightingControl_AutoHighBeam_AHBOverrideStsDetmn_S_R_Flip_Flop2 "ExteriorLightManager/ELM_Main_sys/ELM_Main/IntelligentExteriorLightingControl/AutoHighBeam/AHBOverrideStsDetmn/S-R\r\nFlip-Flop2" /end GROUP
/begin GROUP ExteriorLightManager_ELM_Main_sys_ELM_Main_IntelligentExteriorLightingControl_AutoHighBeam_AHBOverrideStsDetmn "ExteriorLightManager/ELM_Main_sys/ELM_Main/IntelligentExteriorLightingControl/AutoHighBeam/AHBOverrideStsDetmn"
 /begin SUB_GROUP ExteriorLightManager_ELM_Main_sys_ELM_Main_IntelligentExteriorLightingControl_AutoHighBeam_AHBOverrideStsDetmn_S_R_Flip_Flop2 /end SUB_GROUP
/end GROUP
/begin GROUP ExteriorLightManager_ELM_Main_sys_ELM_Main_IntelligentExteriorLightingControl_AutoHighBeam "ExteriorLightManager/ELM_Main_sys/ELM_Main/IntelligentExteriorLightingControl/AutoHighBeam"
 /begin SUB_GROUP ExteriorLightManager_ELM_Main_sys_ELM_Main_IntelligentExteriorLightingControl_AutoHighBeam_AHBOverrideStsDetmn ExteriorLightManager_ELM_Main_sys_ELM_Main_IntelligentExteriorLightingControl_AutoHighBeam_AutoHighBeamPreconditionDetmn ExteriorLightManager_ELM_Main_sys_ELM_Main_IntelligentExteriorLightingControl_AutoHighBeam_Detect_Decrease ExteriorLightManager_ELM_Main_sys_ELM_Main_IntelligentExteriorLightingControl_AutoHighBeam_Detect_Rise_Positive ExteriorLightManager_ELM_Main_sys_ELM_Main_IntelligentExteriorLightingControl_AutoHighBeam_Detect_Rise_Positive1 ExteriorLightManager_ELM_Main_sys_ELM_Main_IntelligentExteriorLightingControl_AutoHighBeam_Detect_Rise_Positive2 ExteriorLightManager_ELM_Main_sys_ELM_Main_IntelligentExteriorLightingControl_AutoHighBeam_If_Action_Subsystem3 ExteriorLightManager_ELM_Main_sys_ELM_Main_IntelligentExteriorLightingControl_AutoHighBeam_S_R_Flip_Flop ExteriorLightManager_ELM_Main_sys_ELM_Main_IntelligentExteriorLightingControl_AutoHighBeam_S_R_Flip_Flop1 /end SUB_GROUP
 /begin REF_MEASUREMENT FCAM_AHBLeftHBRequest FCAM_AHBRightHBRequest /end REF_MEASUREMENT
/end GROUP
/begin GROUP ExteriorLightManager_ELM_Main_sys_ELM_Main_IntelligentExteriorLightingControl "ExteriorLightManager/ELM_Main_sys/ELM_Main/IntelligentExteriorLightingControl"
 /begin SUB_GROUP ExteriorLightManager_ELM_Main_sys_ELM_Main_IntelligentExteriorLightingControl_AutoHighBeam ExteriorLightManager_ELM_Main_sys_ELM_Main_IntelligentExteriorLightingControl_AutoLevellingHeadlamp ExteriorLightManager_ELM_Main_sys_ELM_Main_IntelligentExteriorLightingControl_FollowmeHomeLight ExteriorLightManager_ELM_Main_sys_ELM_Main_IntelligentExteriorLightingControl_OutsideMirrorLedWarningControl ExteriorLightManager_ELM_Main_sys_ELM_Main_IntelligentExteriorLightingControl_WelcomeLight /end SUB_GROUP
/end GROUP
/begin GROUP ExteriorLightManager_ELM_Main_sys_ELM_Main_HazardWarningAndRearLightingControl_ReverseLampControl_Detect_Rise_Positive1 "ExteriorLightManager/ELM_Main_sys/ELM_Main/HazardWarningAndRearLightingControl/ReverseLampControl/Detect Rise\r\nPositive1" /end GROUP
/begin GROUP ExteriorLightManager_ELM_Main_sys_ELM_Main_HazardWarningAndRearLightingControl_ReverseLampControl_Detect_Rise_Positive "ExteriorLightManager/ELM_Main_sys/ELM_Main/HazardWarningAndRearLightingControl/ReverseLampControl/Detect Rise\r\nPositive" /end GROUP
/begin GROUP ExteriorLightManager_ELM_Main_sys_ELM_Main_HazardWarningAndRearLightingControl_ReverseLampControl "ExteriorLightManager/ELM_Main_sys/ELM_Main/HazardWarningAndRearLightingControl/ReverseLampControl"
 /begin SUB_GROUP ExteriorLightManager_ELM_Main_sys_ELM_Main_HazardWarningAndRearLightingControl_ReverseLampControl_Detect_Rise_Positive ExteriorLightManager_ELM_Main_sys_ELM_Main_HazardWarningAndRearLightingControl_ReverseLampControl_Detect_Rise_Positive1 /end SUB_GROUP
 /begin REF_MEASUREMENT CVC_ActualGearValid /end REF_MEASUREMENT
/end GROUP
/begin GROUP ExteriorLightManager_ELM_Main_sys_ELM_Main_HazardWarningAndRearLightingControl_LicensePlateLampControl_Detect_Rise_Positive "ExteriorLightManager/ELM_Main_sys/ELM_Main/HazardWarningAndRearLightingControl/LicensePlateLampControl/Detect Rise\r\nPositive" /end GROUP
/begin GROUP ExteriorLightManager_ELM_Main_sys_ELM_Main_HazardWarningAndRearLightingControl_LicensePlateLampControl "ExteriorLightManager/ELM_Main_sys/ELM_Main/HazardWarningAndRearLightingControl/LicensePlateLampControl"
 /begin SUB_GROUP ExteriorLightManager_ELM_Main_sys_ELM_Main_HazardWarningAndRearLightingControl_LicensePlateLampControl_Detect_Rise_Positive /end SUB_GROUP
 /begin REF_MEASUREMENT S2S_ExteriorLightSet /end REF_MEASUREMENT
/end GROUP
/begin GROUP ExteriorLightManager_ELM_Main_sys_ELM_Main_HazardWarningAndRearLightingControl_HazardWarningLightControl_IndicatorLightFaultFlashingPWMGenerator_TURN_LIGHT_DUTY_CYCLE1 "ExteriorLightManager/ELM_Main_sys/ELM_Main/HazardWarningAndRearLightingControl/HazardWarningLightControl/IndicatorLightFaultFlashingPWMGenerator/TURN_LIGHT_DUTY_CYCLE1" /begin REF_CHARACTERISTIC TURN_LIGHT_DUTY_CYCLE /end REF_CHARACTERISTIC /end GROUP
/begin GROUP ExteriorLightManager_ELM_Main_sys_ELM_Main_HazardWarningAndRearLightingControl_HazardWarningLightControl_IndicatorLightFaultFlashingPWMGenerator_PWMGenerator "ExteriorLightManager/ELM_Main_sys/ELM_Main/HazardWarningAndRearLightingControl/HazardWarningLightControl/IndicatorLightFaultFlashingPWMGenerator/PWMGenerator" /end GROUP
/begin GROUP ExteriorLightManager_ELM_Main_sys_ELM_Main_HazardWarningAndRearLightingControl_HazardWarningLightControl_IndicatorLightFaultFlashingPWMGenerator_FAILURE_TURN_LIGHT_FREQUENCY "ExteriorLightManager/ELM_Main_sys/ELM_Main/HazardWarningAndRearLightingControl/HazardWarningLightControl/IndicatorLightFaultFlashingPWMGenerator/FAILURE_TURN_LIGHT_FREQUENCY" /begin REF_CHARACTERISTIC FAILURE_TURN_LIGHT_FREQUENCY /end REF_CHARACTERISTIC /end GROUP
/begin GROUP ExteriorLightManager_ELM_Main_sys_ELM_Main_HazardWarningAndRearLightingControl_HazardWarningLightControl_IndicatorLightFaultFlashingPWMGenerator_ELM_Ts_P "ExteriorLightManager/ELM_Main_sys/ELM_Main/HazardWarningAndRearLightingControl/HazardWarningLightControl/IndicatorLightFaultFlashingPWMGenerator/ELM_Ts_P" /begin REF_CHARACTERISTIC ELM_Ts_P /end REF_CHARACTERISTIC /end GROUP
/begin GROUP ExteriorLightManager_ELM_Main_sys_ELM_Main_HazardWarningAndRearLightingControl_HazardWarningLightControl_IndicatorLightFaultFlashingPWMGenerator "ExteriorLightManager/ELM_Main_sys/ELM_Main/HazardWarningAndRearLightingControl/HazardWarningLightControl/IndicatorLightFaultFlashingPWMGenerator"
 /begin SUB_GROUP ExteriorLightManager_ELM_Main_sys_ELM_Main_HazardWarningAndRearLightingControl_HazardWarningLightControl_IndicatorLightFaultFlashingPWMGenerator_ELM_Ts_P ExteriorLightManager_ELM_Main_sys_ELM_Main_HazardWarningAndRearLightingControl_HazardWarningLightControl_IndicatorLightFaultFlashingPWMGenerator_FAILURE_TURN_LIGHT_FREQUENCY ExteriorLightManager_ELM_Main_sys_ELM_Main_HazardWarningAndRearLightingControl_HazardWarningLightControl_IndicatorLightFaultFlashingPWMGenerator_PWMGenerator ExteriorLightManager_ELM_Main_sys_ELM_Main_HazardWarningAndRearLightingControl_HazardWarningLightControl_IndicatorLightFaultFlashingPWMGenerator_TURN_LIGHT_DUTY_CYCLE1 /end SUB_GROUP
/end GROUP
/begin GROUP ExteriorLightManager_ELM_Main_sys_ELM_Main_HazardWarningAndRearLightingControl_HazardWarningLightControl_HazardWarningLightManualControl_TailgateWarningFlashingControl_Timer "ExteriorLightManager/ELM_Main_sys/ELM_Main/HazardWarningAndRearLightingControl/HazardWarningLightControl/HazardWarningLightManualControl/TailgateWarningFlashingControl/Timer" /end GROUP
/begin GROUP ExteriorLightManager_ELM_Main_sys_ELM_Main_HazardWarningAndRearLightingControl_HazardWarningLightControl_HazardWarningLightManualControl_TailgateWarningFlashingControl_TailgateOpenClosedDetect "ExteriorLightManager/ELM_Main_sys/ELM_Main/HazardWarningAndRearLightingControl/HazardWarningLightControl/HazardWarningLightManualControl/TailgateWarningFlashingControl/TailgateOpenClosedDetect" /end GROUP
/begin GROUP ExteriorLightManager_ELM_Main_sys_ELM_Main_HazardWarningAndRearLightingControl_HazardWarningLightControl_HazardWarningLightManualControl_TailgateWarningFlashingControl_TailgateFlashingPWMGenerator_TAILGATE_OPERATING_WARNING_LIGHT_FLASHING_FREQUENCY "ExteriorLightManager/ELM_Main_sys/ELM_Main/HazardWarningAndRearLightingControl/HazardWarningLightControl/HazardWarningLightManualControl/TailgateWarningFlashingControl/TailgateFlashingPWMGenerator/TAILGATE_OPERATING_WARNING_LIGHT_FLASHING_FREQUENCY" /begin REF_CHARACTERISTIC TAILGATE_OPERATING_WARNING_LIGHT_FLASHING_FREQUENCY /end REF_CHARACTERISTIC /end GROUP
/begin GROUP ExteriorLightManager_ELM_Main_sys_ELM_Main_HazardWarningAndRearLightingControl_HazardWarningLightControl_HazardWarningLightManualControl_TailgateWarningFlashingControl_TailgateFlashingPWMGenerator_TAILGATE_OPERATING_WARNING_LIGHT_DUTY_CYCLE "ExteriorLightManager/ELM_Main_sys/ELM_Main/HazardWarningAndRearLightingControl/HazardWarningLightControl/HazardWarningLightManualControl/TailgateWarningFlashingControl/TailgateFlashingPWMGenerator/TAILGATE_OPERATING_WARNING_LIGHT_DUTY_CYCLE" /begin REF_CHARACTERISTIC TAILGATE_OPERATING_WARNING_LIGHT_DUTY_CYCLE /end REF_CHARACTERISTIC /end GROUP
/begin GROUP ExteriorLightManager_ELM_Main_sys_ELM_Main_HazardWarningAndRearLightingControl_HazardWarningLightControl_HazardWarningLightManualControl_TailgateWarningFlashingControl_TailgateFlashingPWMGenerator_PWMGenerator "ExteriorLightManager/ELM_Main_sys/ELM_Main/HazardWarningAndRearLightingControl/HazardWarningLightControl/HazardWarningLightManualControl/TailgateWarningFlashingControl/TailgateFlashingPWMGenerator/PWMGenerator" /end GROUP
/begin GROUP ExteriorLightManager_ELM_Main_sys_ELM_Main_HazardWarningAndRearLightingControl_HazardWarningLightControl_HazardWarningLightManualControl_TailgateWarningFlashingControl_TailgateFlashingPWMGenerator_ELM_Ts_P "ExteriorLightManager/ELM_Main_sys/ELM_Main/HazardWarningAndRearLightingControl/HazardWarningLightControl/HazardWarningLightManualControl/TailgateWarningFlashingControl/TailgateFlashingPWMGenerator/ELM_Ts_P" /begin REF_CHARACTERISTIC ELM_Ts_P /end REF_CHARACTERISTIC /end GROUP
/begin GROUP ExteriorLightManager_ELM_Main_sys_ELM_Main_HazardWarningAndRearLightingControl_HazardWarningLightControl_HazardWarningLightManualControl_TailgateWarningFlashingControl_TailgateFlashingPWMGenerator "ExteriorLightManager/ELM_Main_sys/ELM_Main/HazardWarningAndRearLightingControl/HazardWarningLightControl/HazardWarningLightManualControl/TailgateWarningFlashingControl/TailgateFlashingPWMGenerator"
 /begin SUB_GROUP ExteriorLightManager_ELM_Main_sys_ELM_Main_HazardWarningAndRearLightingControl_HazardWarningLightControl_HazardWarningLightManualControl_TailgateWarningFlashingControl_TailgateFlashingPWMGenerator_ELM_Ts_P ExteriorLightManager_ELM_Main_sys_ELM_Main_HazardWarningAndRearLightingControl_HazardWarningLightControl_HazardWarningLightManualControl_TailgateWarningFlashingControl_TailgateFlashingPWMGenerator_PWMGenerator ExteriorLightManager_ELM_Main_sys_ELM_Main_HazardWarningAndRearLightingControl_HazardWarningLightControl_HazardWarningLightManualControl_TailgateWarningFlashingControl_TailgateFlashingPWMGenerator_TAILGATE_OPERATING_WARNING_LIGHT_DUTY_CYCLE ExteriorLightManager_ELM_Main_sys_ELM_Main_HazardWarningAndRearLightingControl_HazardWarningLightControl_HazardWarningLightManualControl_TailgateWarningFlashingControl_TailgateFlashingPWMGenerator_TAILGATE_OPERATING_WARNING_LIGHT_FLASHING_FREQUENCY /end SUB_GROUP
/end GROUP
/begin GROUP ExteriorLightManager_ELM_Main_sys_ELM_Main_HazardWarningAndRearLightingControl_HazardWarningLightControl_HazardWarningLightManualControl_TailgateWarningFlashingControl_TURN_LIGHT_FREQUENCY1 "ExteriorLightManager/ELM_Main_sys/ELM_Main/HazardWarningAndRearLightingControl/HazardWarningLightControl/HazardWarningLightManualControl/TailgateWarningFlashingControl/TURN_LIGHT_FREQUENCY1" /begin REF_CHARACTERISTIC TURN_LIGHT_FREQUENCY /end REF_CHARACTERISTIC /end GROUP
/begin GROUP ExteriorLightManager_ELM_Main_sys_ELM_Main_HazardWarningAndRearLightingControl_HazardWarningLightControl_HazardWarningLightManualControl_TailgateWarningFlashingControl_S_R_Flip_Flop "ExteriorLightManager/ELM_Main_sys/ELM_Main/HazardWarningAndRearLightingControl/HazardWarningLightControl/HazardWarningLightManualControl/TailgateWarningFlashingControl/S-R\r\nFlip-Flop" /end GROUP
/begin GROUP ExteriorLightManager_ELM_Main_sys_ELM_Main_HazardWarningAndRearLightingControl_HazardWarningLightControl_HazardWarningLightManualControl_TailgateWarningFlashingControl_ELM_Ts_P2 "ExteriorLightManager/ELM_Main_sys/ELM_Main/HazardWarningAndRearLightingControl/HazardWarningLightControl/HazardWarningLightManualControl/TailgateWarningFlashingControl/ELM_Ts_P2" /begin REF_CHARACTERISTIC ELM_Ts_P /end REF_CHARACTERISTIC /end GROUP
/begin GROUP ExteriorLightManager_ELM_Main_sys_ELM_Main_HazardWarningAndRearLightingControl_HazardWarningLightControl_HazardWarningLightManualControl_TailgateWarningFlashingControl_Detect_Rise_Positive "ExteriorLightManager/ELM_Main_sys/ELM_Main/HazardWarningAndRearLightingControl/HazardWarningLightControl/HazardWarningLightManualControl/TailgateWarningFlashingControl/Detect Rise\r\nPositive" /end GROUP
/begin GROUP ExteriorLightManager_ELM_Main_sys_ELM_Main_HazardWarningAndRearLightingControl_HazardWarningLightControl_HazardWarningLightManualControl_TailgateWarningFlashingControl "ExteriorLightManager/ELM_Main_sys/ELM_Main/HazardWarningAndRearLightingControl/HazardWarningLightControl/HazardWarningLightManualControl/TailgateWarningFlashingControl"
 /begin SUB_GROUP ExteriorLightManager_ELM_Main_sys_ELM_Main_HazardWarningAndRearLightingControl_HazardWarningLightControl_HazardWarningLightManualControl_TailgateWarningFlashingControl_Detect_Rise_Positive ExteriorLightManager_ELM_Main_sys_ELM_Main_HazardWarningAndRearLightingControl_HazardWarningLightControl_HazardWarningLightManualControl_TailgateWarningFlashingControl_ELM_Ts_P2 ExteriorLightManager_ELM_Main_sys_ELM_Main_HazardWarningAndRearLightingControl_HazardWarningLightControl_HazardWarningLightManualControl_TailgateWarningFlashingControl_S_R_Flip_Flop ExteriorLightManager_ELM_Main_sys_ELM_Main_HazardWarningAndRearLightingControl_HazardWarningLightControl_HazardWarningLightManualControl_TailgateWarningFlashingControl_TURN_LIGHT_FREQUENCY1 ExteriorLightManager_ELM_Main_sys_ELM_Main_HazardWarningAndRearLightingControl_HazardWarningLightControl_HazardWarningLightManualControl_TailgateWarningFlashingControl_TailgateFlashingPWMGenerator ExteriorLightManager_ELM_Main_sys_ELM_Main_HazardWarningAndRearLightingControl_HazardWarningLightControl_HazardWarningLightManualControl_TailgateWarningFlashingControl_TailgateOpenClosedDetect ExteriorLightManager_ELM_Main_sys_ELM_Main_HazardWarningAndRearLightingControl_HazardWarningLightControl_HazardWarningLightManualControl_TailgateWarningFlashingControl_Timer /end SUB_GROUP
/end GROUP
/begin GROUP ExteriorLightManager_ELM_Main_sys_ELM_Main_HazardWarningAndRearLightingControl_HazardWarningLightControl_HazardWarningLightManualControl_HazardWarningLightActivationEnaDetmn "ExteriorLightManager/ELM_Main_sys/ELM_Main/HazardWarningAndRearLightingControl/HazardWarningLightControl/HazardWarningLightManualControl/HazardWarningLightActivationEnaDetmn" /end GROUP
/begin GROUP ExteriorLightManager_ELM_Main_sys_ELM_Main_HazardWarningAndRearLightingControl_HazardWarningLightControl_HazardWarningLightManualControl_HazardButtonFlashingPWMGenerator_TURN_LIGHT_FREQUENCY "ExteriorLightManager/ELM_Main_sys/ELM_Main/HazardWarningAndRearLightingControl/HazardWarningLightControl/HazardWarningLightManualControl/HazardButtonFlashingPWMGenerator/TURN_LIGHT_FREQUENCY" /begin REF_CHARACTERISTIC TURN_LIGHT_FREQUENCY /end REF_CHARACTERISTIC /end GROUP
/begin GROUP ExteriorLightManager_ELM_Main_sys_ELM_Main_HazardWarningAndRearLightingControl_HazardWarningLightControl_HazardWarningLightManualControl_HazardButtonFlashingPWMGenerator_TURN_LIGHT_DUTY_CYCLE "ExteriorLightManager/ELM_Main_sys/ELM_Main/HazardWarningAndRearLightingControl/HazardWarningLightControl/HazardWarningLightManualControl/HazardButtonFlashingPWMGenerator/TURN_LIGHT_DUTY_CYCLE" /begin REF_CHARACTERISTIC TURN_LIGHT_DUTY_CYCLE /end REF_CHARACTERISTIC /end GROUP
/begin GROUP ExteriorLightManager_ELM_Main_sys_ELM_Main_HazardWarningAndRearLightingControl_HazardWarningLightControl_HazardWarningLightManualControl_HazardButtonFlashingPWMGenerator_PWMGenerator "ExteriorLightManager/ELM_Main_sys/ELM_Main/HazardWarningAndRearLightingControl/HazardWarningLightControl/HazardWarningLightManualControl/HazardButtonFlashingPWMGenerator/PWMGenerator" /end GROUP
/begin GROUP ExteriorLightManager_ELM_Main_sys_ELM_Main_HazardWarningAndRearLightingControl_HazardWarningLightControl_HazardWarningLightManualControl_HazardButtonFlashingPWMGenerator_ELM_Ts_P "ExteriorLightManager/ELM_Main_sys/ELM_Main/HazardWarningAndRearLightingControl/HazardWarningLightControl/HazardWarningLightManualControl/HazardButtonFlashingPWMGenerator/ELM_Ts_P" /begin REF_CHARACTERISTIC ELM_Ts_P /end REF_CHARACTERISTIC /end GROUP
/begin GROUP ExteriorLightManager_ELM_Main_sys_ELM_Main_HazardWarningAndRearLightingControl_HazardWarningLightControl_HazardWarningLightManualControl_HazardButtonFlashingPWMGenerator "ExteriorLightManager/ELM_Main_sys/ELM_Main/HazardWarningAndRearLightingControl/HazardWarningLightControl/HazardWarningLightManualControl/HazardButtonFlashingPWMGenerator"
 /begin SUB_GROUP ExteriorLightManager_ELM_Main_sys_ELM_Main_HazardWarningAndRearLightingControl_HazardWarningLightControl_HazardWarningLightManualControl_HazardButtonFlashingPWMGenerator_ELM_Ts_P ExteriorLightManager_ELM_Main_sys_ELM_Main_HazardWarningAndRearLightingControl_HazardWarningLightControl_HazardWarningLightManualControl_HazardButtonFlashingPWMGenerator_PWMGenerator ExteriorLightManager_ELM_Main_sys_ELM_Main_HazardWarningAndRearLightingControl_HazardWarningLightControl_HazardWarningLightManualControl_HazardButtonFlashingPWMGenerator_TURN_LIGHT_DUTY_CYCLE ExteriorLightManager_ELM_Main_sys_ELM_Main_HazardWarningAndRearLightingControl_HazardWarningLightControl_HazardWarningLightManualControl_HazardButtonFlashingPWMGenerator_TURN_LIGHT_FREQUENCY /end SUB_GROUP
/end GROUP
/begin GROUP ExteriorLightManager_ELM_Main_sys_ELM_Main_HazardWarningAndRearLightingControl_HazardWarningLightControl_HazardWarningLightManualControl "ExteriorLightManager/ELM_Main_sys/ELM_Main/HazardWarningAndRearLightingControl/HazardWarningLightControl/HazardWarningLightManualControl"
 /begin SUB_GROUP ExteriorLightManager_ELM_Main_sys_ELM_Main_HazardWarningAndRearLightingControl_HazardWarningLightControl_HazardWarningLightManualControl_HazardButtonFlashingPWMGenerator ExteriorLightManager_ELM_Main_sys_ELM_Main_HazardWarningAndRearLightingControl_HazardWarningLightControl_HazardWarningLightManualControl_HazardWarningLightActivationEnaDetmn ExteriorLightManager_ELM_Main_sys_ELM_Main_HazardWarningAndRearLightingControl_HazardWarningLightControl_HazardWarningLightManualControl_TailgateWarningFlashingControl /end SUB_GROUP
 /begin REF_MEASUREMENT BCMFL_HazardButtonStatus /end REF_MEASUREMENT
/end GROUP
/begin GROUP ExteriorLightManager_ELM_Main_sys_ELM_Main_HazardWarningAndRearLightingControl_HazardWarningLightControl_HazardWarningLightEmergencyBrakeControl_Timer2 "ExteriorLightManager/ELM_Main_sys/ELM_Main/HazardWarningAndRearLightingControl/HazardWarningLightControl/HazardWarningLightEmergencyBrakeControl/Timer2" /end GROUP
/begin GROUP ExteriorLightManager_ELM_Main_sys_ELM_Main_HazardWarningAndRearLightingControl_HazardWarningLightControl_HazardWarningLightEmergencyBrakeControl_FLASH_TURN_LIGHT_DURATION2 "ExteriorLightManager/ELM_Main_sys/ELM_Main/HazardWarningAndRearLightingControl/HazardWarningLightControl/HazardWarningLightEmergencyBrakeControl/FLASH_TURN_LIGHT_DURATION2" /begin REF_CHARACTERISTIC FLASH_TURN_LIGHT_DURATION /end REF_CHARACTERISTIC /end GROUP
/begin GROUP ExteriorLightManager_ELM_Main_sys_ELM_Main_HazardWarningAndRearLightingControl_HazardWarningLightControl_HazardWarningLightEmergencyBrakeControl_EmergencyBrakeFlashingPWMGenerator_TURN_LIGHT_FREQUENCY_IN_EMERGENCY "ExteriorLightManager/ELM_Main_sys/ELM_Main/HazardWarningAndRearLightingControl/HazardWarningLightControl/HazardWarningLightEmergencyBrakeControl/EmergencyBrakeFlashingPWMGenerator/TURN_LIGHT_FREQUENCY_IN_EMERGENCY" /begin REF_CHARACTERISTIC TURN_LIGHT_FREQUENCY_IN_EMERGENCY /end REF_CHARACTERISTIC /end GROUP
/begin GROUP ExteriorLightManager_ELM_Main_sys_ELM_Main_HazardWarningAndRearLightingControl_HazardWarningLightControl_HazardWarningLightEmergencyBrakeControl_EmergencyBrakeFlashingPWMGenerator_TURN_LIGHT_DUTY_CYCLE "ExteriorLightManager/ELM_Main_sys/ELM_Main/HazardWarningAndRearLightingControl/HazardWarningLightControl/HazardWarningLightEmergencyBrakeControl/EmergencyBrakeFlashingPWMGenerator/TURN_LIGHT_DUTY_CYCLE" /begin REF_CHARACTERISTIC TURN_LIGHT_DUTY_CYCLE /end REF_CHARACTERISTIC /end GROUP
/begin GROUP ExteriorLightManager_ELM_Main_sys_ELM_Main_HazardWarningAndRearLightingControl_HazardWarningLightControl_HazardWarningLightEmergencyBrakeControl_EmergencyBrakeFlashingPWMGenerator_PWMGenerator "ExteriorLightManager/ELM_Main_sys/ELM_Main/HazardWarningAndRearLightingControl/HazardWarningLightControl/HazardWarningLightEmergencyBrakeControl/EmergencyBrakeFlashingPWMGenerator/PWMGenerator" /end GROUP
/begin GROUP ExteriorLightManager_ELM_Main_sys_ELM_Main_HazardWarningAndRearLightingControl_HazardWarningLightControl_HazardWarningLightEmergencyBrakeControl_EmergencyBrakeFlashingPWMGenerator_ELM_Ts_P "ExteriorLightManager/ELM_Main_sys/ELM_Main/HazardWarningAndRearLightingControl/HazardWarningLightControl/HazardWarningLightEmergencyBrakeControl/EmergencyBrakeFlashingPWMGenerator/ELM_Ts_P" /begin REF_CHARACTERISTIC ELM_Ts_P /end REF_CHARACTERISTIC /end GROUP
/begin GROUP ExteriorLightManager_ELM_Main_sys_ELM_Main_HazardWarningAndRearLightingControl_HazardWarningLightControl_HazardWarningLightEmergencyBrakeControl_EmergencyBrakeFlashingPWMGenerator "ExteriorLightManager/ELM_Main_sys/ELM_Main/HazardWarningAndRearLightingControl/HazardWarningLightControl/HazardWarningLightEmergencyBrakeControl/EmergencyBrakeFlashingPWMGenerator"
 /begin SUB_GROUP ExteriorLightManager_ELM_Main_sys_ELM_Main_HazardWarningAndRearLightingControl_HazardWarningLightControl_HazardWarningLightEmergencyBrakeControl_EmergencyBrakeFlashingPWMGenerator_ELM_Ts_P ExteriorLightManager_ELM_Main_sys_ELM_Main_HazardWarningAndRearLightingControl_HazardWarningLightControl_HazardWarningLightEmergencyBrakeControl_EmergencyBrakeFlashingPWMGenerator_PWMGenerator ExteriorLightManager_ELM_Main_sys_ELM_Main_HazardWarningAndRearLightingControl_HazardWarningLightControl_HazardWarningLightEmergencyBrakeControl_EmergencyBrakeFlashingPWMGenerator_TURN_LIGHT_DUTY_CYCLE ExteriorLightManager_ELM_Main_sys_ELM_Main_HazardWarningAndRearLightingControl_HazardWarningLightControl_HazardWarningLightEmergencyBrakeControl_EmergencyBrakeFlashingPWMGenerator_TURN_LIGHT_FREQUENCY_IN_EMERGENCY /end SUB_GROUP
/end GROUP
/begin GROUP ExteriorLightManager_ELM_Main_sys_ELM_Main_HazardWarningAndRearLightingControl_HazardWarningLightControl_HazardWarningLightEmergencyBrakeControl_ELM_Ts_P2 "ExteriorLightManager/ELM_Main_sys/ELM_Main/HazardWarningAndRearLightingControl/HazardWarningLightControl/HazardWarningLightEmergencyBrakeControl/ELM_Ts_P2" /begin REF_CHARACTERISTIC ELM_Ts_P /end REF_CHARACTERISTIC /end GROUP
/begin GROUP ExteriorLightManager_ELM_Main_sys_ELM_Main_HazardWarningAndRearLightingControl_HazardWarningLightControl_HazardWarningLightEmergencyBrakeControl "ExteriorLightManager/ELM_Main_sys/ELM_Main/HazardWarningAndRearLightingControl/HazardWarningLightControl/HazardWarningLightEmergencyBrakeControl"
 /begin SUB_GROUP ExteriorLightManager_ELM_Main_sys_ELM_Main_HazardWarningAndRearLightingControl_HazardWarningLightControl_HazardWarningLightEmergencyBrakeControl_ELM_Ts_P2 ExteriorLightManager_ELM_Main_sys_ELM_Main_HazardWarningAndRearLightingControl_HazardWarningLightControl_HazardWarningLightEmergencyBrakeControl_EmergencyBrakeFlashingPWMGenerator ExteriorLightManager_ELM_Main_sys_ELM_Main_HazardWarningAndRearLightingControl_HazardWarningLightControl_HazardWarningLightEmergencyBrakeControl_FLASH_TURN_LIGHT_DURATION2 ExteriorLightManager_ELM_Main_sys_ELM_Main_HazardWarningAndRearLightingControl_HazardWarningLightControl_HazardWarningLightEmergencyBrakeControl_Timer2 /end SUB_GROUP
 /begin REF_MEASUREMENT BCMFL_HazardButtonStatus IDB_AutoHazardRequest /end REF_MEASUREMENT
/end GROUP
/begin GROUP ExteriorLightManager_ELM_Main_sys_ELM_Main_HazardWarningAndRearLightingControl_HazardWarningLightControl_HazardWarningLightCrushControl_HazardWarningLightActivationEnaDetmn "ExteriorLightManager/ELM_Main_sys/ELM_Main/HazardWarningAndRearLightingControl/HazardWarningLightControl/HazardWarningLightCrushControl/HazardWarningLightActivationEnaDetmn" /end GROUP
/begin GROUP ExteriorLightManager_ELM_Main_sys_ELM_Main_HazardWarningAndRearLightingControl_HazardWarningLightControl_HazardWarningLightCrushControl_CrushFlashingPWMGenerator_TURN_LIGHT_FREQUENCY_IN_EMERGENCY "ExteriorLightManager/ELM_Main_sys/ELM_Main/HazardWarningAndRearLightingControl/HazardWarningLightControl/HazardWarningLightCrushControl/CrushFlashingPWMGenerator/TURN_LIGHT_FREQUENCY_IN_EMERGENCY" /begin REF_CHARACTERISTIC TURN_LIGHT_FREQUENCY_IN_EMERGENCY /end REF_CHARACTERISTIC /end GROUP
/begin GROUP ExteriorLightManager_ELM_Main_sys_ELM_Main_HazardWarningAndRearLightingControl_HazardWarningLightControl_HazardWarningLightCrushControl_CrushFlashingPWMGenerator_TURN_LIGHT_DUTY_CYCLE "ExteriorLightManager/ELM_Main_sys/ELM_Main/HazardWarningAndRearLightingControl/HazardWarningLightControl/HazardWarningLightCrushControl/CrushFlashingPWMGenerator/TURN_LIGHT_DUTY_CYCLE" /begin REF_CHARACTERISTIC TURN_LIGHT_DUTY_CYCLE /end REF_CHARACTERISTIC /end GROUP
/begin GROUP ExteriorLightManager_ELM_Main_sys_ELM_Main_HazardWarningAndRearLightingControl_HazardWarningLightControl_HazardWarningLightCrushControl_CrushFlashingPWMGenerator_PWMGenerator "ExteriorLightManager/ELM_Main_sys/ELM_Main/HazardWarningAndRearLightingControl/HazardWarningLightControl/HazardWarningLightCrushControl/CrushFlashingPWMGenerator/PWMGenerator" /end GROUP
/begin GROUP ExteriorLightManager_ELM_Main_sys_ELM_Main_HazardWarningAndRearLightingControl_HazardWarningLightControl_HazardWarningLightCrushControl_CrushFlashingPWMGenerator_ELM_Ts_P "ExteriorLightManager/ELM_Main_sys/ELM_Main/HazardWarningAndRearLightingControl/HazardWarningLightControl/HazardWarningLightCrushControl/CrushFlashingPWMGenerator/ELM_Ts_P" /begin REF_CHARACTERISTIC ELM_Ts_P /end REF_CHARACTERISTIC /end GROUP
/begin GROUP ExteriorLightManager_ELM_Main_sys_ELM_Main_HazardWarningAndRearLightingControl_HazardWarningLightControl_HazardWarningLightCrushControl_CrushFlashingPWMGenerator "ExteriorLightManager/ELM_Main_sys/ELM_Main/HazardWarningAndRearLightingControl/HazardWarningLightControl/HazardWarningLightCrushControl/CrushFlashingPWMGenerator"
 /begin SUB_GROUP ExteriorLightManager_ELM_Main_sys_ELM_Main_HazardWarningAndRearLightingControl_HazardWarningLightControl_HazardWarningLightCrushControl_CrushFlashingPWMGenerator_ELM_Ts_P ExteriorLightManager_ELM_Main_sys_ELM_Main_HazardWarningAndRearLightingControl_HazardWarningLightControl_HazardWarningLightCrushControl_CrushFlashingPWMGenerator_PWMGenerator ExteriorLightManager_ELM_Main_sys_ELM_Main_HazardWarningAndRearLightingControl_HazardWarningLightControl_HazardWarningLightCrushControl_CrushFlashingPWMGenerator_TURN_LIGHT_DUTY_CYCLE ExteriorLightManager_ELM_Main_sys_ELM_Main_HazardWarningAndRearLightingControl_HazardWarningLightControl_HazardWarningLightCrushControl_CrushFlashingPWMGenerator_TURN_LIGHT_FREQUENCY_IN_EMERGENCY /end SUB_GROUP
/end GROUP
/begin GROUP ExteriorLightManager_ELM_Main_sys_ELM_Main_HazardWarningAndRearLightingControl_HazardWarningLightControl_HazardWarningLightCrushControl "ExteriorLightManager/ELM_Main_sys/ELM_Main/HazardWarningAndRearLightingControl/HazardWarningLightControl/HazardWarningLightCrushControl"
 /begin SUB_GROUP ExteriorLightManager_ELM_Main_sys_ELM_Main_HazardWarningAndRearLightingControl_HazardWarningLightControl_HazardWarningLightCrushControl_CrushFlashingPWMGenerator ExteriorLightManager_ELM_Main_sys_ELM_Main_HazardWarningAndRearLightingControl_HazardWarningLightControl_HazardWarningLightCrushControl_HazardWarningLightActivationEnaDetmn /end SUB_GROUP
 /begin REF_MEASUREMENT BCMFL_HazardButtonStatus /end REF_MEASUREMENT
/end GROUP
/begin GROUP ExteriorLightManager_ELM_Main_sys_ELM_Main_HazardWarningAndRearLightingControl_HazardWarningLightControl "ExteriorLightManager/ELM_Main_sys/ELM_Main/HazardWarningAndRearLightingControl/HazardWarningLightControl"
 /begin SUB_GROUP ExteriorLightManager_ELM_Main_sys_ELM_Main_HazardWarningAndRearLightingControl_HazardWarningLightControl_HazardWarningLightCrushControl ExteriorLightManager_ELM_Main_sys_ELM_Main_HazardWarningAndRearLightingControl_HazardWarningLightControl_HazardWarningLightEmergencyBrakeControl ExteriorLightManager_ELM_Main_sys_ELM_Main_HazardWarningAndRearLightingControl_HazardWarningLightControl_HazardWarningLightManualControl ExteriorLightManager_ELM_Main_sys_ELM_Main_HazardWarningAndRearLightingControl_HazardWarningLightControl_IndicatorLightFaultFlashingPWMGenerator /end SUB_GROUP
/end GROUP
/begin GROUP ExteriorLightManager_ELM_Main_sys_ELM_Main_HazardWarningAndRearLightingControl_BrakeLampandHighMountingStopLightControl_Hysteresis "ExteriorLightManager/ELM_Main_sys/ELM_Main/HazardWarningAndRearLightingControl/BrakeLampandHighMountingStopLightControl/Hysteresis" /begin REF_MEASUREMENT YSS_LonglAccRate /end REF_MEASUREMENT /end GROUP
/begin GROUP ExteriorLightManager_ELM_Main_sys_ELM_Main_HazardWarningAndRearLightingControl_BrakeLampandHighMountingStopLightControl_Detect_Rise_Positive2 "ExteriorLightManager/ELM_Main_sys/ELM_Main/HazardWarningAndRearLightingControl/BrakeLampandHighMountingStopLightControl/Detect Rise\r\nPositive2" /end GROUP
/begin GROUP ExteriorLightManager_ELM_Main_sys_ELM_Main_HazardWarningAndRearLightingControl_BrakeLampandHighMountingStopLightControl_Detect_Rise_Positive1 "ExteriorLightManager/ELM_Main_sys/ELM_Main/HazardWarningAndRearLightingControl/BrakeLampandHighMountingStopLightControl/Detect Rise\r\nPositive1" /end GROUP
/begin GROUP ExteriorLightManager_ELM_Main_sys_ELM_Main_HazardWarningAndRearLightingControl_BrakeLampandHighMountingStopLightControl_Detect_Rise_Positive "ExteriorLightManager/ELM_Main_sys/ELM_Main/HazardWarningAndRearLightingControl/BrakeLampandHighMountingStopLightControl/Detect Rise\r\nPositive" /end GROUP
/begin GROUP ExteriorLightManager_ELM_Main_sys_ELM_Main_HazardWarningAndRearLightingControl_BrakeLampandHighMountingStopLightControl_Detect_Decrease "ExteriorLightManager/ELM_Main_sys/ELM_Main/HazardWarningAndRearLightingControl/BrakeLampandHighMountingStopLightControl/Detect\r\nDecrease" /end GROUP
/begin GROUP ExteriorLightManager_ELM_Main_sys_ELM_Main_HazardWarningAndRearLightingControl_BrakeLampandHighMountingStopLightControl_BRAKE_LIGHT_ON_DECCELERATION_THD "ExteriorLightManager/ELM_Main_sys/ELM_Main/HazardWarningAndRearLightingControl/BrakeLampandHighMountingStopLightControl/BRAKE_LIGHT_ON_DECCELERATION_THD" /begin REF_CHARACTERISTIC BRAKE_LIGHT_ON_DECCELERATION_THD /end REF_CHARACTERISTIC /end GROUP
/begin GROUP ExteriorLightManager_ELM_Main_sys_ELM_Main_HazardWarningAndRearLightingControl_BrakeLampandHighMountingStopLightControl_BRAKE_LIGHT_OFF_DECCELERATION_THD "ExteriorLightManager/ELM_Main_sys/ELM_Main/HazardWarningAndRearLightingControl/BrakeLampandHighMountingStopLightControl/BRAKE_LIGHT_OFF_DECCELERATION_THD" /begin REF_CHARACTERISTIC BRAKE_LIGHT_OFF_DECCELERATION_THD /end REF_CHARACTERISTIC /end GROUP
/begin GROUP ExteriorLightManager_ELM_Main_sys_ELM_Main_HazardWarningAndRearLightingControl_BrakeLampandHighMountingStopLightControl "ExteriorLightManager/ELM_Main_sys/ELM_Main/HazardWarningAndRearLightingControl/BrakeLampandHighMountingStopLightControl"
 /begin SUB_GROUP ExteriorLightManager_ELM_Main_sys_ELM_Main_HazardWarningAndRearLightingControl_BrakeLampandHighMountingStopLightControl_BRAKE_LIGHT_OFF_DECCELERATION_THD ExteriorLightManager_ELM_Main_sys_ELM_Main_HazardWarningAndRearLightingControl_BrakeLampandHighMountingStopLightControl_BRAKE_LIGHT_ON_DECCELERATION_THD ExteriorLightManager_ELM_Main_sys_ELM_Main_HazardWarningAndRearLightingControl_BrakeLampandHighMountingStopLightControl_Detect_Decrease ExteriorLightManager_ELM_Main_sys_ELM_Main_HazardWarningAndRearLightingControl_BrakeLampandHighMountingStopLightControl_Detect_Rise_Positive ExteriorLightManager_ELM_Main_sys_ELM_Main_HazardWarningAndRearLightingControl_BrakeLampandHighMountingStopLightControl_Detect_Rise_Positive1 ExteriorLightManager_ELM_Main_sys_ELM_Main_HazardWarningAndRearLightingControl_BrakeLampandHighMountingStopLightControl_Detect_Rise_Positive2 ExteriorLightManager_ELM_Main_sys_ELM_Main_HazardWarningAndRearLightingControl_BrakeLampandHighMountingStopLightControl_Hysteresis /end SUB_GROUP
 /begin REF_MEASUREMENT IDB_AVHActiveStatus /end REF_MEASUREMENT
/end GROUP
/begin GROUP ExteriorLightManager_ELM_Main_sys_ELM_Main_HazardWarningAndRearLightingControl "ExteriorLightManager/ELM_Main_sys/ELM_Main/HazardWarningAndRearLightingControl"
 /begin SUB_GROUP ExteriorLightManager_ELM_Main_sys_ELM_Main_HazardWarningAndRearLightingControl_BrakeLampandHighMountingStopLightControl ExteriorLightManager_ELM_Main_sys_ELM_Main_HazardWarningAndRearLightingControl_HazardWarningLightControl ExteriorLightManager_ELM_Main_sys_ELM_Main_HazardWarningAndRearLightingControl_LicensePlateLampControl ExteriorLightManager_ELM_Main_sys_ELM_Main_HazardWarningAndRearLightingControl_ReverseLampControl /end SUB_GROUP
/end GROUP
/begin GROUP ExteriorLightManager_ELM_Main_sys_ELM_Main_ExteriorLightingControl_ParkingLightsControl_Detect_Rise_Positive "ExteriorLightManager/ELM_Main_sys/ELM_Main/ExteriorLightingControl/ParkingLightsControl/Detect Rise\r\nPositive" /end GROUP
/begin GROUP ExteriorLightManager_ELM_Main_sys_ELM_Main_ExteriorLightingControl_ParkingLightsControl "ExteriorLightManager/ELM_Main_sys/ELM_Main/ExteriorLightingControl/ParkingLightsControl"
 /begin SUB_GROUP ExteriorLightManager_ELM_Main_sys_ELM_Main_ExteriorLightingControl_ParkingLightsControl_Detect_Rise_Positive /end SUB_GROUP
/end GROUP
/begin GROUP ExteriorLightManager_ELM_Main_sys_ELM_Main_ExteriorLightingControl_LowBeamControl_Detect_Rise_Positive2 "ExteriorLightManager/ELM_Main_sys/ELM_Main/ExteriorLightingControl/LowBeamControl/Detect Rise\r\nPositive2" /end GROUP
/begin GROUP ExteriorLightManager_ELM_Main_sys_ELM_Main_ExteriorLightingControl_LowBeamControl_Detect_Rise_Positive1 "ExteriorLightManager/ELM_Main_sys/ELM_Main/ExteriorLightingControl/LowBeamControl/Detect Rise\r\nPositive1" /end GROUP
/begin GROUP ExteriorLightManager_ELM_Main_sys_ELM_Main_ExteriorLightingControl_LowBeamControl "ExteriorLightManager/ELM_Main_sys/ELM_Main/ExteriorLightingControl/LowBeamControl"
 /begin SUB_GROUP ExteriorLightManager_ELM_Main_sys_ELM_Main_ExteriorLightingControl_LowBeamControl_Detect_Rise_Positive1 ExteriorLightManager_ELM_Main_sys_ELM_Main_ExteriorLightingControl_LowBeamControl_Detect_Rise_Positive2 /end SUB_GROUP
/end GROUP
/begin GROUP ExteriorLightManager_ELM_Main_sys_ELM_Main_ExteriorLightingControl_FogLightControl_ManualRearFogLightControl_ManualRearFogLampDeactiveEnaDetmn "ExteriorLightManager/ELM_Main_sys/ELM_Main/ExteriorLightingControl/FogLightControl/ManualRearFogLightControl/ManualRearFogLampDeactiveEnaDetmn" /end GROUP
/begin GROUP ExteriorLightManager_ELM_Main_sys_ELM_Main_ExteriorLightingControl_FogLightControl_ManualRearFogLightControl_ManualRearFogLampActiveEnaDetmn "ExteriorLightManager/ELM_Main_sys/ELM_Main/ExteriorLightingControl/FogLightControl/ManualRearFogLightControl/ManualRearFogLampActiveEnaDetmn" /end GROUP
/begin GROUP ExteriorLightManager_ELM_Main_sys_ELM_Main_ExteriorLightingControl_FogLightControl_ManualRearFogLightControl_Detect_Rise_Positive1 "ExteriorLightManager/ELM_Main_sys/ELM_Main/ExteriorLightingControl/FogLightControl/ManualRearFogLightControl/Detect Rise\r\nPositive1" /end GROUP
/begin GROUP ExteriorLightManager_ELM_Main_sys_ELM_Main_ExteriorLightingControl_FogLightControl_ManualRearFogLightControl_Detect_Rise_Positive "ExteriorLightManager/ELM_Main_sys/ELM_Main/ExteriorLightingControl/FogLightControl/ManualRearFogLightControl/Detect Rise\r\nPositive" /end GROUP
/begin GROUP ExteriorLightManager_ELM_Main_sys_ELM_Main_ExteriorLightingControl_FogLightControl_ManualRearFogLightControl "ExteriorLightManager/ELM_Main_sys/ELM_Main/ExteriorLightingControl/FogLightControl/ManualRearFogLightControl"
 /begin SUB_GROUP ExteriorLightManager_ELM_Main_sys_ELM_Main_ExteriorLightingControl_FogLightControl_ManualRearFogLightControl_Detect_Rise_Positive ExteriorLightManager_ELM_Main_sys_ELM_Main_ExteriorLightingControl_FogLightControl_ManualRearFogLightControl_Detect_Rise_Positive1 ExteriorLightManager_ELM_Main_sys_ELM_Main_ExteriorLightingControl_FogLightControl_ManualRearFogLightControl_ManualRearFogLampActiveEnaDetmn ExteriorLightManager_ELM_Main_sys_ELM_Main_ExteriorLightingControl_FogLightControl_ManualRearFogLightControl_ManualRearFogLampDeactiveEnaDetmn /end SUB_GROUP
/end GROUP
/begin GROUP ExteriorLightManager_ELM_Main_sys_ELM_Main_ExteriorLightingControl_FogLightControl_ManualFrontFogLightControl_ManualFrontFogLampDeactiveEnaDetmn "ExteriorLightManager/ELM_Main_sys/ELM_Main/ExteriorLightingControl/FogLightControl/ManualFrontFogLightControl/ManualFrontFogLampDeactiveEnaDetmn" /end GROUP
/begin GROUP ExteriorLightManager_ELM_Main_sys_ELM_Main_ExteriorLightingControl_FogLightControl_ManualFrontFogLightControl_ManualFrontFogLampActiveEnaDetmn "ExteriorLightManager/ELM_Main_sys/ELM_Main/ExteriorLightingControl/FogLightControl/ManualFrontFogLightControl/ManualFrontFogLampActiveEnaDetmn" /end GROUP
/begin GROUP ExteriorLightManager_ELM_Main_sys_ELM_Main_ExteriorLightingControl_FogLightControl_ManualFrontFogLightControl_Detect_Rise_Positive1 "ExteriorLightManager/ELM_Main_sys/ELM_Main/ExteriorLightingControl/FogLightControl/ManualFrontFogLightControl/Detect Rise\r\nPositive1" /end GROUP
/begin GROUP ExteriorLightManager_ELM_Main_sys_ELM_Main_ExteriorLightingControl_FogLightControl_ManualFrontFogLightControl_Detect_Rise_Positive "ExteriorLightManager/ELM_Main_sys/ELM_Main/ExteriorLightingControl/FogLightControl/ManualFrontFogLightControl/Detect Rise\r\nPositive" /end GROUP
/begin GROUP ExteriorLightManager_ELM_Main_sys_ELM_Main_ExteriorLightingControl_FogLightControl_ManualFrontFogLightControl_Detect_Decrease "ExteriorLightManager/ELM_Main_sys/ELM_Main/ExteriorLightingControl/FogLightControl/ManualFrontFogLightControl/Detect\r\nDecrease" /end GROUP
/begin GROUP ExteriorLightManager_ELM_Main_sys_ELM_Main_ExteriorLightingControl_FogLightControl_ManualFrontFogLightControl "ExteriorLightManager/ELM_Main_sys/ELM_Main/ExteriorLightingControl/FogLightControl/ManualFrontFogLightControl"
 /begin SUB_GROUP ExteriorLightManager_ELM_Main_sys_ELM_Main_ExteriorLightingControl_FogLightControl_ManualFrontFogLightControl_Detect_Decrease ExteriorLightManager_ELM_Main_sys_ELM_Main_ExteriorLightingControl_FogLightControl_ManualFrontFogLightControl_Detect_Rise_Positive ExteriorLightManager_ELM_Main_sys_ELM_Main_ExteriorLightingControl_FogLightControl_ManualFrontFogLightControl_Detect_Rise_Positive1 ExteriorLightManager_ELM_Main_sys_ELM_Main_ExteriorLightingControl_FogLightControl_ManualFrontFogLightControl_ManualFrontFogLampActiveEnaDetmn ExteriorLightManager_ELM_Main_sys_ELM_Main_ExteriorLightingControl_FogLightControl_ManualFrontFogLightControl_ManualFrontFogLampDeactiveEnaDetmn /end SUB_GROUP
/end GROUP
/begin GROUP ExteriorLightManager_ELM_Main_sys_ELM_Main_ExteriorLightingControl_FogLightControl_FogLightSetting "ExteriorLightManager/ELM_Main_sys/ELM_Main/ExteriorLightingControl/FogLightControl/FogLightSetting"
 /begin REF_MEASUREMENT Nv_FrontFogLightSet Nv_RearFogLightSet S2S_FrontFogLightSet S2S_RearFogLightSet /end REF_MEASUREMENT
/end GROUP
/begin GROUP ExteriorLightManager_ELM_Main_sys_ELM_Main_ExteriorLightingControl_FogLightControl "ExteriorLightManager/ELM_Main_sys/ELM_Main/ExteriorLightingControl/FogLightControl"
 /begin SUB_GROUP ExteriorLightManager_ELM_Main_sys_ELM_Main_ExteriorLightingControl_FogLightControl_FogLightSetting ExteriorLightManager_ELM_Main_sys_ELM_Main_ExteriorLightingControl_FogLightControl_ManualFrontFogLightControl ExteriorLightManager_ELM_Main_sys_ELM_Main_ExteriorLightingControl_FogLightControl_ManualRearFogLightControl /end SUB_GROUP
/end GROUP
/begin GROUP ExteriorLightManager_ELM_Main_sys_ELM_Main_ExteriorLightingControl_DaytimeRunningLightControl_Detect_Rise_Positive3 "ExteriorLightManager/ELM_Main_sys/ELM_Main/ExteriorLightingControl/DaytimeRunningLightControl/Detect Rise\r\nPositive3" /end GROUP
/begin GROUP ExteriorLightManager_ELM_Main_sys_ELM_Main_ExteriorLightingControl_DaytimeRunningLightControl_Detect_Rise_Positive2 "ExteriorLightManager/ELM_Main_sys/ELM_Main/ExteriorLightingControl/DaytimeRunningLightControl/Detect Rise\r\nPositive2" /end GROUP
/begin GROUP ExteriorLightManager_ELM_Main_sys_ELM_Main_ExteriorLightingControl_DaytimeRunningLightControl_Detect_Rise_Positive1 "ExteriorLightManager/ELM_Main_sys/ELM_Main/ExteriorLightingControl/DaytimeRunningLightControl/Detect Rise\r\nPositive1" /end GROUP
/begin GROUP ExteriorLightManager_ELM_Main_sys_ELM_Main_ExteriorLightingControl_DaytimeRunningLightControl_Detect_Rise_Positive "ExteriorLightManager/ELM_Main_sys/ELM_Main/ExteriorLightingControl/DaytimeRunningLightControl/Detect Rise\r\nPositive" /end GROUP
/begin GROUP ExteriorLightManager_ELM_Main_sys_ELM_Main_ExteriorLightingControl_DaytimeRunningLightControl "ExteriorLightManager/ELM_Main_sys/ELM_Main/ExteriorLightingControl/DaytimeRunningLightControl"
 /begin SUB_GROUP ExteriorLightManager_ELM_Main_sys_ELM_Main_ExteriorLightingControl_DaytimeRunningLightControl_Detect_Rise_Positive ExteriorLightManager_ELM_Main_sys_ELM_Main_ExteriorLightingControl_DaytimeRunningLightControl_Detect_Rise_Positive1 ExteriorLightManager_ELM_Main_sys_ELM_Main_ExteriorLightingControl_DaytimeRunningLightControl_Detect_Rise_Positive2 ExteriorLightManager_ELM_Main_sys_ELM_Main_ExteriorLightingControl_DaytimeRunningLightControl_Detect_Rise_Positive3 /end SUB_GROUP
/end GROUP
/begin GROUP ExteriorLightManager_ELM_Main_sys_ELM_Main_ExteriorLightingControl_CorneringLightsControl_CorneringLightsTriggerClcn_Detect_Rise_Positive3 "ExteriorLightManager/ELM_Main_sys/ELM_Main/ExteriorLightingControl/CorneringLightsControl/CorneringLightsTriggerClcn/Detect Rise\r\nPositive3" /end GROUP
/begin GROUP ExteriorLightManager_ELM_Main_sys_ELM_Main_ExteriorLightingControl_CorneringLightsControl_CorneringLightsTriggerClcn_Detect_Rise_Positive2 "ExteriorLightManager/ELM_Main_sys/ELM_Main/ExteriorLightingControl/CorneringLightsControl/CorneringLightsTriggerClcn/Detect Rise\r\nPositive2" /end GROUP
/begin GROUP ExteriorLightManager_ELM_Main_sys_ELM_Main_ExteriorLightingControl_CorneringLightsControl_CorneringLightsTriggerClcn_Detect_Rise_Positive1 "ExteriorLightManager/ELM_Main_sys/ELM_Main/ExteriorLightingControl/CorneringLightsControl/CorneringLightsTriggerClcn/Detect Rise\r\nPositive1" /end GROUP
/begin GROUP ExteriorLightManager_ELM_Main_sys_ELM_Main_ExteriorLightingControl_CorneringLightsControl_CorneringLightsTriggerClcn_Detect_Rise_Positive "ExteriorLightManager/ELM_Main_sys/ELM_Main/ExteriorLightingControl/CorneringLightsControl/CorneringLightsTriggerClcn/Detect Rise\r\nPositive" /end GROUP
/begin GROUP ExteriorLightManager_ELM_Main_sys_ELM_Main_ExteriorLightingControl_CorneringLightsControl_CorneringLightsTriggerClcn_CORNERING_LIGHT_VEHICLE_SPEED_THD "ExteriorLightManager/ELM_Main_sys/ELM_Main/ExteriorLightingControl/CorneringLightsControl/CorneringLightsTriggerClcn/CORNERING_LIGHT_VEHICLE_SPEED_THD" /begin REF_CHARACTERISTIC CORNERING_LIGHT_VEHICLE_SPEED_THD /end REF_CHARACTERISTIC /end GROUP
/begin GROUP ExteriorLightManager_ELM_Main_sys_ELM_Main_ExteriorLightingControl_CorneringLightsControl_CorneringLightsTriggerClcn_CORNERING_LIGHT_VEHICLE_SPEED_DEACTIVE_THD "ExteriorLightManager/ELM_Main_sys/ELM_Main/ExteriorLightingControl/CorneringLightsControl/CorneringLightsTriggerClcn/CORNERING_LIGHT_VEHICLE_SPEED_DEACTIVE_THD" /begin REF_CHARACTERISTIC CORNERING_LIGHT_VEHICLE_SPEED_DEACTIVE_THD /end REF_CHARACTERISTIC /end GROUP
/begin GROUP ExteriorLightManager_ELM_Main_sys_ELM_Main_ExteriorLightingControl_CorneringLightsControl_CorneringLightsTriggerClcn_CORNERING_LIGHT_STEERING_ANGLE_DEACTIVE_THD "ExteriorLightManager/ELM_Main_sys/ELM_Main/ExteriorLightingControl/CorneringLightsControl/CorneringLightsTriggerClcn/CORNERING_LIGHT_STEERING_ANGLE_DEACTIVE_THD" /begin REF_CHARACTERISTIC CORNERING_LIGHT_STEERING_ANGLE_DEACTIVE_THD /end REF_CHARACTERISTIC /end GROUP
/begin GROUP ExteriorLightManager_ELM_Main_sys_ELM_Main_ExteriorLightingControl_CorneringLightsControl_CorneringLightsTriggerClcn_CORNERING_LIGHT_STEERING_ANGLE_ACTIVE_THD "ExteriorLightManager/ELM_Main_sys/ELM_Main/ExteriorLightingControl/CorneringLightsControl/CorneringLightsTriggerClcn/CORNERING_LIGHT_STEERING_ANGLE_ACTIVE_THD" /begin REF_CHARACTERISTIC CORNERING_LIGHT_STEERING_ANGLE_ACTIVE_THD /end REF_CHARACTERISTIC /end GROUP
/begin GROUP ExteriorLightManager_ELM_Main_sys_ELM_Main_ExteriorLightingControl_CorneringLightsControl_CorneringLightsTriggerClcn "ExteriorLightManager/ELM_Main_sys/ELM_Main/ExteriorLightingControl/CorneringLightsControl/CorneringLightsTriggerClcn"
 /begin SUB_GROUP ExteriorLightManager_ELM_Main_sys_ELM_Main_ExteriorLightingControl_CorneringLightsControl_CorneringLightsTriggerClcn_CORNERING_LIGHT_STEERING_ANGLE_ACTIVE_THD ExteriorLightManager_ELM_Main_sys_ELM_Main_ExteriorLightingControl_CorneringLightsControl_CorneringLightsTriggerClcn_CORNERING_LIGHT_STEERING_ANGLE_DEACTIVE_THD ExteriorLightManager_ELM_Main_sys_ELM_Main_ExteriorLightingControl_CorneringLightsControl_CorneringLightsTriggerClcn_CORNERING_LIGHT_VEHICLE_SPEED_DEACTIVE_THD ExteriorLightManager_ELM_Main_sys_ELM_Main_ExteriorLightingControl_CorneringLightsControl_CorneringLightsTriggerClcn_CORNERING_LIGHT_VEHICLE_SPEED_THD ExteriorLightManager_ELM_Main_sys_ELM_Main_ExteriorLightingControl_CorneringLightsControl_CorneringLightsTriggerClcn_Detect_Rise_Positive ExteriorLightManager_ELM_Main_sys_ELM_Main_ExteriorLightingControl_CorneringLightsControl_CorneringLightsTriggerClcn_Detect_Rise_Positive1 ExteriorLightManager_ELM_Main_sys_ELM_Main_ExteriorLightingControl_CorneringLightsControl_CorneringLightsTriggerClcn_Detect_Rise_Positive2 ExteriorLightManager_ELM_Main_sys_ELM_Main_ExteriorLightingControl_CorneringLightsControl_CorneringLightsTriggerClcn_Detect_Rise_Positive3 /end SUB_GROUP
 /begin REF_MEASUREMENT EPS_SteeringWheelAngle /end REF_MEASUREMENT
/end GROUP
/begin GROUP ExteriorLightManager_ELM_Main_sys_ELM_Main_ExteriorLightingControl_CorneringLightsControl_CorneringLightsEnaDetmn "ExteriorLightManager/ELM_Main_sys/ELM_Main/ExteriorLightingControl/CorneringLightsControl/CorneringLightsEnaDetmn" /end GROUP
/begin GROUP ExteriorLightManager_ELM_Main_sys_ELM_Main_ExteriorLightingControl_CorneringLightsControl "ExteriorLightManager/ELM_Main_sys/ELM_Main/ExteriorLightingControl/CorneringLightsControl"
 /begin SUB_GROUP ExteriorLightManager_ELM_Main_sys_ELM_Main_ExteriorLightingControl_CorneringLightsControl_CorneringLightsEnaDetmn ExteriorLightManager_ELM_Main_sys_ELM_Main_ExteriorLightingControl_CorneringLightsControl_CorneringLightsTriggerClcn /end SUB_GROUP
/end GROUP
/begin GROUP ExteriorLightManager_ELM_Main_sys_ELM_Main_ExteriorLightingControl_AutoHeadlightsSetting "ExteriorLightManager/ELM_Main_sys/ELM_Main/ExteriorLightingControl/AutoHeadlightsSetting" /begin REF_MEASUREMENT Nv_ExteriorLightSet S2S_ExteriorLightSet /end REF_MEASUREMENT /end GROUP
/begin GROUP ExteriorLightManager_ELM_Main_sys_ELM_Main_ExteriorLightingControl_AutoHeadlightsControl_ExteriorLightControlEnaDetmn "ExteriorLightManager/ELM_Main_sys/ELM_Main/ExteriorLightingControl/AutoHeadlightsControl/ExteriorLightControlEnaDetmn" /end GROUP
/begin GROUP ExteriorLightManager_ELM_Main_sys_ELM_Main_ExteriorLightingControl_AutoHeadlightsControl_Detect_Rise_Positive1 "ExteriorLightManager/ELM_Main_sys/ELM_Main/ExteriorLightingControl/AutoHeadlightsControl/Detect Rise\r\nPositive1" /end GROUP
/begin GROUP ExteriorLightManager_ELM_Main_sys_ELM_Main_ExteriorLightingControl_AutoHeadlightsControl_Detect_Rise_Positive "ExteriorLightManager/ELM_Main_sys/ELM_Main/ExteriorLightingControl/AutoHeadlightsControl/Detect Rise\r\nPositive" /end GROUP
/begin GROUP ExteriorLightManager_ELM_Main_sys_ELM_Main_ExteriorLightingControl_AutoHeadlightsControl "ExteriorLightManager/ELM_Main_sys/ELM_Main/ExteriorLightingControl/AutoHeadlightsControl"
 /begin SUB_GROUP ExteriorLightManager_ELM_Main_sys_ELM_Main_ExteriorLightingControl_AutoHeadlightsControl_Detect_Rise_Positive ExteriorLightManager_ELM_Main_sys_ELM_Main_ExteriorLightingControl_AutoHeadlightsControl_Detect_Rise_Positive1 ExteriorLightManager_ELM_Main_sys_ELM_Main_ExteriorLightingControl_AutoHeadlightsControl_ExteriorLightControlEnaDetmn /end SUB_GROUP
 /begin REF_MEASUREMENT BCMFR_RLSLampStatusFeedback /end REF_MEASUREMENT
/end GROUP
/begin GROUP ExteriorLightManager_ELM_Main_sys_ELM_Main_ExteriorLightingControlByStalkSwitch_TurnIndicatorLightControl_TurnIndicatorLightReqGenerator_TURN_LIGHT_FREQUENCY "ExteriorLightManager/ELM_Main_sys/ELM_Main/ExteriorLightingControlByStalkSwitch/TurnIndicatorLightControl/TurnIndicatorLightReqGenerator/TURN_LIGHT_FREQUENCY" /begin REF_CHARACTERISTIC TURN_LIGHT_FREQUENCY /end REF_CHARACTERISTIC /end GROUP
/begin GROUP ExteriorLightManager_ELM_Main_sys_ELM_Main_ExteriorLightingControlByStalkSwitch_TurnIndicatorLightControl_TurnIndicatorLightReqGenerator_TURN_LIGHT_DUTY_CYCLE "ExteriorLightManager/ELM_Main_sys/ELM_Main/ExteriorLightingControlByStalkSwitch/TurnIndicatorLightControl/TurnIndicatorLightReqGenerator/TURN_LIGHT_DUTY_CYCLE" /begin REF_CHARACTERISTIC TURN_LIGHT_DUTY_CYCLE /end REF_CHARACTERISTIC /end GROUP
/begin GROUP ExteriorLightManager_ELM_Main_sys_ELM_Main_ExteriorLightingControlByStalkSwitch_TurnIndicatorLightControl_TurnIndicatorLightReqGenerator_FlashingPWMGenerator_PWMGenerator "ExteriorLightManager/ELM_Main_sys/ELM_Main/ExteriorLightingControlByStalkSwitch/TurnIndicatorLightControl/TurnIndicatorLightReqGenerator/FlashingPWMGenerator/PWMGenerator" /end GROUP
/begin GROUP ExteriorLightManager_ELM_Main_sys_ELM_Main_ExteriorLightingControlByStalkSwitch_TurnIndicatorLightControl_TurnIndicatorLightReqGenerator_FlashingPWMGenerator "ExteriorLightManager/ELM_Main_sys/ELM_Main/ExteriorLightingControlByStalkSwitch/TurnIndicatorLightControl/TurnIndicatorLightReqGenerator/FlashingPWMGenerator"
 /begin SUB_GROUP ExteriorLightManager_ELM_Main_sys_ELM_Main_ExteriorLightingControlByStalkSwitch_TurnIndicatorLightControl_TurnIndicatorLightReqGenerator_FlashingPWMGenerator_PWMGenerator /end SUB_GROUP
/end GROUP
/begin GROUP ExteriorLightManager_ELM_Main_sys_ELM_Main_ExteriorLightingControlByStalkSwitch_TurnIndicatorLightControl_TurnIndicatorLightReqGenerator_FAILURE_TURN_LIGHT_FREQUENCY "ExteriorLightManager/ELM_Main_sys/ELM_Main/ExteriorLightingControlByStalkSwitch/TurnIndicatorLightControl/TurnIndicatorLightReqGenerator/FAILURE_TURN_LIGHT_FREQUENCY" /begin REF_CHARACTERISTIC FAILURE_TURN_LIGHT_FREQUENCY /end REF_CHARACTERISTIC /end GROUP
/begin GROUP ExteriorLightManager_ELM_Main_sys_ELM_Main_ExteriorLightingControlByStalkSwitch_TurnIndicatorLightControl_TurnIndicatorLightReqGenerator_ELM_Ts_P "ExteriorLightManager/ELM_Main_sys/ELM_Main/ExteriorLightingControlByStalkSwitch/TurnIndicatorLightControl/TurnIndicatorLightReqGenerator/ELM_Ts_P" /begin REF_CHARACTERISTIC ELM_Ts_P /end REF_CHARACTERISTIC /end GROUP
/begin GROUP ExteriorLightManager_ELM_Main_sys_ELM_Main_ExteriorLightingControlByStalkSwitch_TurnIndicatorLightControl_TurnIndicatorLightReqGenerator "ExteriorLightManager/ELM_Main_sys/ELM_Main/ExteriorLightingControlByStalkSwitch/TurnIndicatorLightControl/TurnIndicatorLightReqGenerator"
 /begin SUB_GROUP ExteriorLightManager_ELM_Main_sys_ELM_Main_ExteriorLightingControlByStalkSwitch_TurnIndicatorLightControl_TurnIndicatorLightReqGenerator_ELM_Ts_P ExteriorLightManager_ELM_Main_sys_ELM_Main_ExteriorLightingControlByStalkSwitch_TurnIndicatorLightControl_TurnIndicatorLightReqGenerator_FAILURE_TURN_LIGHT_FREQUENCY ExteriorLightManager_ELM_Main_sys_ELM_Main_ExteriorLightingControlByStalkSwitch_TurnIndicatorLightControl_TurnIndicatorLightReqGenerator_FlashingPWMGenerator ExteriorLightManager_ELM_Main_sys_ELM_Main_ExteriorLightingControlByStalkSwitch_TurnIndicatorLightControl_TurnIndicatorLightReqGenerator_TURN_LIGHT_DUTY_CYCLE ExteriorLightManager_ELM_Main_sys_ELM_Main_ExteriorLightingControlByStalkSwitch_TurnIndicatorLightControl_TurnIndicatorLightReqGenerator_TURN_LIGHT_FREQUENCY /end SUB_GROUP
/end GROUP
/begin GROUP ExteriorLightManager_ELM_Main_sys_ELM_Main_ExteriorLightingControlByStalkSwitch_TurnIndicatorLightControl_RightTurnIndicatorLightDeactive_SteeringOppositeDeactiveDetect_OPPOSITE_OFFSET_ANGLE "ExteriorLightManager/ELM_Main_sys/ELM_Main/ExteriorLightingControlByStalkSwitch/TurnIndicatorLightControl/RightTurnIndicatorLightDeactive/SteeringOppositeDeactiveDetect/OPPOSITE_OFFSET_ANGLE" /begin REF_CHARACTERISTIC OPPOSITE_OFFSET_ANGLE /end REF_CHARACTERISTIC /end GROUP
/begin GROUP ExteriorLightManager_ELM_Main_sys_ELM_Main_ExteriorLightingControlByStalkSwitch_TurnIndicatorLightControl_RightTurnIndicatorLightDeactive_SteeringOppositeDeactiveDetect_OPPOSITE_ANGLE_THRESHOLD1 "ExteriorLightManager/ELM_Main_sys/ELM_Main/ExteriorLightingControlByStalkSwitch/TurnIndicatorLightControl/RightTurnIndicatorLightDeactive/SteeringOppositeDeactiveDetect/OPPOSITE_ANGLE_THRESHOLD1" /begin REF_CHARACTERISTIC OPPOSITE_ANGLE_THRESHOLD /end REF_CHARACTERISTIC /end GROUP
/begin GROUP ExteriorLightManager_ELM_Main_sys_ELM_Main_ExteriorLightingControlByStalkSwitch_TurnIndicatorLightControl_RightTurnIndicatorLightDeactive_SteeringOppositeDeactiveDetect_OPPOSITE_ANGLE_THRESHOLD "ExteriorLightManager/ELM_Main_sys/ELM_Main/ExteriorLightingControlByStalkSwitch/TurnIndicatorLightControl/RightTurnIndicatorLightDeactive/SteeringOppositeDeactiveDetect/OPPOSITE_ANGLE_THRESHOLD" /begin REF_CHARACTERISTIC OPPOSITE_ANGLE_THRESHOLD /end REF_CHARACTERISTIC /end GROUP
/begin GROUP ExteriorLightManager_ELM_Main_sys_ELM_Main_ExteriorLightingControlByStalkSwitch_TurnIndicatorLightControl_RightTurnIndicatorLightDeactive_SteeringOppositeDeactiveDetect_Detect_Rise_Positive5 "ExteriorLightManager/ELM_Main_sys/ELM_Main/ExteriorLightingControlByStalkSwitch/TurnIndicatorLightControl/RightTurnIndicatorLightDeactive/SteeringOppositeDeactiveDetect/Detect Rise\r\nPositive5" /end GROUP
/begin GROUP ExteriorLightManager_ELM_Main_sys_ELM_Main_ExteriorLightingControlByStalkSwitch_TurnIndicatorLightControl_RightTurnIndicatorLightDeactive_SteeringOppositeDeactiveDetect_Detect_Rise_Positive4 "ExteriorLightManager/ELM_Main_sys/ELM_Main/ExteriorLightingControlByStalkSwitch/TurnIndicatorLightControl/RightTurnIndicatorLightDeactive/SteeringOppositeDeactiveDetect/Detect Rise\r\nPositive4" /end GROUP
/begin GROUP ExteriorLightManager_ELM_Main_sys_ELM_Main_ExteriorLightingControlByStalkSwitch_TurnIndicatorLightControl_RightTurnIndicatorLightDeactive_SteeringOppositeDeactiveDetect_Detect_Rise_Positive3 "ExteriorLightManager/ELM_Main_sys/ELM_Main/ExteriorLightingControlByStalkSwitch/TurnIndicatorLightControl/RightTurnIndicatorLightDeactive/SteeringOppositeDeactiveDetect/Detect Rise\r\nPositive3" /end GROUP
/begin GROUP ExteriorLightManager_ELM_Main_sys_ELM_Main_ExteriorLightingControlByStalkSwitch_TurnIndicatorLightControl_RightTurnIndicatorLightDeactive_SteeringOppositeDeactiveDetect_Detect_Rise_Positive2 "ExteriorLightManager/ELM_Main_sys/ELM_Main/ExteriorLightingControlByStalkSwitch/TurnIndicatorLightControl/RightTurnIndicatorLightDeactive/SteeringOppositeDeactiveDetect/Detect Rise\r\nPositive2" /end GROUP
/begin GROUP ExteriorLightManager_ELM_Main_sys_ELM_Main_ExteriorLightingControlByStalkSwitch_TurnIndicatorLightControl_RightTurnIndicatorLightDeactive_SteeringOppositeDeactiveDetect "ExteriorLightManager/ELM_Main_sys/ELM_Main/ExteriorLightingControlByStalkSwitch/TurnIndicatorLightControl/RightTurnIndicatorLightDeactive/SteeringOppositeDeactiveDetect"
 /begin SUB_GROUP ExteriorLightManager_ELM_Main_sys_ELM_Main_ExteriorLightingControlByStalkSwitch_TurnIndicatorLightControl_RightTurnIndicatorLightDeactive_SteeringOppositeDeactiveDetect_Detect_Rise_Positive2 ExteriorLightManager_ELM_Main_sys_ELM_Main_ExteriorLightingControlByStalkSwitch_TurnIndicatorLightControl_RightTurnIndicatorLightDeactive_SteeringOppositeDeactiveDetect_Detect_Rise_Positive3 ExteriorLightManager_ELM_Main_sys_ELM_Main_ExteriorLightingControlByStalkSwitch_TurnIndicatorLightControl_RightTurnIndicatorLightDeactive_SteeringOppositeDeactiveDetect_Detect_Rise_Positive4 ExteriorLightManager_ELM_Main_sys_ELM_Main_ExteriorLightingControlByStalkSwitch_TurnIndicatorLightControl_RightTurnIndicatorLightDeactive_SteeringOppositeDeactiveDetect_Detect_Rise_Positive5 ExteriorLightManager_ELM_Main_sys_ELM_Main_ExteriorLightingControlByStalkSwitch_TurnIndicatorLightControl_RightTurnIndicatorLightDeactive_SteeringOppositeDeactiveDetect_OPPOSITE_ANGLE_THRESHOLD ExteriorLightManager_ELM_Main_sys_ELM_Main_ExteriorLightingControlByStalkSwitch_TurnIndicatorLightControl_RightTurnIndicatorLightDeactive_SteeringOppositeDeactiveDetect_OPPOSITE_ANGLE_THRESHOLD1 ExteriorLightManager_ELM_Main_sys_ELM_Main_ExteriorLightingControlByStalkSwitch_TurnIndicatorLightControl_RightTurnIndicatorLightDeactive_SteeringOppositeDeactiveDetect_OPPOSITE_OFFSET_ANGLE /end SUB_GROUP
 /begin REF_MEASUREMENT EPS_SteeringWheelAngle /end REF_MEASUREMENT
/end GROUP
/begin GROUP ExteriorLightManager_ELM_Main_sys_ELM_Main_ExteriorLightingControlByStalkSwitch_TurnIndicatorLightControl_RightTurnIndicatorLightDeactive_SteeringBacktoCenterDeactiveDetect_S_R_Flip_Flop2 "ExteriorLightManager/ELM_Main_sys/ELM_Main/ExteriorLightingControlByStalkSwitch/TurnIndicatorLightControl/RightTurnIndicatorLightDeactive/SteeringBacktoCenterDeactiveDetect/S-R\r\nFlip-Flop2" /end GROUP
/begin GROUP ExteriorLightManager_ELM_Main_sys_ELM_Main_ExteriorLightingControlByStalkSwitch_TurnIndicatorLightControl_RightTurnIndicatorLightDeactive_SteeringBacktoCenterDeactiveDetect_S_R_Flip_Flop1 "ExteriorLightManager/ELM_Main_sys/ELM_Main/ExteriorLightingControlByStalkSwitch/TurnIndicatorLightControl/RightTurnIndicatorLightDeactive/SteeringBacktoCenterDeactiveDetect/S-R\r\nFlip-Flop1" /end GROUP
/begin GROUP ExteriorLightManager_ELM_Main_sys_ELM_Main_ExteriorLightingControlByStalkSwitch_TurnIndicatorLightControl_RightTurnIndicatorLightDeactive_SteeringBacktoCenterDeactiveDetect_SAME_DIRECTION_ANGLE_THRESHOLD2 "ExteriorLightManager/ELM_Main_sys/ELM_Main/ExteriorLightingControlByStalkSwitch/TurnIndicatorLightControl/RightTurnIndicatorLightDeactive/SteeringBacktoCenterDeactiveDetect/SAME_DIRECTION_ANGLE_THRESHOLD2" /begin REF_CHARACTERISTIC SAME_DIRECTION_ANGLE_THRESHOLD /end REF_CHARACTERISTIC /end GROUP
/begin GROUP ExteriorLightManager_ELM_Main_sys_ELM_Main_ExteriorLightingControlByStalkSwitch_TurnIndicatorLightControl_RightTurnIndicatorLightDeactive_SteeringBacktoCenterDeactiveDetect_SAME_DIRECTION_ANGLE_THRESHOLD1 "ExteriorLightManager/ELM_Main_sys/ELM_Main/ExteriorLightingControlByStalkSwitch/TurnIndicatorLightControl/RightTurnIndicatorLightDeactive/SteeringBacktoCenterDeactiveDetect/SAME_DIRECTION_ANGLE_THRESHOLD1" /begin REF_CHARACTERISTIC SAME_DIRECTION_ANGLE_THRESHOLD /end REF_CHARACTERISTIC /end GROUP
/begin GROUP ExteriorLightManager_ELM_Main_sys_ELM_Main_ExteriorLightingControlByStalkSwitch_TurnIndicatorLightControl_RightTurnIndicatorLightDeactive_SteeringBacktoCenterDeactiveDetect_Detect_Rise_Positive5 "ExteriorLightManager/ELM_Main_sys/ELM_Main/ExteriorLightingControlByStalkSwitch/TurnIndicatorLightControl/RightTurnIndicatorLightDeactive/SteeringBacktoCenterDeactiveDetect/Detect Rise\r\nPositive5" /end GROUP
/begin GROUP ExteriorLightManager_ELM_Main_sys_ELM_Main_ExteriorLightingControlByStalkSwitch_TurnIndicatorLightControl_RightTurnIndicatorLightDeactive_SteeringBacktoCenterDeactiveDetect_Detect_Rise_Positive4 "ExteriorLightManager/ELM_Main_sys/ELM_Main/ExteriorLightingControlByStalkSwitch/TurnIndicatorLightControl/RightTurnIndicatorLightDeactive/SteeringBacktoCenterDeactiveDetect/Detect Rise\r\nPositive4" /end GROUP
/begin GROUP ExteriorLightManager_ELM_Main_sys_ELM_Main_ExteriorLightingControlByStalkSwitch_TurnIndicatorLightControl_RightTurnIndicatorLightDeactive_SteeringBacktoCenterDeactiveDetect_Detect_Rise_Positive3 "ExteriorLightManager/ELM_Main_sys/ELM_Main/ExteriorLightingControlByStalkSwitch/TurnIndicatorLightControl/RightTurnIndicatorLightDeactive/SteeringBacktoCenterDeactiveDetect/Detect Rise\r\nPositive3" /end GROUP
/begin GROUP ExteriorLightManager_ELM_Main_sys_ELM_Main_ExteriorLightingControlByStalkSwitch_TurnIndicatorLightControl_RightTurnIndicatorLightDeactive_SteeringBacktoCenterDeactiveDetect_Detect_Rise_Positive2 "ExteriorLightManager/ELM_Main_sys/ELM_Main/ExteriorLightingControlByStalkSwitch/TurnIndicatorLightControl/RightTurnIndicatorLightDeactive/SteeringBacktoCenterDeactiveDetect/Detect Rise\r\nPositive2" /end GROUP
/begin GROUP ExteriorLightManager_ELM_Main_sys_ELM_Main_ExteriorLightingControlByStalkSwitch_TurnIndicatorLightControl_RightTurnIndicatorLightDeactive_SteeringBacktoCenterDeactiveDetect_Detect_Decrease2 "ExteriorLightManager/ELM_Main_sys/ELM_Main/ExteriorLightingControlByStalkSwitch/TurnIndicatorLightControl/RightTurnIndicatorLightDeactive/SteeringBacktoCenterDeactiveDetect/Detect\r\nDecrease2" /end GROUP
/begin GROUP ExteriorLightManager_ELM_Main_sys_ELM_Main_ExteriorLightingControlByStalkSwitch_TurnIndicatorLightControl_RightTurnIndicatorLightDeactive_SteeringBacktoCenterDeactiveDetect_Detect_Decrease1 "ExteriorLightManager/ELM_Main_sys/ELM_Main/ExteriorLightingControlByStalkSwitch/TurnIndicatorLightControl/RightTurnIndicatorLightDeactive/SteeringBacktoCenterDeactiveDetect/Detect\r\nDecrease1" /end GROUP
/begin GROUP ExteriorLightManager_ELM_Main_sys_ELM_Main_ExteriorLightingControlByStalkSwitch_TurnIndicatorLightControl_RightTurnIndicatorLightDeactive_SteeringBacktoCenterDeactiveDetect_CENTER_POSITION_THRESHOLD5 "ExteriorLightManager/ELM_Main_sys/ELM_Main/ExteriorLightingControlByStalkSwitch/TurnIndicatorLightControl/RightTurnIndicatorLightDeactive/SteeringBacktoCenterDeactiveDetect/CENTER_POSITION_THRESHOLD5" /begin REF_CHARACTERISTIC CENTER_POSITION_THRESHOLD /end REF_CHARACTERISTIC /end GROUP
/begin GROUP ExteriorLightManager_ELM_Main_sys_ELM_Main_ExteriorLightingControlByStalkSwitch_TurnIndicatorLightControl_RightTurnIndicatorLightDeactive_SteeringBacktoCenterDeactiveDetect_CENTER_POSITION_THRESHOLD4 "ExteriorLightManager/ELM_Main_sys/ELM_Main/ExteriorLightingControlByStalkSwitch/TurnIndicatorLightControl/RightTurnIndicatorLightDeactive/SteeringBacktoCenterDeactiveDetect/CENTER_POSITION_THRESHOLD4" /begin REF_CHARACTERISTIC CENTER_POSITION_THRESHOLD /end REF_CHARACTERISTIC /end GROUP
/begin GROUP ExteriorLightManager_ELM_Main_sys_ELM_Main_ExteriorLightingControlByStalkSwitch_TurnIndicatorLightControl_RightTurnIndicatorLightDeactive_SteeringBacktoCenterDeactiveDetect "ExteriorLightManager/ELM_Main_sys/ELM_Main/ExteriorLightingControlByStalkSwitch/TurnIndicatorLightControl/RightTurnIndicatorLightDeactive/SteeringBacktoCenterDeactiveDetect"
 /begin SUB_GROUP ExteriorLightManager_ELM_Main_sys_ELM_Main_ExteriorLightingControlByStalkSwitch_TurnIndicatorLightControl_RightTurnIndicatorLightDeactive_SteeringBacktoCenterDeactiveDetect_CENTER_POSITION_THRESHOLD4 ExteriorLightManager_ELM_Main_sys_ELM_Main_ExteriorLightingControlByStalkSwitch_TurnIndicatorLightControl_RightTurnIndicatorLightDeactive_SteeringBacktoCenterDeactiveDetect_CENTER_POSITION_THRESHOLD5 ExteriorLightManager_ELM_Main_sys_ELM_Main_ExteriorLightingControlByStalkSwitch_TurnIndicatorLightControl_RightTurnIndicatorLightDeactive_SteeringBacktoCenterDeactiveDetect_Detect_Decrease1 ExteriorLightManager_ELM_Main_sys_ELM_Main_ExteriorLightingControlByStalkSwitch_TurnIndicatorLightControl_RightTurnIndicatorLightDeactive_SteeringBacktoCenterDeactiveDetect_Detect_Decrease2 ExteriorLightManager_ELM_Main_sys_ELM_Main_ExteriorLightingControlByStalkSwitch_TurnIndicatorLightControl_RightTurnIndicatorLightDeactive_SteeringBacktoCenterDeactiveDetect_Detect_Rise_Positive2 ExteriorLightManager_ELM_Main_sys_ELM_Main_ExteriorLightingControlByStalkSwitch_TurnIndicatorLightControl_RightTurnIndicatorLightDeactive_SteeringBacktoCenterDeactiveDetect_Detect_Rise_Positive3 ExteriorLightManager_ELM_Main_sys_ELM_Main_ExteriorLightingControlByStalkSwitch_TurnIndicatorLightControl_RightTurnIndicatorLightDeactive_SteeringBacktoCenterDeactiveDetect_Detect_Rise_Positive4 ExteriorLightManager_ELM_Main_sys_ELM_Main_ExteriorLightingControlByStalkSwitch_TurnIndicatorLightControl_RightTurnIndicatorLightDeactive_SteeringBacktoCenterDeactiveDetect_Detect_Rise_Positive5 ExteriorLightManager_ELM_Main_sys_ELM_Main_ExteriorLightingControlByStalkSwitch_TurnIndicatorLightControl_RightTurnIndicatorLightDeactive_SteeringBacktoCenterDeactiveDetect_SAME_DIRECTION_ANGLE_THRESHOLD1 ExteriorLightManager_ELM_Main_sys_ELM_Main_ExteriorLightingControlByStalkSwitch_TurnIndicatorLightControl_RightTurnIndicatorLightDeactive_SteeringBacktoCenterDeactiveDetect_SAME_DIRECTION_ANGLE_THRESHOLD2 ExteriorLightManager_ELM_Main_sys_ELM_Main_ExteriorLightingControlByStalkSwitch_TurnIndicatorLightControl_RightTurnIndicatorLightDeactive_SteeringBacktoCenterDeactiveDetect_S_R_Flip_Flop1 ExteriorLightManager_ELM_Main_sys_ELM_Main_ExteriorLightingControlByStalkSwitch_TurnIndicatorLightControl_RightTurnIndicatorLightDeactive_SteeringBacktoCenterDeactiveDetect_S_R_Flip_Flop2 /end SUB_GROUP
 /begin REF_MEASUREMENT EPS_SteeringWheelAngle /end REF_MEASUREMENT
/end GROUP
/begin GROUP ExteriorLightManager_ELM_Main_sys_ELM_Main_ExteriorLightingControlByStalkSwitch_TurnIndicatorLightControl_RightTurnIndicatorLightControl_HighwayFlashing_TURN_LIGHT_FREQUENCY1 "ExteriorLightManager/ELM_Main_sys/ELM_Main/ExteriorLightingControlByStalkSwitch/TurnIndicatorLightControl/RightTurnIndicatorLightControl_HighwayFlashing/TURN_LIGHT_FREQUENCY1" /begin REF_CHARACTERISTIC TURN_LIGHT_FREQUENCY /end REF_CHARACTERISTIC /end GROUP
/begin GROUP ExteriorLightManager_ELM_Main_sys_ELM_Main_ExteriorLightingControlByStalkSwitch_TurnIndicatorLightControl_RightTurnIndicatorLightControl_HighwayFlashing_ELM_Ts_P2 "ExteriorLightManager/ELM_Main_sys/ELM_Main/ExteriorLightingControlByStalkSwitch/TurnIndicatorLightControl/RightTurnIndicatorLightControl_HighwayFlashing/ELM_Ts_P2" /begin REF_CHARACTERISTIC ELM_Ts_P /end REF_CHARACTERISTIC /end GROUP
/begin GROUP ExteriorLightManager_ELM_Main_sys_ELM_Main_ExteriorLightingControlByStalkSwitch_TurnIndicatorLightControl_LeftTurnIndicatorLightDeactive_SteeringOppositeDeactiveDetect_OPPOSITE_OFFSET_ANGLE "ExteriorLightManager/ELM_Main_sys/ELM_Main/ExteriorLightingControlByStalkSwitch/TurnIndicatorLightControl/LeftTurnIndicatorLightDeactive/SteeringOppositeDeactiveDetect/OPPOSITE_OFFSET_ANGLE" /begin REF_CHARACTERISTIC OPPOSITE_OFFSET_ANGLE /end REF_CHARACTERISTIC /end GROUP
/begin GROUP ExteriorLightManager_ELM_Main_sys_ELM_Main_ExteriorLightingControlByStalkSwitch_TurnIndicatorLightControl_LeftTurnIndicatorLightDeactive_SteeringOppositeDeactiveDetect_OPPOSITE_ANGLE_THRESHOLD1 "ExteriorLightManager/ELM_Main_sys/ELM_Main/ExteriorLightingControlByStalkSwitch/TurnIndicatorLightControl/LeftTurnIndicatorLightDeactive/SteeringOppositeDeactiveDetect/OPPOSITE_ANGLE_THRESHOLD1" /begin REF_CHARACTERISTIC OPPOSITE_ANGLE_THRESHOLD /end REF_CHARACTERISTIC /end GROUP
/begin GROUP ExteriorLightManager_ELM_Main_sys_ELM_Main_ExteriorLightingControlByStalkSwitch_TurnIndicatorLightControl_LeftTurnIndicatorLightDeactive_SteeringOppositeDeactiveDetect_OPPOSITE_ANGLE_THRESHOLD "ExteriorLightManager/ELM_Main_sys/ELM_Main/ExteriorLightingControlByStalkSwitch/TurnIndicatorLightControl/LeftTurnIndicatorLightDeactive/SteeringOppositeDeactiveDetect/OPPOSITE_ANGLE_THRESHOLD" /begin REF_CHARACTERISTIC OPPOSITE_ANGLE_THRESHOLD /end REF_CHARACTERISTIC /end GROUP
/begin GROUP ExteriorLightManager_ELM_Main_sys_ELM_Main_ExteriorLightingControlByStalkSwitch_TurnIndicatorLightControl_LeftTurnIndicatorLightDeactive_SteeringOppositeDeactiveDetect "ExteriorLightManager/ELM_Main_sys/ELM_Main/ExteriorLightingControlByStalkSwitch/TurnIndicatorLightControl/LeftTurnIndicatorLightDeactive/SteeringOppositeDeactiveDetect" /begin REF_MEASUREMENT EPS_SteeringWheelAngle /end REF_MEASUREMENT /end GROUP
/begin GROUP ExteriorLightManager_ELM_Main_sys_ELM_Main_ExteriorLightingControlByStalkSwitch_TurnIndicatorLightControl_LeftTurnIndicatorLightDeactive_SteeringBacktoCenterDeactiveDetect_SAME_DIRECTION_ANGLE_THRESHOLD1 "ExteriorLightManager/ELM_Main_sys/ELM_Main/ExteriorLightingControlByStalkSwitch/TurnIndicatorLightControl/LeftTurnIndicatorLightDeactive/SteeringBacktoCenterDeactiveDetect/SAME_DIRECTION_ANGLE_THRESHOLD1" /begin REF_CHARACTERISTIC SAME_DIRECTION_ANGLE_THRESHOLD /end REF_CHARACTERISTIC /end GROUP
/begin GROUP ExteriorLightManager_ELM_Main_sys_ELM_Main_ExteriorLightingControlByStalkSwitch_TurnIndicatorLightControl_LeftTurnIndicatorLightDeactive_SteeringBacktoCenterDeactiveDetect_SAME_DIRECTION_ANGLE_THRESHOLD "ExteriorLightManager/ELM_Main_sys/ELM_Main/ExteriorLightingControlByStalkSwitch/TurnIndicatorLightControl/LeftTurnIndicatorLightDeactive/SteeringBacktoCenterDeactiveDetect/SAME_DIRECTION_ANGLE_THRESHOLD" /begin REF_CHARACTERISTIC SAME_DIRECTION_ANGLE_THRESHOLD /end REF_CHARACTERISTIC /end GROUP
/begin GROUP ExteriorLightManager_ELM_Main_sys_ELM_Main_ExteriorLightingControlByStalkSwitch_TurnIndicatorLightControl_LeftTurnIndicatorLightDeactive_SteeringBacktoCenterDeactiveDetect_CENTER_POSITION_THRESHOLD4 "ExteriorLightManager/ELM_Main_sys/ELM_Main/ExteriorLightingControlByStalkSwitch/TurnIndicatorLightControl/LeftTurnIndicatorLightDeactive/SteeringBacktoCenterDeactiveDetect/CENTER_POSITION_THRESHOLD4" /begin REF_CHARACTERISTIC CENTER_POSITION_THRESHOLD /end REF_CHARACTERISTIC /end GROUP
/begin GROUP ExteriorLightManager_ELM_Main_sys_ELM_Main_ExteriorLightingControlByStalkSwitch_TurnIndicatorLightControl_LeftTurnIndicatorLightDeactive_SteeringBacktoCenterDeactiveDetect_CENTER_POSITION_THRESHOLD "ExteriorLightManager/ELM_Main_sys/ELM_Main/ExteriorLightingControlByStalkSwitch/TurnIndicatorLightControl/LeftTurnIndicatorLightDeactive/SteeringBacktoCenterDeactiveDetect/CENTER_POSITION_THRESHOLD" /begin REF_CHARACTERISTIC CENTER_POSITION_THRESHOLD /end REF_CHARACTERISTIC /end GROUP
/begin GROUP ExteriorLightManager_ELM_Main_sys_ELM_Main_ExteriorLightingControlByStalkSwitch_TurnIndicatorLightControl_LeftTurnIndicatorLightDeactive_SteeringBacktoCenterDeactiveDetect "ExteriorLightManager/ELM_Main_sys/ELM_Main/ExteriorLightingControlByStalkSwitch/TurnIndicatorLightControl/LeftTurnIndicatorLightDeactive/SteeringBacktoCenterDeactiveDetect" /begin REF_MEASUREMENT EPS_SteeringWheelAngle /end REF_MEASUREMENT /end GROUP
/begin GROUP ExteriorLightManager_ELM_Main_sys_ELM_Main_ExteriorLightingControlByStalkSwitch_TurnIndicatorLightControl_LeftTurnIndicatorLightControl_HighwayFlashing_TURN_LIGHT_FREQUENCY1 "ExteriorLightManager/ELM_Main_sys/ELM_Main/ExteriorLightingControlByStalkSwitch/TurnIndicatorLightControl/LeftTurnIndicatorLightControl_HighwayFlashing/TURN_LIGHT_FREQUENCY1" /begin REF_CHARACTERISTIC TURN_LIGHT_FREQUENCY /end REF_CHARACTERISTIC /end GROUP
/begin GROUP ExteriorLightManager_ELM_Main_sys_ELM_Main_ExteriorLightingControlByStalkSwitch_TurnIndicatorLightControl_LeftTurnIndicatorLightControl_HighwayFlashing_ELM_Ts_P2 "ExteriorLightManager/ELM_Main_sys/ELM_Main/ExteriorLightingControlByStalkSwitch/TurnIndicatorLightControl/LeftTurnIndicatorLightControl_HighwayFlashing/ELM_Ts_P2" /begin REF_CHARACTERISTIC ELM_Ts_P /end REF_CHARACTERISTIC /end GROUP
/begin GROUP ExteriorLightManager_ELM_Main_sys_ELM_Main_ExteriorLightingControlByStalkSwitch_TurnIndicatorLightControl_CentralLockingTurnIndicatorLightControl_TURN_LIGHT_FREQUENCY1 "ExteriorLightManager/ELM_Main_sys/ELM_Main/ExteriorLightingControlByStalkSwitch/TurnIndicatorLightControl/CentralLockingTurnIndicatorLightControl/TURN_LIGHT_FREQUENCY1" /begin REF_CHARACTERISTIC TURN_LIGHT_FREQUENCY /end REF_CHARACTERISTIC /end GROUP
/begin GROUP ExteriorLightManager_ELM_Main_sys_ELM_Main_ExteriorLightingControlByStalkSwitch_TurnIndicatorLightControl_CentralLockingTurnIndicatorLightControl_ELM_Ts_P2 "ExteriorLightManager/ELM_Main_sys/ELM_Main/ExteriorLightingControlByStalkSwitch/TurnIndicatorLightControl/CentralLockingTurnIndicatorLightControl/ELM_Ts_P2" /begin REF_CHARACTERISTIC ELM_Ts_P /end REF_CHARACTERISTIC /end GROUP
/begin GROUP ExteriorLightManager_ELM_Main_sys_ELM_Main_ExteriorLightingControlByStalkSwitch_ManualHighBeamControl_FlashHighBeam_ELM_Ts_P "ExteriorLightManager/ELM_Main_sys/ELM_Main/ExteriorLightingControlByStalkSwitch/ManualHighBeamControl/FlashHighBeam/ELM_Ts_P" /begin REF_CHARACTERISTIC ELM_Ts_P /end REF_CHARACTERISTIC /end GROUP
/begin GROUP ExteriorLightManager_ELM_Main_sys_ELM_Main_ExteriorLightingControlByStalkSwitch_ManualHighBeamControl_ContinuousHighBeam_ContinuousHighBeamDeactiveTriggerDetect "ExteriorLightManager/ELM_Main_sys/ELM_Main/ExteriorLightingControlByStalkSwitch/ManualHighBeamControl/ContinuousHighBeam/ContinuousHighBeamDeactiveTriggerDetect" /begin REF_MEASUREMENT S2S_ExteriorLightSet /end REF_MEASUREMENT /end GROUP
/begin GROUP ExteriorLightManager_ELM_Main_sys_ELM_Main_ExteriorLightingControlByStalkSwitch_ManualHighBeamControl "ExteriorLightManager/ELM_Main_sys/ELM_Main/ExteriorLightingControlByStalkSwitch/ManualHighBeamControl" /begin REF_MEASUREMENT S2S_AHBSet /end REF_MEASUREMENT /end GROUP
/begin GROUP ExteriorLightManager_ELM_Main_sys_ELM_Main_ExteriorLightingControlByStalkSwitch_IndividualParkingLightControl_RightParkingLightControl_ELM_Ts_P "ExteriorLightManager/ELM_Main_sys/ELM_Main/ExteriorLightingControlByStalkSwitch/IndividualParkingLightControl/RightParkingLightControl/ELM_Ts_P" /begin REF_CHARACTERISTIC ELM_Ts_P /end REF_CHARACTERISTIC /end GROUP
/begin GROUP ExteriorLightManager_ELM_Main_sys_ELM_Main_ExteriorLightingControlByStalkSwitch_IndividualParkingLightControl_LeftParkingLightControl_ELM_Ts_P "ExteriorLightManager/ELM_Main_sys/ELM_Main/ExteriorLightingControlByStalkSwitch/IndividualParkingLightControl/LeftParkingLightControl/ELM_Ts_P" /begin REF_CHARACTERISTIC ELM_Ts_P /end REF_CHARACTERISTIC /end GROUP
/begin GROUP ExteriorLightManager "ExteriorLightManager" ROOT
 /begin REF_MEASUREMENT BCMFL_FLDRLStatus BCMFL_FrntHeightSnsrVolt BCMFL_FrontHeightSensorStatus BCMFL_HazardButtonStatus BCMFR_FRDRLStatus BCMFR_RLSLampStatusFeedback BCMRE_ReHeightSnsrVolt BCMRE_RearHeightSensorStatus CLM_DoorLockUnlockType CVC_ActualGearValid EPS_SteeringWheelAngle FCAM_AHBLeftHBRequest FCAM_AHBRightHBRequest FCAM_FLBSDWarningRequest FCAM_FLDOWWarningRequest FCAM_FRBSDWarningRequest FCAM_FRDOWWarningRequest FCAM_FRRCTAWarningRequest HLML_MotorTemperatureInfo HLMR_MotorTemperatureInfo IDB_AVHActiveStatus IDB_AutoHazardRequest IF_FCAM_FLRCTAWarningRequest Nv_ExteriorLightSet Nv_FMHSet Nv_FrontFogLightSet Nv_RearFogLightSet Nv_WelcomeLightSet S2S_AHBSet S2S_ExteriorLightSet S2S_FMHSet S2S_FrontFogLightSet S2S_RearFogLightSet S2S_WelcomeLightSet SCM_LeftStalkSwitchStatus YSS_LonglAccRate /end REF_MEASUREMENT
/end GROUP
/begin MEASUREMENT YSS_LonglAccRate "" FLOAT32_IEEE CM_single 0 0 -3.4E+38 3.4E+38 ECU_ADDRESS 0x3434CB00 /* @ECU_Address@YSS_LonglAccRate@ */ /end MEASUREMENT
/begin MEASUREMENT SCM_LeftStalkSwitchStatus "" UBYTE CM_uint8 0 0 0 255 ECU_ADDRESS 0x3434CB66 /* @ECU_Address@SCM_LeftStalkSwitchStatus@ */ /end MEASUREMENT
/begin MEASUREMENT S2S_WelcomeLightSet "" UBYTE CM_uint8 0 0 0 255 ECU_ADDRESS 0x3434C7AA /* @ECU_Address@S2S_WelcomeLightSet@ */ /end MEASUREMENT
/begin MEASUREMENT S2S_RearFogLightSet "" UBYTE CM_uint8 0 0 0 255 ECU_ADDRESS 0x3434C7A4 /* @ECU_Address@S2S_RearFogLightSet@ */ /end MEASUREMENT
/begin MEASUREMENT S2S_FrontFogLightSet "" UBYTE CM_uint8 0 0 0 255 ECU_ADDRESS 0x3434C7A2 /* @ECU_Address@S2S_FrontFogLightSet@ */ /end MEASUREMENT
/begin MEASUREMENT S2S_FMHSet "" UBYTE CM_uint8 0 0 0 255 ECU_ADDRESS 0x3434C7A8 /* @ECU_Address@S2S_FMHSet@ */ /end MEASUREMENT
/begin MEASUREMENT S2S_ExteriorLightSet "" UBYTE CM_uint8 0 0 0 255 ECU_ADDRESS 0x3434C7A0 /* @ECU_Address@S2S_ExteriorLightSet@ */ /end MEASUREMENT
/begin MEASUREMENT S2S_AHBSet "" UBYTE CM_uint8 0 0 0 255 ECU_ADDRESS 0x3434C7A7 /* @ECU_Address@S2S_AHBSet@ */ /end MEASUREMENT
/begin MEASUREMENT Nv_WelcomeLightSet "" UBYTE CM_uint8 0 0 0 255 ECU_ADDRESS 0x3434C7AB /* @ECU_Address@Nv_WelcomeLightSet@ */ /end MEASUREMENT
/begin MEASUREMENT Nv_RearFogLightSet "" UBYTE CM_uint8 0 0 0 255 ECU_ADDRESS 0x3434C7A5 /* @ECU_Address@Nv_RearFogLightSet@ */ /end MEASUREMENT
/begin MEASUREMENT Nv_FrontFogLightSet "" UBYTE CM_uint8 0 0 0 255 ECU_ADDRESS 0x3434C7A3 /* @ECU_Address@Nv_FrontFogLightSet@ */ /end MEASUREMENT
/begin MEASUREMENT Nv_FMHSet "" UBYTE CM_uint8 0 0 0 255 ECU_ADDRESS 0x3434C7A9 /* @ECU_Address@Nv_FMHSet@ */ /end MEASUREMENT
/begin MEASUREMENT Nv_ExteriorLightSet "" UBYTE CM_uint8 0 0 0 255 ECU_ADDRESS 0x3434C7A1 /* @ECU_Address@Nv_ExteriorLightSet@ */ /end MEASUREMENT
/begin MEASUREMENT IF_FCAM_FLRCTAWarningRequest "" UBYTE CM_uint8 0 0 0 255 ECU_ADDRESS 0x3434CA9A /* @ECU_Address@IF_FCAM_FLRCTAWarningRequest@ */ /end MEASUREMENT
/begin MEASUREMENT IDB_AutoHazardRequest "" UBYTE CM_uint8 0 0 0 255 ECU_ADDRESS 0x3434CA33 /* @ECU_Address@IDB_AutoHazardRequest@ */ /end MEASUREMENT
/begin MEASUREMENT IDB_AVHActiveStatus "" UBYTE CM_uint8 0 0 0 255 ECU_ADDRESS 0x3434CA34 /* @ECU_Address@IDB_AVHActiveStatus@ */ /end MEASUREMENT
/begin MEASUREMENT HLMR_MotorTemperatureInfo "" UBYTE CM_uint8 0 0 0 255 ECU_ADDRESS 0x3434CA95 /* @ECU_Address@HLMR_MotorTemperatureInfo@ */ /end MEASUREMENT
/begin MEASUREMENT HLML_MotorTemperatureInfo "" UBYTE CM_uint8 0 0 0 255 ECU_ADDRESS 0x3434CA96 /* @ECU_Address@HLML_MotorTemperatureInfo@ */ /end MEASUREMENT
/begin MEASUREMENT FCAM_FRRCTAWarningRequest "" UBYTE CM_uint8 0 0 0 255 ECU_ADDRESS 0x3434CA97 /* @ECU_Address@FCAM_FRRCTAWarningRequest@ */ /end MEASUREMENT
/begin MEASUREMENT FCAM_FRDOWWarningRequest "" UBYTE CM_uint8 0 0 0 255 ECU_ADDRESS 0x3434CA98 /* @ECU_Address@FCAM_FRDOWWarningRequest@ */ /end MEASUREMENT
/begin MEASUREMENT FCAM_FRBSDWarningRequest "" UBYTE CM_uint8 0 0 0 255 ECU_ADDRESS 0x3434CA8D /* @ECU_Address@FCAM_FRBSDWarningRequest@ */ /end MEASUREMENT
/begin MEASUREMENT FCAM_FLDOWWarningRequest "" UBYTE CM_uint8 0 0 0 255 ECU_ADDRESS 0x3434CA9B /* @ECU_Address@FCAM_FLDOWWarningRequest@ */ /end MEASUREMENT
/begin MEASUREMENT FCAM_FLBSDWarningRequest "" UBYTE CM_uint8 0 0 0 255 ECU_ADDRESS 0x3434CA9C /* @ECU_Address@FCAM_FLBSDWarningRequest@ */ /end MEASUREMENT
/begin MEASUREMENT FCAM_AHBRightHBRequest "" UBYTE CM_uint8 0 0 0 255 ECU_ADDRESS 0x3434CA9D /* @ECU_Address@FCAM_AHBRightHBRequest@ */ /end MEASUREMENT
/begin MEASUREMENT FCAM_AHBLeftHBRequest "" UBYTE CM_uint8 0 0 0 255 ECU_ADDRESS 0x3434CA9E /* @ECU_Address@FCAM_AHBLeftHBRequest@ */ /end MEASUREMENT
/begin MEASUREMENT EPS_SteeringWheelAngle "" FLOAT32_IEEE CM_single 0 0 -3.4E+38 3.4E+38 ECU_ADDRESS 0x3434CAFC /* @ECU_Address@EPS_SteeringWheelAngle@ */ /end MEASUREMENT
/begin MEASUREMENT CVC_ActualGearValid "" UBYTE CM_uint8 0 0 0 255 ECU_ADDRESS 0x3434C7AC /* @ECU_Address@CVC_ActualGearValid@ */ /end MEASUREMENT
/begin MEASUREMENT CLM_DoorLockUnlockType "" UBYTE CM_uint8 0 0 0 255 ECU_ADDRESS 0x3434CB5D /* @ECU_Address@CLM_DoorLockUnlockType@ */ /end MEASUREMENT
/begin MEASUREMENT BCMRE_RearHeightSensorStatus "" UBYTE CM_uint8 0 0 0 255 ECU_ADDRESS 0x3434CA90 /* @ECU_Address@BCMRE_RearHeightSensorStatus@ */ /end MEASUREMENT
/begin MEASUREMENT BCMRE_ReHeightSnsrVolt "" FLOAT32_IEEE CM_single 0 0 -3.4E+38 3.4E+38 ECU_ADDRESS 0x3434CAC4 /* @ECU_Address@BCMRE_ReHeightSnsrVolt@ */ /end MEASUREMENT
/begin MEASUREMENT BCMFR_RLSLampStatusFeedback "" UBYTE CM_uint8 0 0 0 255 ECU_ADDRESS 0x3434CAA8 /* @ECU_Address@BCMFR_RLSLampStatusFeedback@ */ /end MEASUREMENT
/begin MEASUREMENT BCMFR_FRDRLStatus "" UBYTE CM_uint8 0 0 0 255 ECU_ADDRESS 0x3434CAAE /* @ECU_Address@BCMFR_FRDRLStatus@ */ /end MEASUREMENT
/begin MEASUREMENT BCMFL_HazardButtonStatus "" UBYTE CM_uint8 0 0 0 255 ECU_ADDRESS 0x3434CAAF /* @ECU_Address@BCMFL_HazardButtonStatus@ */ /end MEASUREMENT
/begin MEASUREMENT BCMFL_FrontHeightSensorStatus "" UBYTE CM_uint8 0 0 0 255 ECU_ADDRESS 0x3434CAB2 /* @ECU_Address@BCMFL_FrontHeightSensorStatus@ */ /end MEASUREMENT
/begin MEASUREMENT BCMFL_FrntHeightSnsrVolt "" FLOAT32_IEEE CM_single 0 0 -3.4E+38 3.4E+38 ECU_ADDRESS 0x3434CABC /* @ECU_Address@BCMFL_FrntHeightSnsrVolt@ */ /end MEASUREMENT
/begin MEASUREMENT BCMFL_FLDRLStatus "" UBYTE CM_uint8 0 0 0 255 ECU_ADDRESS 0x3434CA6C /* @ECU_Address@BCMFL_FLDRLStatus@ */ /end MEASUREMENT
/end MODULE
/end PROJECT
