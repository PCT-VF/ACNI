/******************************************************************************
* ASAP2 file: aem_ApplErrMgr_FD.a2l
* Code generation for model "aem_ApplErrMgr_FD".
* Model version : 11.15
* Simulink Coder version : 23.2 (R2023b) 01-Aug-2023
* C source code generated on : Tue Sep 03 17:55:54 2024
* Target selection: autosar.tlc
* Embedded hardware selection: Custom Processor->Custom Processor
* Code generation objectives: Unspecified
* Validation result: Not run
* (add additional file header information here)
******************************************************************************/
/* Version 1.71 */
ASAP2_VERSION 1 71
/begin PROJECT ProjectName "Project Comment Goes Here"
/begin HEADER "Header Comments go here" /end HEADER
/begin MODULE ModuleName "Module Comment Goes Here"
/begin MOD_PAR "" VERSION "V1.0" SUPPLIER "Template" CUSTOMER "Template" CUSTOMER_NO "Template" USER "Template" PHONE_NO "" ECU "Template" CPU_TYPE "Template" NO_OF_INTERFACES 1
 /begin MEMORY_SEGMENT Code "Code" CODE FLASH INTERN 0x34980000 0x1604 -1 -1 -1 -1 -1
  /begin IF_DATA ETK_XETK
   /begin ETK_XETK_ACCESS SERIAL_INTERFACE /end ETK_XETK_ACCESS
  /end IF_DATA
  /begin IF_DATA XCPplus 0x0102
   /begin SEGMENT 0x01 0x01 0x00 0x00 0x00
    /begin CHECKSUM XCP_CRC_32 /* checksum: add bytes to 16bit result */ MAX_BLOCK_SIZE 0xFFFFFFFF /end CHECKSUM
    /begin PAGE 0x00 /* page number */ ECU_ACCESS_WITH_XCP_ONLY XCP_READ_ACCESS_WITH_ECU_ONLY XCP_WRITE_ACCESS_NOT_ALLOWED /end PAGE
   /end SEGMENT
  /end IF_DATA
 /end MEMORY_SEGMENT
 /begin MEMORY_SEGMENT Code "Code" CODE FLASH INTERN 0x34980000 0x1604 -1 -1 -1 -1 -1
  /begin IF_DATA ETK_XETK
   /begin ETK_XETK_ACCESS SERIAL_INTERFACE /end ETK_XETK_ACCESS
  /end IF_DATA
  /begin IF_DATA XCPplus 0x0102
   /begin SEGMENT 0x01 0x01 0x00 0x00 0x00
    /begin CHECKSUM XCP_CRC_32 /* checksum: add bytes to 16bit result */ MAX_BLOCK_SIZE 0xFFFFFFFF /end CHECKSUM
    /begin PAGE 0x00 /* page number */ ECU_ACCESS_WITH_XCP_ONLY XCP_READ_ACCESS_WITH_ECU_ONLY XCP_WRITE_ACCESS_NOT_ALLOWED /end PAGE
   /end SEGMENT
  /end IF_DATA
 /end MEMORY_SEGMENT
 /begin MEMORY_SEGMENT .calibration_all ".calibration_all" DATA FLASH INTERN 0x34700000 0x000037AE -1 -1 -1 -1 -1
  /begin IF_DATA XCPplus 0x0102
   /begin SEGMENT 0x02 0x02 0x00 0x00 0x00 /begin CHECKSUM XCP_ADD_11 /end CHECKSUM
    /begin PAGE 0x00 /* page number RP */ ECU_ACCESS_WITH_XCP_ONLY XCP_READ_ACCESS_WITH_ECU_ONLY XCP_WRITE_ACCESS_NOT_ALLOWED /* By this option, this memory page is Reference Page! */ /end PAGE
    /begin PAGE 0x01 /* page number WP */ ECU_ACCESS_WITH_XCP_ONLY XCP_READ_ACCESS_WITH_ECU_ONLY XCP_WRITE_ACCESS_WITH_ECU_ONLY /* By this option, this memory page is Working Page! */ /end PAGE
   /end SEGMENT
  /end IF_DATA
 /end MEMORY_SEGMENT
 /begin MEMORY_SEGMENT mk_exceptiontable "mk_exceptiontable" DATA FLASH INTERN 0x34800000 0x00000800 -1 -1 -1 -1 -1 /end MEMORY_SEGMENT
 /begin MEMORY_SEGMENT text "text" DATA FLASH INTERN 0x34801000 0x000F2F04 -1 -1 -1 -1 -1 /end MEMORY_SEGMENT
 /begin MEMORY_SEGMENT .ROM.MK_Ram_data_C0 ".ROM.MK_Ram_data_C0" DATA FLASH INTERN 0x34988000 0x00000080 -1 -1 -1 -1 -1 /end MEMORY_SEGMENT
 /begin MEMORY_SEGMENT .ROM.MK_Ram_data_C1 ".ROM.MK_Ram_data_C1" DATA FLASH INTERN 0x34990000 0x00000080 -1 -1 -1 -1 -1 /end MEMORY_SEGMENT
 /begin MEMORY_SEGMENT .ROM.MK_Ram_data_C2 ".ROM.MK_Ram_data_C2" DATA FLASH INTERN 0x34998000 0x00000080 -1 -1 -1 -1 -1 /end MEMORY_SEGMENT
 /begin MEMORY_SEGMENT .ROM.MK_Ram_data_C3 ".ROM.MK_Ram_data_C3" DATA FLASH INTERN 0x349A0000 0x00000080 -1 -1 -1 -1 -1 /end MEMORY_SEGMENT
 /begin MEMORY_SEGMENT .ROM.MK_Ram_data ".ROM.MK_Ram_data" DATA FLASH INTERN 0x349A2000 0x00000014 -1 -1 -1 -1 -1 /end MEMORY_SEGMENT
 /begin MEMORY_SEGMENT .ROM.data_C0_RAM_C0 ".ROM.data_C0_RAM_C0" DATA FLASH INTERN 0x349A2020 0x00003044 -1 -1 -1 -1 -1 /end MEMORY_SEGMENT
 /begin MEMORY_SEGMENT .ROM.data_C1_RAM_C1 ".ROM.data_C1_RAM_C1" DATA FLASH INTERN 0x349A5080 0x00000000 -1 -1 -1 -1 -1 /end MEMORY_SEGMENT
 /begin MEMORY_SEGMENT .ROM.data_C2_RAM_BSW_Share ".ROM.data_C2_RAM_BSW_Share" DATA FLASH INTERN 0x349A5080 0x000082B8 -1 -1 -1 -1 -1 /end MEMORY_SEGMENT
 /begin MEMORY_SEGMENT .ROM.data_C2_RAM_GLB ".ROM.data_C2_RAM_GLB" DATA FLASH INTERN 0x349AD340 0x0000042D -1 -1 -1 -1 -1 /end MEMORY_SEGMENT
 /begin MEMORY_SEGMENT .ecuinfo ".ecuinfo" DATA FLASH INTERN 0x34FFFC00 0x000000A8 -1 -1 -1 -1 -1 /end MEMORY_SEGMENT
/end MOD_PAR
/begin MOD_COMMON "Common definitions" BYTE_ORDER MSB_LAST ALIGNMENT_BYTE 1 ALIGNMENT_WORD 2 ALIGNMENT_LONG 4 ALIGNMENT_FLOAT32_IEEE 4 ALIGNMENT_FLOAT64_IEEE 8 /end MOD_COMMON
/begin IF_DATA XCPplus 0x0102
 /begin PAG /* MAX_SEGMENTS */ 21 /end PAG
 /*************** start of PROTOCOL_LAYER *******************/
 /begin PROTOCOL_LAYER /* At MODULE */ 0x0102 /* XCP protocol layer version */ 1000 /* T1 [ms] */ 1000 /* T2 [ms] */ 0 /* T3 [ms] */ 0 /* T4 [ms] */ 0 /* T5 [ms] */ 0 /* T6 [ms] */ 0 /* T7 [ms] */ 8 /* MAX_CTO */ 8 /* MAX_DTO default for DAQ and STIM */ BYTE_ORDER_MSB_LAST /* BYTE_ORDER: INTEL */ ADDRESS_GRANULARITY_BYTE /* ADDRESS_GRANULARITY */ OPTIONAL_CMD GET_COMM_MODE_INFO OPTIONAL_CMD SET_MTA OPTIONAL_CMD UPLOAD OPTIONAL_CMD SHORT_UPLOAD OPTIONAL_CMD BUILD_CHECKSUM OPTIONAL_CMD DOWNLOAD OPTIONAL_CMD DOWNLOAD_NEXT OPTIONAL_CMD DOWNLOAD_MAX OPTIONAL_CMD SET_CAL_PAGE OPTIONAL_CMD GET_CAL_PAGE OPTIONAL_CMD COPY_CAL_PAGE OPTIONAL_CMD CLEAR_DAQ_LIST OPTIONAL_CMD SET_DAQ_PTR OPTIONAL_CMD WRITE_DAQ OPTIONAL_CMD SET_DAQ_LIST_MODE OPTIONAL_CMD START_STOP_DAQ_LIST OPTIONAL_CMD START_STOP_SYNCH OPTIONAL_CMD FREE_DAQ OPTIONAL_CMD ALLOC_DAQ OPTIONAL_CMD ALLOC_ODT OPTIONAL_CMD ALLOC_ODT_ENTRY COMMUNICATION_MODE_SUPPORTED /* optional modes supported */ BLOCK SLAVE /* Slave Block Mode supported */ MASTER /* Master Block Mode supported */ 255 /* MAX_BS */ 0 /* MIN_ST */ /end PROTOCOL_LAYER
 /***************** end of PROTOCOL_LAYER *******************/
 /begin DAQ DYNAMIC 65535 3 0 OPTIMISATION_TYPE_DEFAULT ADDRESS_EXTENSION_FREE IDENTIFICATION_FIELD_TYPE_ABSOLUTE GRANULARITY_ODT_ENTRY_SIZE_DAQ_BYTE 255 OVERLOAD_INDICATION_EVENT PRESCALER_SUPPORTED /begin DAQ_MEMORY_CONSUMPTION 4995 46 6 5 2 0 /end DAQ_MEMORY_CONSUMPTION
  /begin EVENT "10ms time synchronous" "10_ms" 0 DAQ 1 10 6 6 CONSISTENCY EVENT /end EVENT
  /begin EVENT "1ms time synchronous" "1_ms" 1 DAQ 1 1 6 8 CONSISTENCY EVENT /end EVENT
  /begin EVENT "100ms time synchronous" "100_ms" 2 DAQ 1 100 6 5 CONSISTENCY EVENT /end EVENT
 /end DAQ
 /begin XCP_ON_CAN 0x0102 CAN_ID_MASTER 0x7B1 CAN_ID_SLAVE 0x782 BAUDRATE 500000 SAMPLE_POINT 75 BTL_CYCLES 8 SJW 1 MAX_BUS_LOAD 90 MAX_DLC_REQUIRED TRANSPORT_LAYER_INSTANCE "Calibration CAN (APPL)" /end XCP_ON_CAN
 /begin XCP_ON_CAN 0x0102 CAN_ID_MASTER 0x7B1 CAN_ID_SLAVE 0x782 BAUDRATE 500000 SAMPLE_POINT 75 BTL_CYCLES 8 SJW 1 MAX_BUS_LOAD 90 MAX_DLC_REQUIRED
  /begin DAQ DYNAMIC 65535 3 0 OPTIMISATION_TYPE_DEFAULT ADDRESS_EXTENSION_FREE IDENTIFICATION_FIELD_TYPE_ABSOLUTE GRANULARITY_ODT_ENTRY_SIZE_DAQ_BYTE 255 OVERLOAD_INDICATION_EVENT PRESCALER_SUPPORTED /begin DAQ_MEMORY_CONSUMPTION 19995 46 6 5 2 0 /end DAQ_MEMORY_CONSUMPTION
   /begin EVENT "10ms time synchronous" "10_ms" 0 DAQ 1 10 6 6 CONSISTENCY EVENT /end EVENT
   /begin EVENT "1ms time synchronous" "1_ms" 1 DAQ 1 1 6 8 CONSISTENCY EVENT /end EVENT
   /begin EVENT "100ms time synchronous" "100_ms" 2 DAQ 1 100 6 5 CONSISTENCY EVENT /end EVENT
  /end DAQ
  TRANSPORT_LAYER_INSTANCE "Calibration CAN (APPL) (ED-RAM)" /end XCP_ON_CAN
 /begin XCP_ON_CAN 0x0102 CAN_ID_MASTER 0x7B1 CAN_ID_SLAVE 0x782 BAUDRATE 500000 SAMPLE_POINT 75 BTL_CYCLES 8 SJW 1 MAX_BUS_LOAD 20 MAX_DLC_REQUIRED TRANSPORT_LAYER_INSTANCE "Vehicle CAN (PT)" /end XCP_ON_CAN
 /begin XCP_ON_CAN 0x0102 CAN_ID_MASTER 0x7B1 CAN_ID_SLAVE 0x782 BAUDRATE 500000 SAMPLE_POINT 75 BTL_CYCLES 8 SJW 1 MAX_BUS_LOAD 20 MAX_DLC_REQUIRED TRANSPORT_LAYER_INSTANCE "Vehicle CAN (PT) (ED-RAM)" /end XCP_ON_CAN
 /begin XCP_ON_CAN 0x0102 CAN_ID_MASTER 0x400007B1 CAN_ID_SLAVE 0x400007F82 BAUDRATE 500000 SAMPLE_POINT 75 BTL_CYCLES 8 SJW 1 MAX_BUS_LOAD 80
  /begin CAN_FD MAX_DLC 64 /* 8, 12, 16, 20, 24, 32, 48 or 64 */ CAN_FD_DATA_TRANSFER_BAUDRATE 2000000 SAMPLE_POINT 75 /* sample point receiver*/ BTL_CYCLES 8 SJW 1 /end CAN_FD
  /begin DAQ DYNAMIC 65535 3 0 OPTIMISATION_TYPE_ODT_TYPE_32 ADDRESS_EXTENSION_FREE IDENTIFICATION_FIELD_TYPE_RELATIVE_WORD_ALIGNED GRANULARITY_ODT_ENTRY_SIZE_DAQ_BYTE 255 OVERLOAD_INDICATION_EVENT PRESCALER_SUPPORTED /begin DAQ_MEMORY_CONSUMPTION 4995 208 6 5 2 0 /end DAQ_MEMORY_CONSUMPTION /begin EVENT "10ms time synchronous" "10_ms" 0 DAQ 1 10 6 6 /end EVENT /begin EVENT "1ms time synchronous" "1_ms" 1 DAQ 1 1 6 8 /end EVENT /begin EVENT "100ms time synchronous" "100_ms" 2 DAQ 1 100 6 5 /end EVENT /end DAQ
  TRANSPORT_LAYER_INSTANCE "Calibration CAN-FD (APPL-FD)" /end XCP_ON_CAN
 /begin XCP_ON_CAN 0x0102 CAN_ID_MASTER 0x400007F0 CAN_ID_SLAVE 0x400007F1 BAUDRATE 500000 SAMPLE_POINT 75 BTL_CYCLES 8 SJW 1 MAX_BUS_LOAD 80
  /begin CAN_FD MAX_DLC 64 /* 8, 12, 16, 20, 24, 32, 48 or 64 */ CAN_FD_DATA_TRANSFER_BAUDRATE 2000000 SAMPLE_POINT 75 /* sample point receiver*/ BTL_CYCLES 8 SJW 1 /end CAN_FD
  /begin DAQ DYNAMIC 65535 3 0 OPTIMISATION_TYPE_ODT_TYPE_32 ADDRESS_EXTENSION_FREE IDENTIFICATION_FIELD_TYPE_RELATIVE_WORD_ALIGNED GRANULARITY_ODT_ENTRY_SIZE_DAQ_BYTE 255 OVERLOAD_INDICATION_EVENT PRESCALER_SUPPORTED /begin DAQ_MEMORY_CONSUMPTION 19995 208 6 5 2 0 /end DAQ_MEMORY_CONSUMPTION /begin EVENT "10ms time synchronous" "10_ms" 0 DAQ 1 10 6 6 /end EVENT /begin EVENT "1ms time synchronous" "1_ms" 1 DAQ 1 1 6 8 /end EVENT /begin EVENT "100ms time synchronous" "100_ms" 2 DAQ 1 100 6 5 /end EVENT /end DAQ
  TRANSPORT_LAYER_INSTANCE "Calibration CAN-FD (APPL-FD) (ED-RAM)" /end XCP_ON_CAN
/end IF_DATA
/begin MOD_COMMON "Mod Common Comment Here" BYTE_ORDER MSB_LAST ALIGNMENT_BYTE 1 ALIGNMENT_WORD 2 ALIGNMENT_LONG 4 ALIGNMENT_FLOAT32_IEEE 4 ALIGNMENT_FLOAT64_IEEE 8 ALIGNMENT_INT64 8 /end MOD_COMMON
/begin CHARACTERISTIC WASHER_WIPE_TIME "" VALUE 0x3470011F /* @ECU_Address@WASHER_WIPE_TIME@ */ Record_UBYTE 0 CM_uint8 0 255 /end CHARACTERISTIC
/begin CHARACTERISTIC VSM_SpeedThreshold_P "" VALUE 0x347036D4 /* @ECU_Address@VSM_SpeedThreshold_P@ */ Record_FLOAT32_IEEE 0 CM_single -3.4E+38 3.4E+38 /end CHARACTERISTIC
/begin CHARACTERISTIC VSM_MaximumSpeed_P "" VALUE 0x3470186E /* @ECU_Address@VSM_MaximumSpeed_P@ */ Record_UWORD 0 CM_uint16 0 65535 /end CHARACTERISTIC
/begin CHARACTERISTIC VSM_LowerVehicleOffset_P "" VALUE 0x347036D0 /* @ECU_Address@VSM_LowerVehicleOffset_P@ */ Record_FLOAT32_IEEE 0 CM_single -3.4E+38 3.4E+38 /end CHARACTERISTIC
/begin CHARACTERISTIC VSM_LowerSpeedPercentageFactor_P "" VALUE 0x347036CC /* @ECU_Address@VSM_LowerSpeedPercentageFactor_P@ */ Record_FLOAT32_IEEE 0 CM_single -3.4E+38 3.4E+38 /end CHARACTERISTIC
/begin CHARACTERISTIC VSM_InvalidDigitSpeed_P "" VALUE 0x3470186C /* @ECU_Address@VSM_InvalidDigitSpeed_P@ */ Record_UWORD 0 CM_uint16 0 65535 /end CHARACTERISTIC
/begin CHARACTERISTIC VSM_HigherSpeedOffset_P "" VALUE 0x347036C8 /* @ECU_Address@VSM_HigherSpeedOffset_P@ */ Record_FLOAT32_IEEE 0 CM_single -3.4E+38 3.4E+38 /end CHARACTERISTIC
/begin CHARACTERISTIC VSM_GeneralSpeedPercentageFactor_P "" VALUE 0x347036C4 /* @ECU_Address@VSM_GeneralSpeedPercentageFactor_P@ */ Record_FLOAT32_IEEE 0 CM_single -3.4E+38 3.4E+38 /end CHARACTERISTIC
/begin CHARACTERISTIC VSM_DigitSpeed_O "Calibration value for output digitSpeed" VALUE 0x3470186A /* @ECU_Address@VSM_DigitSpeed_O@ */ Record_UWORD 0 CM_uint16 0 65535 /end CHARACTERISTIC
/begin CHARACTERISTIC VSM_DigitSpeed_E "Calibration switch for output digitSpeed" VALUE 0x3470011E /* @ECU_Address@VSM_DigitSpeed_E@ */ Record_UBYTE 0 CM_uint8 0 255 /end CHARACTERISTIC
/begin CHARACTERISTIC VMS_Ts_P "" VALUE 0x347036C0 /* @ECU_Address@VMS_Ts_P@ */ Record_FLOAT32_IEEE 0 CM_single -3.4E+38 3.4E+38 /end CHARACTERISTIC
/begin CHARACTERISTIC VMS_TimeConstantForFilter_P "" VALUE 0x347036BC /* @ECU_Address@VMS_TimeConstantForFilter_P@ */ Record_FLOAT32_IEEE 0 CM_single -3.4E+38 3.4E+38 /end CHARACTERISTIC
/begin CHARACTERISTIC TCM_Ts_P "" VALUE 0x34703694 /* @ECU_Address@TCM_Ts_P@ */ Record_FLOAT32_IEEE 0 CM_single -3.4E+38 3.4E+38 /end CHARACTERISTIC
/begin CHARACTERISTIC TCM_STANDSTILL_VELOCITY_THRESHOLD_P "" VALUE 0x34703690 /* @ECU_Address@TCM_STANDSTILL_VELOCITY_THRESHOLD_P@ */ Record_FLOAT32_IEEE 0 CM_single -3.4E+38 3.4E+38 /end CHARACTERISTIC
/begin CHARACTERISTIC TCM_OccupancySeatbeltMonitorCfgFlag_P "" VALUE 0x34700114 /* @ECU_Address@TCM_OccupancySeatbeltMonitorCfgFlag_P@ */ Record_BOOLEAN 0 CM_boolean 0 1 /end CHARACTERISTIC
/begin CHARACTERISTIC TCM_ON_LOWSOC_SAVEMODE_TIME_P "" VALUE 0x34700113 /* @ECU_Address@TCM_ON_LOWSOC_SAVEMODE_TIME_P@ */ Record_UBYTE 0 CM_uint8 0 255 /end CHARACTERISTIC
/begin CHARACTERISTIC TCM_ON_IDLE_TIME_P "Unit is second, default value is 600s" VALUE 0x34701868 /* @ECU_Address@TCM_ON_IDLE_TIME_P@ */ Record_UWORD 0 CM_uint16 0 65535 /end CHARACTERISTIC
/begin CHARACTERISTIC TCM_MINIMUM_HV_SOC_THRESHOLD_P "" VALUE 0x3470368C /* @ECU_Address@TCM_MINIMUM_HV_SOC_THRESHOLD_P@ */ Record_FLOAT32_IEEE 0 CM_single -3.4E+38 3.4E+38 /end CHARACTERISTIC
/begin CHARACTERISTIC TCM_ImmobilizerConfigurationFlag_P "" VALUE 0x34700112 /* @ECU_Address@TCM_ImmobilizerConfigurationFlag_P@ */ Record_BOOLEAN 0 CM_boolean 0 1 /end CHARACTERISTIC
/begin CHARACTERISTIC TCM_CpdConfigurationFlag_P "" VALUE 0x34700111 /* @ECU_Address@TCM_CpdConfigurationFlag_P@ */ Record_BOOLEAN 0 CM_boolean 0 1 /end CHARACTERISTIC
/begin CHARACTERISTIC TCM_CHARGING_DISPLAY_TIME_P "Unit is second, default value is 300" VALUE 0x34701866 /* @ECU_Address@TCM_CHARGING_DISPLAY_TIME_P@ */ Record_UWORD 0 CM_uint16 0 65535 /end CHARACTERISTIC
/begin CHARACTERISTIC TCM_AlcoholInterLockConfigurationFlag_P "" VALUE 0x34700110 /* @ECU_Address@TCM_AlcoholInterLockConfigurationFlag_P@ */ Record_BOOLEAN 0 CM_boolean 0 1 /end CHARACTERISTIC
/begin CHARACTERISTIC TCM_ACC_LOWSOC_SAVEMODE_TIME_P "" VALUE 0x3470010F /* @ECU_Address@TCM_ACC_LOWSOC_SAVEMODE_TIME_P@ */ Record_UBYTE 0 CM_uint8 0 255 /end CHARACTERISTIC
/begin CHARACTERISTIC TCM_ACC_IDLE_TIME_P "Unit is second, default value is 120s." VALUE 0x3470010E /* @ECU_Address@TCM_ACC_IDLE_TIME_P@ */ Record_UBYTE 0 CM_uint8 0 255 /end CHARACTERISTIC
/begin CHARACTERISTIC SMAM_Ts_P "" VALUE 0x34703688 /* @ECU_Address@SMAM_Ts_P@ */ Record_FLOAT32_IEEE 0 CM_single -3.4E+38 3.4E+38 /end CHARACTERISTIC
/begin CHARACTERISTIC SMAM_HeatingTimer_P "Unit is second" VALUE 0x34701864 /* @ECU_Address@SMAM_HeatingTimer_P@ */ Record_UWORD 0 CM_uint16 0 65535 /end CHARACTERISTIC
/begin CHARACTERISTIC VEHICLE_UNLOCKED_DOME_LIGHT_ON_DURATION "" VALUE 0x34703684 /* @ECU_Address@VEHICLE_UNLOCKED_DOME_LIGHT_ON_DURATION@ */ Record_FLOAT32_IEEE 0 CM_single -3.4E+38 3.4E+38 /end CHARACTERISTIC
/begin CHARACTERISTIC MIN_BRIGHTNESS_ILLUMINATION "" VALUE 0x3470010C /* @ECU_Address@MIN_BRIGHTNESS_ILLUMINATION@ */ Record_UBYTE 0 CM_uint8 0 255 /end CHARACTERISTIC
/begin CHARACTERISTIC DOME_LIGHT_ON_DURATION "" VALUE 0x34703680 /* @ECU_Address@DOME_LIGHT_ON_DURATION@ */ Record_FLOAT32_IEEE 0 CM_single -3.4E+38 3.4E+38 /end CHARACTERISTIC
/begin CHARACTERISTIC CRASHED_DOME_LIGHT_ON_DURATION "" VALUE 0x3470367C /* @ECU_Address@CRASHED_DOME_LIGHT_ON_DURATION@ */ Record_FLOAT32_IEEE 0 CM_single -3.4E+38 3.4E+38 /end CHARACTERISTIC
/begin CHARACTERISTIC PANIC_ALARM_HORN_ON_DURATION "" VALUE 0x34703678 /* @ECU_Address@PANIC_ALARM_HORN_ON_DURATION@ */ Record_FLOAT32_IEEE 0 CM_single -3.4E+38 3.4E+38 /end CHARACTERISTIC
/begin CHARACTERISTIC PANIC_ALARM_HORN_OFF_DURATION "" VALUE 0x34703674 /* @ECU_Address@PANIC_ALARM_HORN_OFF_DURATION@ */ Record_FLOAT32_IEEE 0 CM_single -3.4E+38 3.4E+38 /end CHARACTERISTIC
/begin CHARACTERISTIC KEYFOB_PE_HORN_ON_DURATION "" VALUE 0x34703670 /* @ECU_Address@KEYFOB_PE_HORN_ON_DURATION@ */ Record_FLOAT32_IEEE 0 CM_single -3.4E+38 3.4E+38 /end CHARACTERISTIC
/begin CHARACTERISTIC KEYFOB_PE_HORN_OFF_DURATION "" VALUE 0x3470366C /* @ECU_Address@KEYFOB_PE_HORN_OFF_DURATION@ */ Record_FLOAT32_IEEE 0 CM_single -3.4E+38 3.4E+38 /end CHARACTERISTIC
/begin CHARACTERISTIC KEYFOB_PE_HORN_CYCLE "" VALUE 0x3470010A /* @ECU_Address@KEYFOB_PE_HORN_CYCLE@ */ Record_UBYTE 0 CM_uint8 0 255 /end CHARACTERISTIC
/begin CHARACTERISTIC HCM_Ts_P "" VALUE 0x34703668 /* @ECU_Address@HCM_Ts_P@ */ Record_FLOAT32_IEEE 0 CM_single -3.4E+38 3.4E+38 /end CHARACTERISTIC
/begin CHARACTERISTIC CAPP_HORN_ON_DURATION "" VALUE 0x34703664 /* @ECU_Address@CAPP_HORN_ON_DURATION@ */ Record_FLOAT32_IEEE 0 CM_single -3.4E+38 3.4E+38 /end CHARACTERISTIC
/begin CHARACTERISTIC CAPP_HORN_OFF_DURATION "" VALUE 0x34703660 /* @ECU_Address@CAPP_HORN_OFF_DURATION@ */ Record_FLOAT32_IEEE 0 CM_single -3.4E+38 3.4E+38 /end CHARACTERISTIC
/begin CHARACTERISTIC CAPP_HORN_CYCLE "" VALUE 0x34700109 /* @ECU_Address@CAPP_HORN_CYCLE@ */ Record_UBYTE 0 CM_uint8 0 255 /end CHARACTERISTIC
/begin CHARACTERISTIC ALARM_TRIGGERED_HORN_ON_DURATION "" VALUE 0x3470365C /* @ECU_Address@ALARM_TRIGGERED_HORN_ON_DURATION@ */ Record_FLOAT32_IEEE 0 CM_single -3.4E+38 3.4E+38 /end CHARACTERISTIC
/begin CHARACTERISTIC ALARM_TRIGGERED_HORN_OFF_DURATION "" VALUE 0x34703658 /* @ECU_Address@ALARM_TRIGGERED_HORN_OFF_DURATION@ */ Record_FLOAT32_IEEE 0 CM_single -3.4E+38 3.4E+38 /end CHARACTERISTIC
/begin CHARACTERISTIC BYPASS_REQUEST_INDICATOR_LIGHT "" VALUE 0x34700102 /* @ECU_Address@BYPASS_REQUEST_INDICATOR_LIGHT@ */ Record_UBYTE 0 CM_uint8 0 255 /end CHARACTERISTIC
/begin CHARACTERISTIC BYPASS_REQUEST_ALL_LIGHT "" VALUE 0x347000FC /* @ECU_Address@BYPASS_REQUEST_ALL_LIGHT@ */ Record_UBYTE 0 CM_uint8 0 255 /end CHARACTERISTIC
/begin CHARACTERISTIC BYPASS_CONTROL_CONSTANT_INDICATOR_LIGHT "" VALUE 0x347000F5 /* @ECU_Address@BYPASS_CONTROL_CONSTANT_INDICATOR_LIGHT@ */ Record_BOOLEAN 0 CM_boolean 0 1 /end CHARACTERISTIC
/begin CHARACTERISTIC BYPASS_CONTROL_CONSTANT_ALL_LIGHT "" VALUE 0x347000EF /* @ECU_Address@BYPASS_CONTROL_CONSTANT_ALL_LIGHT@ */ Record_BOOLEAN 0 CM_boolean 0 1 /end CHARACTERISTIC
/begin COMPU_METHOD CM_uint8 "Q = V" IDENTICAL "%3.0" "" /end COMPU_METHOD
/begin COMPU_METHOD CM_int8 "Q = V" IDENTICAL "%3.0" "" /end COMPU_METHOD
/begin COMPU_METHOD CM_double "Q = V" IDENTICAL "%15.10" "" /end COMPU_METHOD
/begin COMPU_METHOD CM_uint32 "Q = V" IDENTICAL "%10.0" "" /end COMPU_METHOD
/begin COMPU_METHOD CM_uint16 "Q = V" IDENTICAL "%5.0" "" /end COMPU_METHOD
/begin COMPU_METHOD CM_single "Q = V" IDENTICAL "%8.6" "" /end COMPU_METHOD
/begin COMPU_METHOD CM_boolean "Q = V" IDENTICAL "%1.0" "" /end COMPU_METHOD
/begin RECORD_LAYOUT Record_UBYTE FNC_VALUES 1 UBYTE COLUMN_DIR DIRECT /end RECORD_LAYOUT
/begin RECORD_LAYOUT Record_UWORD FNC_VALUES 1 UWORD COLUMN_DIR DIRECT /end RECORD_LAYOUT
/begin RECORD_LAYOUT Record_FLOAT32_IEEE FNC_VALUES 1 FLOAT32_IEEE COLUMN_DIR DIRECT /end RECORD_LAYOUT
/begin RECORD_LAYOUT Record_BOOLEAN FNC_VALUES 1 UBYTE COLUMN_DIR DIRECT /end RECORD_LAYOUT
/begin GROUP AntiTheftAlarm "AntiTheftAlarm" ROOT /end GROUP
/begin GROUP WiperWasherManager_WWM_Main_sys_Subsystem_WiperAutoModeSetting_RearWiperAutoModeSetting "WiperWasherManager/WWM_Main_sys/Subsystem/WiperAutoModeSetting/RearWiperAutoModeSetting" /begin REF_MEASUREMENT Nv_RearWiperAutoModeSet S2S_RearWiperAutoModeSet /end REF_MEASUREMENT /end GROUP
/begin GROUP WiperWasherManager_WWM_Main_sys_Subsystem_WiperAutoModeSetting_FrontWiperAutoModeSetting "WiperWasherManager/WWM_Main_sys/Subsystem/WiperAutoModeSetting/FrontWiperAutoModeSetting" /begin REF_MEASUREMENT COM_ThumbWheelSts /end REF_MEASUREMENT /end GROUP
/begin GROUP WiperWasherManager_WWM_Main_sys_Subsystem_WiperAutoModeSetting "WiperWasherManager/WWM_Main_sys/Subsystem/WiperAutoModeSetting"
 /begin SUB_GROUP WiperWasherManager_WWM_Main_sys_Subsystem_WiperAutoModeSetting_FrontWiperAutoModeSetting WiperWasherManager_WWM_Main_sys_Subsystem_WiperAutoModeSetting_RearWiperAutoModeSetting /end SUB_GROUP
/end GROUP
/begin GROUP WiperWasherManager_WWM_Main_sys_Subsystem_WasherControl_RearWasherControl "WiperWasherManager/WWM_Main_sys/Subsystem/WasherControl/RearWasherControl" /end GROUP
/begin GROUP WiperWasherManager_WWM_Main_sys_Subsystem_WasherControl_FrontWasherControl "WiperWasherManager/WWM_Main_sys/Subsystem/WasherControl/FrontWasherControl" /end GROUP
/begin GROUP WiperWasherManager_WWM_Main_sys_Subsystem_WasherControl "WiperWasherManager/WWM_Main_sys/Subsystem/WasherControl"
 /begin SUB_GROUP WiperWasherManager_WWM_Main_sys_Subsystem_WasherControl_FrontWasherControl WiperWasherManager_WWM_Main_sys_Subsystem_WasherControl_RearWasherControl /end SUB_GROUP
/end GROUP
/begin GROUP WiperWasherManager_WWM_Main_sys_Subsystem_WASHER_WIPE_TIME2 "WiperWasherManager/WWM_Main_sys/Subsystem/WASHER_WIPE_TIME2" /begin REF_CHARACTERISTIC WASHER_WIPE_TIME /end REF_CHARACTERISTIC /end GROUP
/begin GROUP WiperWasherManager_WWM_Main_sys_Subsystem_WASHER_WIPE_TIME "WiperWasherManager/WWM_Main_sys/Subsystem/WASHER_WIPE_TIME" /begin REF_CHARACTERISTIC WASHER_WIPE_TIME /end REF_CHARACTERISTIC /end GROUP
/begin GROUP WiperWasherManager_WWM_Main_sys_Subsystem_RLSSensitivityLevelRisingDetect_Detect_Increase "WiperWasherManager/WWM_Main_sys/Subsystem/RLSSensitivityLevelRisingDetect/Detect\r\nIncrease" /begin REF_MEASUREMENT COM_ThumbWheelSts /end REF_MEASUREMENT /end GROUP
/begin GROUP WiperWasherManager_WWM_Main_sys_Subsystem_RLSSensitivityLevelRisingDetect "WiperWasherManager/WWM_Main_sys/Subsystem/RLSSensitivityLevelRisingDetect"
 /begin SUB_GROUP WiperWasherManager_WWM_Main_sys_Subsystem_RLSSensitivityLevelRisingDetect_Detect_Increase /end SUB_GROUP
/end GROUP
/begin GROUP WiperWasherManager_WWM_Main_sys_Subsystem_Bit_Upack "WiperWasherManager/WWM_Main_sys/Subsystem/Bit Upack" /begin REF_MEASUREMENT COM_RightStalkSwitchSts /end REF_MEASUREMENT /end GROUP
/begin GROUP WiperWasherManager_WWM_Main_sys_Subsystem "WiperWasherManager/WWM_Main_sys/Subsystem"
 /begin SUB_GROUP WiperWasherManager_WWM_Main_sys_Subsystem_Bit_Upack WiperWasherManager_WWM_Main_sys_Subsystem_RLSSensitivityLevelRisingDetect WiperWasherManager_WWM_Main_sys_Subsystem_WASHER_WIPE_TIME WiperWasherManager_WWM_Main_sys_Subsystem_WASHER_WIPE_TIME2 WiperWasherManager_WWM_Main_sys_Subsystem_WasherControl WiperWasherManager_WWM_Main_sys_Subsystem_WiperAutoModeSetting /end SUB_GROUP
 /begin REF_MEASUREMENT COM_FrontWiperParkPosSts COM_FrontWiperSts COM_RLSWiperSpeedReq COM_RearWiperParkPosSts COM_RearWiperWorkingSts COM_ThumbWheelSts S2S_WiperServiceModeSet /end REF_MEASUREMENT
/end GROUP
/begin GROUP WiperWasherManager_WWM_Main_sys "WiperWasherManager/WWM_Main_sys" /begin SUB_GROUP WiperWasherManager_WWM_Main_sys_Subsystem /end SUB_GROUP /end GROUP
/begin GROUP WiperWasherManager "WiperWasherManager" ROOT /begin SUB_GROUP WiperWasherManager_WWM_Main_sys /end SUB_GROUP
 /begin REF_MEASUREMENT COM_FrontWiperParkPosSts COM_FrontWiperStepTimeSts COM_FrontWiperSts COM_RLSWiperSpeedReq COM_RearWiperParkPosSts COM_RearWiperWorkingSts COM_RightStalkSwitchSts COM_ThumbWheelSts COM_WasherPumpSts COM_WiperServiceModeSts Nv_RearWiperAutoModeSet S2S_RearWiperAutoModeSet S2S_WiperServiceModeSet WWM_AutoModeLEDSts WWM_AutoOrIntervalModeSts WWM_FrontWasherFluidSpayReq WWM_FrontWiperSpeedSet WWM_FrontWiperStepTimeSet WWM_Nv_RearWiperAutoModeSet WWM_RLSSensitivityLevelSet WWM_RearWasherFluidSpayReq WWM_RearWiperAutoMode WWM_RearWiperSet WWM_WiperServiceModeSet /end REF_MEASUREMENT
/end GROUP
/begin GROUP WindowControlManager_WCM_Main_sys_WindowControl_WindowCtrlEnableProcessing_VehicleOperationJudgeButton "WindowControlManager/WCM_Main_sys/WindowControl/WindowCtrlEnableProcessing/VehicleOperationJudgeButton" /end GROUP
/begin GROUP WindowControlManager_WCM_Main_sys_WindowControl_WindowCtrlEnableProcessing_FLStopProcessing "WindowControlManager/WCM_Main_sys/WindowControl/WindowCtrlEnableProcessing/FLStopProcessing"
 /begin REF_MEASUREMENT COM_WindowFLThermalProtect COM_WindowPositionFL COM_WindowsFLAntiPinchWarn /end REF_MEASUREMENT
/end GROUP
/begin GROUP WindowControlManager_WCM_Main_sys_WindowControl_WindowCtrlEnableProcessing_FLEnableProcessing "WindowControlManager/WCM_Main_sys/WindowControl/WindowCtrlEnableProcessing/FLEnableProcessing"
 /begin REF_MEASUREMENT COM_WindowFLThermalProtect COM_WindowPositionFL COM_WindowsFLAntiPinchWarn /end REF_MEASUREMENT
/end GROUP
/begin GROUP WindowControlManager_WCM_Main_sys_WindowControl_WindowCtrlEnableProcessing "WindowControlManager/WCM_Main_sys/WindowControl/WindowCtrlEnableProcessing"
 /begin SUB_GROUP WindowControlManager_WCM_Main_sys_WindowControl_WindowCtrlEnableProcessing_FLEnableProcessing WindowControlManager_WCM_Main_sys_WindowControl_WindowCtrlEnableProcessing_FLStopProcessing WindowControlManager_WCM_Main_sys_WindowControl_WindowCtrlEnableProcessing_VehicleOperationJudgeButton /end SUB_GROUP
/end GROUP
/begin GROUP WindowControlManager_WCM_Main_sys_WindowControl_WindowControlOnButton_FLWindowCommand_Detect_Rise_Positive3 "WindowControlManager/WCM_Main_sys/WindowControl/WindowControlOnButton/FLWindowCommand/Detect Rise\r\nPositive3" /end GROUP
/begin GROUP WindowControlManager_WCM_Main_sys_WindowControl_WindowControlOnButton_FLWindowCommand_Detect_Rise_Positive2 "WindowControlManager/WCM_Main_sys/WindowControl/WindowControlOnButton/FLWindowCommand/Detect Rise\r\nPositive2" /end GROUP
/begin GROUP WindowControlManager_WCM_Main_sys_WindowControl_WindowControlOnButton_FLWindowCommand_Detect_Rise_Positive1 "WindowControlManager/WCM_Main_sys/WindowControl/WindowControlOnButton/FLWindowCommand/Detect Rise\r\nPositive1" /end GROUP
/begin GROUP WindowControlManager_WCM_Main_sys_WindowControl_WindowControlOnButton_FLWindowCommand_Detect_Rise_Positive "WindowControlManager/WCM_Main_sys/WindowControl/WindowControlOnButton/FLWindowCommand/Detect Rise\r\nPositive" /end GROUP
/begin GROUP WindowControlManager_WCM_Main_sys_WindowControl_WindowControlOnButton_FLWindowCommand "WindowControlManager/WCM_Main_sys/WindowControl/WindowControlOnButton/FLWindowCommand"
 /begin SUB_GROUP WindowControlManager_WCM_Main_sys_WindowControl_WindowControlOnButton_FLWindowCommand_Detect_Rise_Positive WindowControlManager_WCM_Main_sys_WindowControl_WindowControlOnButton_FLWindowCommand_Detect_Rise_Positive1 WindowControlManager_WCM_Main_sys_WindowControl_WindowControlOnButton_FLWindowCommand_Detect_Rise_Positive2 WindowControlManager_WCM_Main_sys_WindowControl_WindowControlOnButton_FLWindowCommand_Detect_Rise_Positive3 /end SUB_GROUP
 /begin REF_MEASUREMENT COM_WindowDSBBtnPressFL COM_WindowFLLearningSts COM_WindowFLSuppressionWarn /end REF_MEASUREMENT
/end GROUP
/begin GROUP WindowControlManager_WCM_Main_sys_WindowControl_WindowControlOnButton_FLWIndowButtonCommand "WindowControlManager/WCM_Main_sys/WindowControl/WindowControlOnButton/FLWIndowButtonCommand" /end GROUP
/begin GROUP WindowControlManager_WCM_Main_sys_WindowControl_WindowControlOnButton "WindowControlManager/WCM_Main_sys/WindowControl/WindowControlOnButton"
 /begin SUB_GROUP WindowControlManager_WCM_Main_sys_WindowControl_WindowControlOnButton_FLWIndowButtonCommand WindowControlManager_WCM_Main_sys_WindowControl_WindowControlOnButton_FLWindowCommand /end SUB_GROUP
/end GROUP
/begin GROUP WindowControlManager_WCM_Main_sys_WindowControl_WindowAuxiliaryControl_WashMode_Detect_Rise_Positive "WindowControlManager/WCM_Main_sys/WindowControl/WindowAuxiliaryControl/WashMode/Detect Rise\r\nPositive" /end GROUP
/begin GROUP WindowControlManager_WCM_Main_sys_WindowControl_WindowAuxiliaryControl_WashMode "WindowControlManager/WCM_Main_sys/WindowControl/WindowAuxiliaryControl/WashMode"
 /begin SUB_GROUP WindowControlManager_WCM_Main_sys_WindowControl_WindowAuxiliaryControl_WashMode_Detect_Rise_Positive /end SUB_GROUP
 /begin REF_MEASUREMENT S2S_WashModeSet /end REF_MEASUREMENT
/end GROUP
/begin GROUP WindowControlManager_WCM_Main_sys_WindowControl_WindowAuxiliaryControl_VoiceControl_Detect_Rise_Positive1 "WindowControlManager/WCM_Main_sys/WindowControl/WindowAuxiliaryControl/VoiceControl/Detect Rise\r\nPositive1" /end GROUP
/begin GROUP WindowControlManager_WCM_Main_sys_WindowControl_WindowAuxiliaryControl_VoiceControl_Detect_Rise_Positive "WindowControlManager/WCM_Main_sys/WindowControl/WindowAuxiliaryControl/VoiceControl/Detect Rise\r\nPositive" /end GROUP
/begin GROUP WindowControlManager_WCM_Main_sys_WindowControl_WindowAuxiliaryControl_VoiceControl "WindowControlManager/WCM_Main_sys/WindowControl/WindowAuxiliaryControl/VoiceControl"
 /begin SUB_GROUP WindowControlManager_WCM_Main_sys_WindowControl_WindowAuxiliaryControl_VoiceControl_Detect_Rise_Positive WindowControlManager_WCM_Main_sys_WindowControl_WindowAuxiliaryControl_VoiceControl_Detect_Rise_Positive1 /end SUB_GROUP
 /begin REF_MEASUREMENT S2S_WindowVoiceControlFL /end REF_MEASUREMENT
/end GROUP
/begin GROUP WindowControlManager_WCM_Main_sys_WindowControl_WindowAuxiliaryControl_Subsystem "WindowControlManager/WCM_Main_sys/WindowControl/WindowAuxiliaryControl/Subsystem" /end GROUP
/begin GROUP WindowControlManager_WCM_Main_sys_WindowControl_WindowAuxiliaryControl_PEButtonControl "WindowControlManager/WCM_Main_sys/WindowControl/WindowAuxiliaryControl/PEButtonControl" /end GROUP
/begin GROUP WindowControlManager_WCM_Main_sys_WindowControl_WindowAuxiliaryControl_FOBControl_Detect_Rise_Positive1 "WindowControlManager/WCM_Main_sys/WindowControl/WindowAuxiliaryControl/FOBControl/Detect Rise\r\nPositive1" /end GROUP
/begin GROUP WindowControlManager_WCM_Main_sys_WindowControl_WindowAuxiliaryControl_FOBControl_Detect_Rise_Positive "WindowControlManager/WCM_Main_sys/WindowControl/WindowAuxiliaryControl/FOBControl/Detect Rise\r\nPositive" /end GROUP
/begin GROUP WindowControlManager_WCM_Main_sys_WindowControl_WindowAuxiliaryControl_FOBControl "WindowControlManager/WCM_Main_sys/WindowControl/WindowAuxiliaryControl/FOBControl"
 /begin SUB_GROUP WindowControlManager_WCM_Main_sys_WindowControl_WindowAuxiliaryControl_FOBControl_Detect_Rise_Positive WindowControlManager_WCM_Main_sys_WindowControl_WindowAuxiliaryControl_FOBControl_Detect_Rise_Positive1 /end SUB_GROUP
/end GROUP
/begin GROUP WindowControlManager_WCM_Main_sys_WindowControl_WindowAuxiliaryControl_CAppControl_Detect_Rise_Positive1 "WindowControlManager/WCM_Main_sys/WindowControl/WindowAuxiliaryControl/CAppControl/Detect Rise\r\nPositive1" /end GROUP
/begin GROUP WindowControlManager_WCM_Main_sys_WindowControl_WindowAuxiliaryControl_CAppControl_Detect_Rise_Positive "WindowControlManager/WCM_Main_sys/WindowControl/WindowAuxiliaryControl/CAppControl/Detect Rise\r\nPositive" /end GROUP
/begin GROUP WindowControlManager_WCM_Main_sys_WindowControl_WindowAuxiliaryControl_CAppControl "WindowControlManager/WCM_Main_sys/WindowControl/WindowAuxiliaryControl/CAppControl"
 /begin SUB_GROUP WindowControlManager_WCM_Main_sys_WindowControl_WindowAuxiliaryControl_CAppControl_Detect_Rise_Positive WindowControlManager_WCM_Main_sys_WindowControl_WindowAuxiliaryControl_CAppControl_Detect_Rise_Positive1 /end SUB_GROUP
 /begin REF_MEASUREMENT S2S_WindowCAppControlFL /end REF_MEASUREMENT
/end GROUP
/begin GROUP WindowControlManager_WCM_Main_sys_WindowControl_WindowAuxiliaryControl "WindowControlManager/WCM_Main_sys/WindowControl/WindowAuxiliaryControl"
 /begin SUB_GROUP WindowControlManager_WCM_Main_sys_WindowControl_WindowAuxiliaryControl_CAppControl WindowControlManager_WCM_Main_sys_WindowControl_WindowAuxiliaryControl_FOBControl WindowControlManager_WCM_Main_sys_WindowControl_WindowAuxiliaryControl_PEButtonControl WindowControlManager_WCM_Main_sys_WindowControl_WindowAuxiliaryControl_Subsystem WindowControlManager_WCM_Main_sys_WindowControl_WindowAuxiliaryControl_VoiceControl WindowControlManager_WCM_Main_sys_WindowControl_WindowAuxiliaryControl_WashMode /end SUB_GROUP
 /begin REF_MEASUREMENT COM_WindowFLLearningSts COM_WindowFLSuppressionWarn /end REF_MEASUREMENT
/end GROUP
/begin GROUP WindowControlManager_WCM_Main_sys_WindowControl_WindLockControl "WindowControlManager/WCM_Main_sys/WindowControl/WindLockControl" /begin REF_MEASUREMENT COM_WindowLockDSBBtnPress /end REF_MEASUREMENT /end GROUP
/begin GROUP WindowControlManager_WCM_Main_sys_WindowControl_WIndowControlCommand_S_R_Flip_Flop "WindowControlManager/WCM_Main_sys/WindowControl/WIndowControlCommand/S-R\r\nFlip-Flop" /end GROUP
/begin GROUP WindowControlManager_WCM_Main_sys_WindowControl_WIndowControlCommand_Detect_Rise_Positive "WindowControlManager/WCM_Main_sys/WindowControl/WIndowControlCommand/Detect Rise\r\nPositive" /end GROUP
/begin GROUP WindowControlManager_WCM_Main_sys_WindowControl_WIndowControlCommand_Detect_Change "WindowControlManager/WCM_Main_sys/WindowControl/WIndowControlCommand/Detect\r\nChange" /end GROUP
/begin GROUP WindowControlManager_WCM_Main_sys_WindowControl_WIndowControlCommand "WindowControlManager/WCM_Main_sys/WindowControl/WIndowControlCommand"
 /begin SUB_GROUP WindowControlManager_WCM_Main_sys_WindowControl_WIndowControlCommand_Detect_Change WindowControlManager_WCM_Main_sys_WindowControl_WIndowControlCommand_Detect_Rise_Positive WindowControlManager_WCM_Main_sys_WindowControl_WIndowControlCommand_S_R_Flip_Flop /end SUB_GROUP
 /begin REF_MEASUREMENT COM_WindowPositionFL COM_WindowPositionFR COM_WindowPositionRL COM_WindowPositionRR /end REF_MEASUREMENT
/end GROUP
/begin GROUP WindowControlManager_WCM_Main_sys_WindowControl "WindowControlManager/WCM_Main_sys/WindowControl"
 /begin SUB_GROUP WindowControlManager_WCM_Main_sys_WindowControl_WIndowControlCommand WindowControlManager_WCM_Main_sys_WindowControl_WindLockControl WindowControlManager_WCM_Main_sys_WindowControl_WindowAuxiliaryControl WindowControlManager_WCM_Main_sys_WindowControl_WindowControlOnButton WindowControlManager_WCM_Main_sys_WindowControl_WindowCtrlEnableProcessing /end SUB_GROUP
/end GROUP
/begin GROUP WindowControlManager_WCM_Main_sys "WindowControlManager/WCM_Main_sys" /begin SUB_GROUP WindowControlManager_WCM_Main_sys_WindowControl /end SUB_GROUP /end GROUP
/begin GROUP WindowControlManager "WindowControlManager" ROOT /begin SUB_GROUP WindowControlManager_WCM_Main_sys /end SUB_GROUP
 /begin REF_MEASUREMENT COM_WindowBtnPressFR COM_WindowBtnPressRL COM_WindowBtnPressRR COM_WindowDSBBtnPressFL COM_WindowDSBBtnPressFR COM_WindowDSBBtnPressRL COM_WindowDSBBtnPressRR COM_WindowFLLearningSts COM_WindowFLLockActive COM_WindowFLSuppressionWarn COM_WindowFLThermalProtect COM_WindowFRLearningSts COM_WindowFRLockActive COM_WindowFRSuppressionWarn COM_WindowFRThermalProtect COM_WindowLockDSBBtnPress COM_WindowPositionFL COM_WindowPositionFR COM_WindowPositionRL COM_WindowPositionRR COM_WindowRLLearningSts COM_WindowRLLockActive COM_WindowRLSuppressionWarn COM_WindowRLThermalProtect COM_WindowRRLearningSts COM_WindowRRLockActive COM_WindowRRSuppressionWarn COM_WindowRRThermalProtect COM_WindowsFLAntiPinchWarn COM_WindowsFRAntiPinchWarn COM_WindowsRLAntiPinchWarn COM_WindowsRRAntiPinchWarn P_WCM_WindowControlRL P_WCM_WindowControlRR S2S_WashModeSet S2S_WindowCAppControlFL S2S_WindowCAppControlFR S2S_WindowCAppControlRL S2S_WindowCAppControlRR S2S_WindowVoiceControlFL S2S_WindowVoiceControlFR S2S_WindowVoiceControlRL S2S_WindowVoiceControlRR WCM_WindowControlFL WCM_WindowControlFR WCM_WindowsControlGlobal /end REF_MEASUREMENT
/end GROUP
/begin GROUP VehicleSpeedManager_VSM_Main_sys_VSM_MaximumSpeed_P1 "VehicleSpeedManager/VSM_Main_sys/VSM_MaximumSpeed_P1" /begin REF_CHARACTERISTIC VSM_MaximumSpeed_P /end REF_CHARACTERISTIC /end GROUP
/begin GROUP VehicleSpeedManager_VSM_Main_sys_VSM_MaximumSpeed_P "VehicleSpeedManager/VSM_Main_sys/VSM_MaximumSpeed_P" /begin REF_CHARACTERISTIC VSM_MaximumSpeed_P /end REF_CHARACTERISTIC /end GROUP
/begin GROUP VehicleSpeedManager_VSM_Main_sys_UnitSwitch "VehicleSpeedManager/VSM_Main_sys/UnitSwitch" /begin REF_MEASUREMENT MHU_STAT_MileageUnit /end REF_MEASUREMENT /end GROUP
/begin GROUP VehicleSpeedManager_VSM_Main_sys_SpeedCalculation_VSM_SpeedThreshold_P "VehicleSpeedManager/VSM_Main_sys/SpeedCalculation/VSM_SpeedThreshold_P" /begin REF_CHARACTERISTIC VSM_SpeedThreshold_P /end REF_CHARACTERISTIC /end GROUP
/begin GROUP VehicleSpeedManager_VSM_Main_sys_SpeedCalculation_VSM_LowerVehicleOffset_P "VehicleSpeedManager/VSM_Main_sys/SpeedCalculation/VSM_LowerVehicleOffset_P" /begin REF_CHARACTERISTIC VSM_LowerVehicleOffset_P /end REF_CHARACTERISTIC /end GROUP
/begin GROUP VehicleSpeedManager_VSM_Main_sys_SpeedCalculation_VSM_LowerSpeedPercentageFactor_P "VehicleSpeedManager/VSM_Main_sys/SpeedCalculation/VSM_LowerSpeedPercentageFactor_P" /begin REF_CHARACTERISTIC VSM_LowerSpeedPercentageFactor_P /end REF_CHARACTERISTIC /end GROUP
/begin GROUP VehicleSpeedManager_VSM_Main_sys_SpeedCalculation_VSM_HigherSpeedOffset_P "VehicleSpeedManager/VSM_Main_sys/SpeedCalculation/VSM_HigherSpeedOffset_P" /begin REF_CHARACTERISTIC VSM_HigherSpeedOffset_P /end REF_CHARACTERISTIC /end GROUP
/begin GROUP VehicleSpeedManager_VSM_Main_sys_SpeedCalculation_VSM_GeneralSpeedPercentageFactor_P "VehicleSpeedManager/VSM_Main_sys/SpeedCalculation/VSM_GeneralSpeedPercentageFactor_P" /begin REF_CHARACTERISTIC VSM_GeneralSpeedPercentageFactor_P /end REF_CHARACTERISTIC /end GROUP
/begin GROUP VehicleSpeedManager_VSM_Main_sys_SpeedCalculation "VehicleSpeedManager/VSM_Main_sys/SpeedCalculation"
 /begin SUB_GROUP VehicleSpeedManager_VSM_Main_sys_SpeedCalculation_VSM_GeneralSpeedPercentageFactor_P VehicleSpeedManager_VSM_Main_sys_SpeedCalculation_VSM_HigherSpeedOffset_P VehicleSpeedManager_VSM_Main_sys_SpeedCalculation_VSM_LowerSpeedPercentageFactor_P VehicleSpeedManager_VSM_Main_sys_SpeedCalculation_VSM_LowerVehicleOffset_P VehicleSpeedManager_VSM_Main_sys_SpeedCalculation_VSM_SpeedThreshold_P /end SUB_GROUP
/end GROUP
/begin GROUP VehicleSpeedManager_VSM_Main_sys_InvalidDetecttion_VSM_InvalidDigitSpeed_P "VehicleSpeedManager/VSM_Main_sys/InvalidDetecttion/VSM_InvalidDigitSpeed_P" /begin REF_CHARACTERISTIC VSM_InvalidDigitSpeed_P /end REF_CHARACTERISTIC /end GROUP
/begin GROUP VehicleSpeedManager_VSM_Main_sys_InvalidDetecttion_VSM_DigitSpeed_O "VehicleSpeedManager/VSM_Main_sys/InvalidDetecttion/VSM_DigitSpeed_O" /begin REF_CHARACTERISTIC VSM_DigitSpeed_O /end REF_CHARACTERISTIC /end GROUP
/begin GROUP VehicleSpeedManager_VSM_Main_sys_InvalidDetecttion_VSM_DigitSpeed_E "VehicleSpeedManager/VSM_Main_sys/InvalidDetecttion/VSM_DigitSpeed_E" /begin REF_CHARACTERISTIC VSM_DigitSpeed_E /end REF_CHARACTERISTIC /end GROUP
/begin GROUP VehicleSpeedManager_VSM_Main_sys_InvalidDetecttion "VehicleSpeedManager/VSM_Main_sys/InvalidDetecttion"
 /begin SUB_GROUP VehicleSpeedManager_VSM_Main_sys_InvalidDetecttion_VSM_DigitSpeed_E VehicleSpeedManager_VSM_Main_sys_InvalidDetecttion_VSM_DigitSpeed_O VehicleSpeedManager_VSM_Main_sys_InvalidDetecttion_VSM_InvalidDigitSpeed_P /end SUB_GROUP
 /begin REF_MEASUREMENT BCMFL_Clamp15FL BCMFR_Clamp15FR BCMRE_Clamp15RE BSW_VehicleSpdE2ESts /end REF_MEASUREMENT
/end GROUP
/begin GROUP VehicleSpeedManager_VSM_Main_sys_DampingAlgorithm_VMS_Ts_P "VehicleSpeedManager/VSM_Main_sys/DampingAlgorithm/VMS_Ts_P" /begin REF_CHARACTERISTIC VMS_Ts_P /end REF_CHARACTERISTIC /end GROUP
/begin GROUP VehicleSpeedManager_VSM_Main_sys_DampingAlgorithm_VMS_TimeConstantForFilter_P "VehicleSpeedManager/VSM_Main_sys/DampingAlgorithm/VMS_TimeConstantForFilter_P" /begin REF_CHARACTERISTIC VMS_TimeConstantForFilter_P /end REF_CHARACTERISTIC /end GROUP
/begin GROUP VehicleSpeedManager_VSM_Main_sys_DampingAlgorithm "VehicleSpeedManager/VSM_Main_sys/DampingAlgorithm"
 /begin SUB_GROUP VehicleSpeedManager_VSM_Main_sys_DampingAlgorithm_VMS_TimeConstantForFilter_P VehicleSpeedManager_VSM_Main_sys_DampingAlgorithm_VMS_Ts_P /end SUB_GROUP
/end GROUP
/begin GROUP VehicleSpeedManager_VSM_Main_sys "VehicleSpeedManager/VSM_Main_sys"
 /begin SUB_GROUP VehicleSpeedManager_VSM_Main_sys_DampingAlgorithm VehicleSpeedManager_VSM_Main_sys_InvalidDetecttion VehicleSpeedManager_VSM_Main_sys_SpeedCalculation VehicleSpeedManager_VSM_Main_sys_UnitSwitch VehicleSpeedManager_VSM_Main_sys_VSM_MaximumSpeed_P VehicleSpeedManager_VSM_Main_sys_VSM_MaximumSpeed_P1 /end SUB_GROUP
/end GROUP
/begin GROUP VehicleSpeedManager "VehicleSpeedManager" ROOT /begin SUB_GROUP VehicleSpeedManager_VSM_Main_sys /end SUB_GROUP
 /begin REF_MEASUREMENT BCMFL_Clamp15FL BCMFR_Clamp15FR BCMRE_Clamp15RE BSW_VehicleSpdE2ESts MHU_STAT_MileageUnit VSM_DigitSpeed /end REF_MEASUREMENT
/end GROUP
/begin GROUP TerminalClampManager_TCM_10ms_sys_TimerUnitConvertion_TCM_Ts_P1 "TerminalClampManager/TCM_10ms_sys/TimerUnitConvertion/TCM_Ts_P1" /begin REF_CHARACTERISTIC TCM_Ts_P /end REF_CHARACTERISTIC /end GROUP
/begin GROUP TerminalClampManager_TCM_10ms_sys_TimerUnitConvertion_TCM_Ts_P "TerminalClampManager/TCM_10ms_sys/TimerUnitConvertion/TCM_Ts_P" /begin REF_CHARACTERISTIC TCM_Ts_P /end REF_CHARACTERISTIC /end GROUP
/begin GROUP TerminalClampManager_TCM_10ms_sys_TimerUnitConvertion_TCM_ON_LOWSOC_SAVEMODE_TIME_P "TerminalClampManager/TCM_10ms_sys/TimerUnitConvertion/TCM_ON_LOWSOC_SAVEMODE_TIME_P" /begin REF_CHARACTERISTIC TCM_ON_LOWSOC_SAVEMODE_TIME_P /end REF_CHARACTERISTIC /end GROUP
/begin GROUP TerminalClampManager_TCM_10ms_sys_TimerUnitConvertion_TCM_ON_IDLE_TIME_P "TerminalClampManager/TCM_10ms_sys/TimerUnitConvertion/TCM_ON_IDLE_TIME_P" /begin REF_CHARACTERISTIC TCM_ON_IDLE_TIME_P /end REF_CHARACTERISTIC /end GROUP
/begin GROUP TerminalClampManager_TCM_10ms_sys_TimerUnitConvertion_TCM_ACC_LOWSOC_SAVEMODE_TIME_P "TerminalClampManager/TCM_10ms_sys/TimerUnitConvertion/TCM_ACC_LOWSOC_SAVEMODE_TIME_P" /begin REF_CHARACTERISTIC TCM_ACC_LOWSOC_SAVEMODE_TIME_P /end REF_CHARACTERISTIC /end GROUP
/begin GROUP TerminalClampManager_TCM_10ms_sys_TimerUnitConvertion_TCM_ACC_IDLE_TIME_P "TerminalClampManager/TCM_10ms_sys/TimerUnitConvertion/TCM_ACC_IDLE_TIME_P" /begin REF_CHARACTERISTIC TCM_ACC_IDLE_TIME_P /end REF_CHARACTERISTIC /end GROUP
/begin GROUP TerminalClampManager_TCM_10ms_sys_TimerUnitConvertion "TerminalClampManager/TCM_10ms_sys/TimerUnitConvertion"
 /begin SUB_GROUP TerminalClampManager_TCM_10ms_sys_TimerUnitConvertion_TCM_ACC_IDLE_TIME_P TerminalClampManager_TCM_10ms_sys_TimerUnitConvertion_TCM_ACC_LOWSOC_SAVEMODE_TIME_P TerminalClampManager_TCM_10ms_sys_TimerUnitConvertion_TCM_ON_IDLE_TIME_P TerminalClampManager_TCM_10ms_sys_TimerUnitConvertion_TCM_ON_LOWSOC_SAVEMODE_TIME_P TerminalClampManager_TCM_10ms_sys_TimerUnitConvertion_TCM_Ts_P TerminalClampManager_TCM_10ms_sys_TimerUnitConvertion_TCM_Ts_P1 /end SUB_GROUP
/end GROUP
/begin GROUP TerminalClampManager_TCM_10ms_sys_TimerOutput_TCM_Ts_P3 "TerminalClampManager/TCM_10ms_sys/TimerOutput/TCM_Ts_P3" /begin REF_CHARACTERISTIC TCM_Ts_P /end REF_CHARACTERISTIC /end GROUP
/begin GROUP TerminalClampManager_TCM_10ms_sys_TimerOutput_TCM_Ts_P2 "TerminalClampManager/TCM_10ms_sys/TimerOutput/TCM_Ts_P2" /begin REF_CHARACTERISTIC TCM_Ts_P /end REF_CHARACTERISTIC /end GROUP
/begin GROUP TerminalClampManager_TCM_10ms_sys_TimerOutput_TCM_Ts_P1 "TerminalClampManager/TCM_10ms_sys/TimerOutput/TCM_Ts_P1" /begin REF_CHARACTERISTIC TCM_Ts_P /end REF_CHARACTERISTIC /end GROUP
/begin GROUP TerminalClampManager_TCM_10ms_sys_TimerOutput_TCM_Ts_P "TerminalClampManager/TCM_10ms_sys/TimerOutput/TCM_Ts_P" /begin REF_CHARACTERISTIC TCM_Ts_P /end REF_CHARACTERISTIC /end GROUP
/begin GROUP TerminalClampManager_TCM_10ms_sys_TimerOutput "TerminalClampManager/TCM_10ms_sys/TimerOutput"
 /begin SUB_GROUP TerminalClampManager_TCM_10ms_sys_TimerOutput_TCM_Ts_P TerminalClampManager_TCM_10ms_sys_TimerOutput_TCM_Ts_P1 TerminalClampManager_TCM_10ms_sys_TimerOutput_TCM_Ts_P2 TerminalClampManager_TCM_10ms_sys_TimerOutput_TCM_Ts_P3 /end SUB_GROUP
/end GROUP
/begin GROUP TerminalClampManager_TCM_10ms_sys_OperationStateRecovery_StatusRequstCompatible "TerminalClampManager/TCM_10ms_sys/OperationStateRecovery/StatusRequstCompatible"
 /begin REF_MEASUREMENT BCMFL_Clamp15FL BCMFL_Clamp30cFL BCMFL_Clamp30sFL BCMFL_ClampRFL BCMFR_Clamp15FR BCMFR_Clamp30cFR BCMFR_Clamp30sFR BCMFR_ClampRFR BCMRE_Clamp15RE BCMRE_Clamp30cRE BCMRE_Clamp30sRE BCMRE_ClampRRE /end REF_MEASUREMENT
/end GROUP
/begin GROUP TerminalClampManager_TCM_10ms_sys_OperationStateRecovery_StateRecoveryFromOff2Other "TerminalClampManager/TCM_10ms_sys/OperationStateRecovery/StateRecoveryFromOff2Other"
 /begin REF_MEASUREMENT BCMFL_Clamp15FL BCMFL_Clamp30cFL BCMFL_Clamp30sFL BCMFL_ClampRFL BCMFR_Clamp15FR BCMFR_Clamp30cFR BCMFR_Clamp30sFR BCMFR_ClampRFR BCMRE_Clamp15RE BCMRE_Clamp30cRE BCMRE_Clamp30sRE BCMRE_ClampRRE CVC_OtaRequest /end REF_MEASUREMENT
/end GROUP
/begin GROUP TerminalClampManager_TCM_10ms_sys_OperationStateRecovery_StateRecoveryFromOff2Acc "TerminalClampManager/TCM_10ms_sys/OperationStateRecovery/StateRecoveryFromOff2Acc"
 /begin REF_MEASUREMENT BCMFL_Clamp15FL BCMFL_Clamp30cFL BCMFL_Clamp30sFL BCMFL_ClampRFL BCMFR_Clamp15FR BCMFR_Clamp30cFR BCMFR_Clamp30sFR BCMFR_ClampRFR BCMRE_Clamp15RE BCMRE_Clamp30cRE BCMRE_Clamp30sRE BCMRE_ClampRRE /end REF_MEASUREMENT
/end GROUP
/begin GROUP TerminalClampManager_TCM_10ms_sys_OperationStateRecovery "TerminalClampManager/TCM_10ms_sys/OperationStateRecovery"
 /begin SUB_GROUP TerminalClampManager_TCM_10ms_sys_OperationStateRecovery_StateRecoveryFromOff2Acc TerminalClampManager_TCM_10ms_sys_OperationStateRecovery_StateRecoveryFromOff2Other TerminalClampManager_TCM_10ms_sys_OperationStateRecovery_StatusRequstCompatible /end SUB_GROUP
/end GROUP
/begin GROUP TerminalClampManager_TCM_10ms_sys_OperationPostprocess "TerminalClampManager/TCM_10ms_sys/OperationPostprocess" /end GROUP
/begin GROUP TerminalClampManager_TCM_10ms_sys_InternalWakeupLogic_Detect_Increase1 "TerminalClampManager/TCM_10ms_sys/InternalWakeupLogic/Detect\r\nIncrease1" /end GROUP
/begin GROUP TerminalClampManager_TCM_10ms_sys_InternalWakeupLogic_Detect_Increase "TerminalClampManager/TCM_10ms_sys/InternalWakeupLogic/Detect\r\nIncrease" /end GROUP
/begin GROUP TerminalClampManager_TCM_10ms_sys_InternalWakeupLogic "TerminalClampManager/TCM_10ms_sys/InternalWakeupLogic"
 /begin SUB_GROUP TerminalClampManager_TCM_10ms_sys_InternalWakeupLogic_Detect_Increase TerminalClampManager_TCM_10ms_sys_InternalWakeupLogic_Detect_Increase1 /end SUB_GROUP
/end GROUP
/begin GROUP TerminalClampManager_TCM_10ms_sys_IncompatibleWarning_TCM_STANDSTILL_VELOCITY_THRESHOLD_P "TerminalClampManager/TCM_10ms_sys/IncompatibleWarning/TCM_STANDSTILL_VELOCITY_THRESHOLD_P" /begin REF_CHARACTERISTIC TCM_STANDSTILL_VELOCITY_THRESHOLD_P /end REF_CHARACTERISTIC /end GROUP
/begin GROUP TerminalClampManager_TCM_10ms_sys_IncompatibleWarning "TerminalClampManager/TCM_10ms_sys/IncompatibleWarning"
 /begin SUB_GROUP TerminalClampManager_TCM_10ms_sys_IncompatibleWarning_TCM_STANDSTILL_VELOCITY_THRESHOLD_P /end SUB_GROUP
/end GROUP
/begin GROUP TerminalClampManager_TCM_10ms_sys_FullScreenChargeDisplayTimer_Timer "TerminalClampManager/TCM_10ms_sys/FullScreenChargeDisplayTimer/Timer" /end GROUP
/begin GROUP TerminalClampManager_TCM_10ms_sys_FullScreenChargeDisplayTimer_TCM_Ts_P3 "TerminalClampManager/TCM_10ms_sys/FullScreenChargeDisplayTimer/TCM_Ts_P3" /begin REF_CHARACTERISTIC TCM_Ts_P /end REF_CHARACTERISTIC /end GROUP
/begin GROUP TerminalClampManager_TCM_10ms_sys_FullScreenChargeDisplayTimer_TCM_CHARGING_DISPLAY_TIME_P "TerminalClampManager/TCM_10ms_sys/FullScreenChargeDisplayTimer/TCM_CHARGING_DISPLAY_TIME_P" /begin REF_CHARACTERISTIC TCM_CHARGING_DISPLAY_TIME_P /end REF_CHARACTERISTIC /end GROUP
/begin GROUP TerminalClampManager_TCM_10ms_sys_FullScreenChargeDisplayTimer "TerminalClampManager/TCM_10ms_sys/FullScreenChargeDisplayTimer"
 /begin SUB_GROUP TerminalClampManager_TCM_10ms_sys_FullScreenChargeDisplayTimer_TCM_CHARGING_DISPLAY_TIME_P TerminalClampManager_TCM_10ms_sys_FullScreenChargeDisplayTimer_TCM_Ts_P3 TerminalClampManager_TCM_10ms_sys_FullScreenChargeDisplayTimer_Timer /end SUB_GROUP
 /begin REF_MEASUREMENT VCU_VehChgSts /end REF_MEASUREMENT
/end GROUP
/begin GROUP TerminalClampManager_TCM_10ms_sys_ClampReqDetmn "TerminalClampManager/TCM_10ms_sys/ClampReqDetmn" /begin REF_MEASUREMENT BMS_HVOnOffSts /end REF_MEASUREMENT /end GROUP
/begin GROUP TerminalClampManager_TCM_10ms_sys_AllTransistionDetmn_Transition2OtaConditionDetmn_TCM_STANDSTILL_VELOCITY_THRESHOLD_P "TerminalClampManager/TCM_10ms_sys/AllTransistionDetmn/Transition2OtaConditionDetmn/TCM_STANDSTILL_VELOCITY_THRESHOLD_P" /begin REF_CHARACTERISTIC TCM_STANDSTILL_VELOCITY_THRESHOLD_P /end REF_CHARACTERISTIC /end GROUP
/begin GROUP TerminalClampManager_TCM_10ms_sys_AllTransistionDetmn_Transition2OtaConditionDetmn "TerminalClampManager/TCM_10ms_sys/AllTransistionDetmn/Transition2OtaConditionDetmn"
 /begin SUB_GROUP TerminalClampManager_TCM_10ms_sys_AllTransistionDetmn_Transition2OtaConditionDetmn_TCM_STANDSTILL_VELOCITY_THRESHOLD_P /end SUB_GROUP
 /begin REF_MEASUREMENT CVC_OtaRequest /end REF_MEASUREMENT
/end GROUP
/begin GROUP TerminalClampManager_TCM_10ms_sys_AllTransistionDetmn_Transition2OnAndMotorOnConditionDetmn_On2MotorRunningCondition_TCM_ImmobilizerConfigurationFlag_P "TerminalClampManager/TCM_10ms_sys/AllTransistionDetmn/Transition2OnAndMotorOnConditionDetmn/On2MotorRunningCondition/TCM_ImmobilizerConfigurationFlag_P" /begin REF_CHARACTERISTIC TCM_ImmobilizerConfigurationFlag_P /end REF_CHARACTERISTIC /end GROUP
/begin GROUP TerminalClampManager_TCM_10ms_sys_AllTransistionDetmn_Transition2OnAndMotorOnConditionDetmn_On2MotorRunningCondition "TerminalClampManager/TCM_10ms_sys/AllTransistionDetmn/Transition2OnAndMotorOnConditionDetmn/On2MotorRunningCondition"
 /begin SUB_GROUP TerminalClampManager_TCM_10ms_sys_AllTransistionDetmn_Transition2OnAndMotorOnConditionDetmn_On2MotorRunningCondition_TCM_ImmobilizerConfigurationFlag_P /end SUB_GROUP
 /begin REF_MEASUREMENT FCAM_RemoteDrivingRequest IMMO_IMMOSts /end REF_MEASUREMENT
/end GROUP
/begin GROUP TerminalClampManager_TCM_10ms_sys_AllTransistionDetmn_Transition2OnAndMotorOnConditionDetmn_Off2OnCondition_TCM_AlcoholInterLockConfigurationFlag_P "TerminalClampManager/TCM_10ms_sys/AllTransistionDetmn/Transition2OnAndMotorOnConditionDetmn/Off2OnCondition/TCM_AlcoholInterLockConfigurationFlag_P" /begin REF_CHARACTERISTIC TCM_AlcoholInterLockConfigurationFlag_P /end REF_CHARACTERISTIC /end GROUP
/begin GROUP TerminalClampManager_TCM_10ms_sys_AllTransistionDetmn_Transition2OnAndMotorOnConditionDetmn_Off2OnCondition "TerminalClampManager/TCM_10ms_sys/AllTransistionDetmn/Transition2OnAndMotorOnConditionDetmn/Off2OnCondition"
 /begin SUB_GROUP TerminalClampManager_TCM_10ms_sys_AllTransistionDetmn_Transition2OnAndMotorOnConditionDetmn_Off2OnCondition_TCM_AlcoholInterLockConfigurationFlag_P /end SUB_GROUP
 /begin REF_MEASUREMENT BCMRE_AlcoholockSwitch CVC_RemoteParkingRequest /end REF_MEASUREMENT
/end GROUP
/begin GROUP TerminalClampManager_TCM_10ms_sys_AllTransistionDetmn_Transition2OnAndMotorOnConditionDetmn_MotorRunning2OnCondition_TCM_STANDSTILL_VELOCITY_THRESHOLD_P "TerminalClampManager/TCM_10ms_sys/AllTransistionDetmn/Transition2OnAndMotorOnConditionDetmn/MotorRunning2OnCondition/TCM_STANDSTILL_VELOCITY_THRESHOLD_P" /begin REF_CHARACTERISTIC TCM_STANDSTILL_VELOCITY_THRESHOLD_P /end REF_CHARACTERISTIC /end GROUP
/begin GROUP TerminalClampManager_TCM_10ms_sys_AllTransistionDetmn_Transition2OnAndMotorOnConditionDetmn_MotorRunning2OnCondition "TerminalClampManager/TCM_10ms_sys/AllTransistionDetmn/Transition2OnAndMotorOnConditionDetmn/MotorRunning2OnCondition"
 /begin SUB_GROUP TerminalClampManager_TCM_10ms_sys_AllTransistionDetmn_Transition2OnAndMotorOnConditionDetmn_MotorRunning2OnCondition_TCM_STANDSTILL_VELOCITY_THRESHOLD_P /end SUB_GROUP
 /begin REF_MEASUREMENT FCAM_RemoteDrivingRequest /end REF_MEASUREMENT
/end GROUP
/begin GROUP TerminalClampManager_TCM_10ms_sys_AllTransistionDetmn_Transition2OnAndMotorOnConditionDetmn "TerminalClampManager/TCM_10ms_sys/AllTransistionDetmn/Transition2OnAndMotorOnConditionDetmn"
 /begin SUB_GROUP TerminalClampManager_TCM_10ms_sys_AllTransistionDetmn_Transition2OnAndMotorOnConditionDetmn_MotorRunning2OnCondition TerminalClampManager_TCM_10ms_sys_AllTransistionDetmn_Transition2OnAndMotorOnConditionDetmn_Off2OnCondition TerminalClampManager_TCM_10ms_sys_AllTransistionDetmn_Transition2OnAndMotorOnConditionDetmn_On2MotorRunningCondition /end SUB_GROUP
/end GROUP
/begin GROUP TerminalClampManager_TCM_10ms_sys_AllTransistionDetmn_Transition2OffConditionDetmn_Ota2OffCondition "TerminalClampManager/TCM_10ms_sys/AllTransistionDetmn/Transition2OffConditionDetmn/Ota2OffCondition" /begin REF_MEASUREMENT CVC_OtaRequest /end REF_MEASUREMENT /end GROUP
/begin GROUP TerminalClampManager_TCM_10ms_sys_AllTransistionDetmn_Transition2OffConditionDetmn_On2OffCondition_TCM_STANDSTILL_VELOCITY_THRESHOLD_P1 "TerminalClampManager/TCM_10ms_sys/AllTransistionDetmn/Transition2OffConditionDetmn/On2OffCondition/TCM_STANDSTILL_VELOCITY_THRESHOLD_P1" /begin REF_CHARACTERISTIC TCM_STANDSTILL_VELOCITY_THRESHOLD_P /end REF_CHARACTERISTIC /end GROUP
/begin GROUP TerminalClampManager_TCM_10ms_sys_AllTransistionDetmn_Transition2OffConditionDetmn_On2OffCondition_TCM_STANDSTILL_VELOCITY_THRESHOLD_P "TerminalClampManager/TCM_10ms_sys/AllTransistionDetmn/Transition2OffConditionDetmn/On2OffCondition/TCM_STANDSTILL_VELOCITY_THRESHOLD_P" /begin REF_CHARACTERISTIC TCM_STANDSTILL_VELOCITY_THRESHOLD_P /end REF_CHARACTERISTIC /end GROUP
/begin GROUP TerminalClampManager_TCM_10ms_sys_AllTransistionDetmn_Transition2OffConditionDetmn_On2OffCondition_TCM_MINIMUM_HV_SOC_THRESHOLD_P "TerminalClampManager/TCM_10ms_sys/AllTransistionDetmn/Transition2OffConditionDetmn/On2OffCondition/TCM_MINIMUM_HV_SOC_THRESHOLD_P" /begin REF_CHARACTERISTIC TCM_MINIMUM_HV_SOC_THRESHOLD_P /end REF_CHARACTERISTIC /end GROUP
/begin GROUP TerminalClampManager_TCM_10ms_sys_AllTransistionDetmn_Transition2OffConditionDetmn_On2OffCondition_Detect_Change1 "TerminalClampManager/TCM_10ms_sys/AllTransistionDetmn/Transition2OffConditionDetmn/On2OffCondition/Detect_Change1" /begin REF_MEASUREMENT CVC_TransportModeSts /end REF_MEASUREMENT /end GROUP
/begin GROUP TerminalClampManager_TCM_10ms_sys_AllTransistionDetmn_Transition2OffConditionDetmn_On2OffCondition "TerminalClampManager/TCM_10ms_sys/AllTransistionDetmn/Transition2OffConditionDetmn/On2OffCondition"
 /begin SUB_GROUP TerminalClampManager_TCM_10ms_sys_AllTransistionDetmn_Transition2OffConditionDetmn_On2OffCondition_Detect_Change1 TerminalClampManager_TCM_10ms_sys_AllTransistionDetmn_Transition2OffConditionDetmn_On2OffCondition_TCM_MINIMUM_HV_SOC_THRESHOLD_P TerminalClampManager_TCM_10ms_sys_AllTransistionDetmn_Transition2OffConditionDetmn_On2OffCondition_TCM_STANDSTILL_VELOCITY_THRESHOLD_P TerminalClampManager_TCM_10ms_sys_AllTransistionDetmn_Transition2OffConditionDetmn_On2OffCondition_TCM_STANDSTILL_VELOCITY_THRESHOLD_P1 /end SUB_GROUP
 /begin REF_MEASUREMENT ATA_AntiTheftStatus CVC_SocDisplay CVC_TransportModeSts /end REF_MEASUREMENT
/end GROUP
/begin GROUP TerminalClampManager_TCM_10ms_sys_AllTransistionDetmn_Transition2OffConditionDetmn_Acc2OffCondition_TCM_CpdConfigurationFlag_P "TerminalClampManager/TCM_10ms_sys/AllTransistionDetmn/Transition2OffConditionDetmn/Acc2OffCondition/TCM_CpdConfigurationFlag_P" /begin REF_CHARACTERISTIC TCM_CpdConfigurationFlag_P /end REF_CHARACTERISTIC /end GROUP
/begin GROUP TerminalClampManager_TCM_10ms_sys_AllTransistionDetmn_Transition2OffConditionDetmn_Acc2OffCondition "TerminalClampManager/TCM_10ms_sys/AllTransistionDetmn/Transition2OffConditionDetmn/Acc2OffCondition"
 /begin SUB_GROUP TerminalClampManager_TCM_10ms_sys_AllTransistionDetmn_Transition2OffConditionDetmn_Acc2OffCondition_TCM_CpdConfigurationFlag_P /end SUB_GROUP
 /begin REF_MEASUREMENT ATA_AntiTheftStatus CVC_AccessoryModeRequest /end REF_MEASUREMENT
/end GROUP
/begin GROUP TerminalClampManager_TCM_10ms_sys_AllTransistionDetmn_Transition2OffConditionDetmn "TerminalClampManager/TCM_10ms_sys/AllTransistionDetmn/Transition2OffConditionDetmn"
 /begin SUB_GROUP TerminalClampManager_TCM_10ms_sys_AllTransistionDetmn_Transition2OffConditionDetmn_Acc2OffCondition TerminalClampManager_TCM_10ms_sys_AllTransistionDetmn_Transition2OffConditionDetmn_On2OffCondition TerminalClampManager_TCM_10ms_sys_AllTransistionDetmn_Transition2OffConditionDetmn_Ota2OffCondition /end SUB_GROUP
/end GROUP
/begin GROUP TerminalClampManager_TCM_10ms_sys_AllTransistionDetmn_Transition2AccConditionDetmn_On2AccCondition_TCM_STANDSTILL_VELOCITY_THRESHOLD_P "TerminalClampManager/TCM_10ms_sys/AllTransistionDetmn/Transition2AccConditionDetmn/On2AccCondition/TCM_STANDSTILL_VELOCITY_THRESHOLD_P" /begin REF_CHARACTERISTIC TCM_STANDSTILL_VELOCITY_THRESHOLD_P /end REF_CHARACTERISTIC /end GROUP
/begin GROUP TerminalClampManager_TCM_10ms_sys_AllTransistionDetmn_Transition2AccConditionDetmn_On2AccCondition "TerminalClampManager/TCM_10ms_sys/AllTransistionDetmn/Transition2AccConditionDetmn/On2AccCondition"
 /begin SUB_GROUP TerminalClampManager_TCM_10ms_sys_AllTransistionDetmn_Transition2AccConditionDetmn_On2AccCondition_TCM_STANDSTILL_VELOCITY_THRESHOLD_P /end SUB_GROUP
 /begin REF_MEASUREMENT CVC_AccessoryModeRequest /end REF_MEASUREMENT
/end GROUP
/begin GROUP TerminalClampManager_TCM_10ms_sys_AllTransistionDetmn_Transition2AccConditionDetmn_Off2AccCondition_TCM_CpdConfigurationFlag_P "TerminalClampManager/TCM_10ms_sys/AllTransistionDetmn/Transition2AccConditionDetmn/Off2AccCondition/TCM_CpdConfigurationFlag_P" /begin REF_CHARACTERISTIC TCM_CpdConfigurationFlag_P /end REF_CHARACTERISTIC /end GROUP
/begin GROUP TerminalClampManager_TCM_10ms_sys_AllTransistionDetmn_Transition2AccConditionDetmn_Off2AccCondition "TerminalClampManager/TCM_10ms_sys/AllTransistionDetmn/Transition2AccConditionDetmn/Off2AccCondition"
 /begin SUB_GROUP TerminalClampManager_TCM_10ms_sys_AllTransistionDetmn_Transition2AccConditionDetmn_Off2AccCondition_TCM_CpdConfigurationFlag_P /end SUB_GROUP
 /begin REF_MEASUREMENT ATA_AntiTheftStatus BCMRE_FootKickOperationRequest BCMRE_TailgatePassiveEntryReq CVC_AccessoryModeRequest /end REF_MEASUREMENT
/end GROUP
/begin GROUP TerminalClampManager_TCM_10ms_sys_AllTransistionDetmn_Transition2AccConditionDetmn "TerminalClampManager/TCM_10ms_sys/AllTransistionDetmn/Transition2AccConditionDetmn"
 /begin SUB_GROUP TerminalClampManager_TCM_10ms_sys_AllTransistionDetmn_Transition2AccConditionDetmn_Off2AccCondition TerminalClampManager_TCM_10ms_sys_AllTransistionDetmn_Transition2AccConditionDetmn_On2AccCondition /end SUB_GROUP
/end GROUP
/begin GROUP TerminalClampManager_TCM_10ms_sys_AllTransistionDetmn_SeatOccupancyDetection_TCM_OccupancySeatbeltMonitorCfgFlag_P3 "TerminalClampManager/TCM_10ms_sys/AllTransistionDetmn/SeatOccupancyDetection/TCM_OccupancySeatbeltMonitorCfgFlag_P3" /begin REF_CHARACTERISTIC TCM_OccupancySeatbeltMonitorCfgFlag_P /end REF_CHARACTERISTIC /end GROUP
/begin GROUP TerminalClampManager_TCM_10ms_sys_AllTransistionDetmn_SeatOccupancyDetection_TCM_OccupancySeatbeltMonitorCfgFlag_P2 "TerminalClampManager/TCM_10ms_sys/AllTransistionDetmn/SeatOccupancyDetection/TCM_OccupancySeatbeltMonitorCfgFlag_P2" /begin REF_CHARACTERISTIC TCM_OccupancySeatbeltMonitorCfgFlag_P /end REF_CHARACTERISTIC /end GROUP
/begin GROUP TerminalClampManager_TCM_10ms_sys_AllTransistionDetmn_SeatOccupancyDetection_TCM_OccupancySeatbeltMonitorCfgFlag_P1 "TerminalClampManager/TCM_10ms_sys/AllTransistionDetmn/SeatOccupancyDetection/TCM_OccupancySeatbeltMonitorCfgFlag_P1" /begin REF_CHARACTERISTIC TCM_OccupancySeatbeltMonitorCfgFlag_P /end REF_CHARACTERISTIC /end GROUP
/begin GROUP TerminalClampManager_TCM_10ms_sys_AllTransistionDetmn_SeatOccupancyDetection_TCM_OccupancySeatbeltMonitorCfgFlag_P "TerminalClampManager/TCM_10ms_sys/AllTransistionDetmn/SeatOccupancyDetection/TCM_OccupancySeatbeltMonitorCfgFlag_P" /begin REF_CHARACTERISTIC TCM_OccupancySeatbeltMonitorCfgFlag_P /end REF_CHARACTERISTIC /end GROUP
/begin GROUP TerminalClampManager_TCM_10ms_sys_AllTransistionDetmn_SeatOccupancyDetection "TerminalClampManager/TCM_10ms_sys/AllTransistionDetmn/SeatOccupancyDetection"
 /begin SUB_GROUP TerminalClampManager_TCM_10ms_sys_AllTransistionDetmn_SeatOccupancyDetection_TCM_OccupancySeatbeltMonitorCfgFlag_P TerminalClampManager_TCM_10ms_sys_AllTransistionDetmn_SeatOccupancyDetection_TCM_OccupancySeatbeltMonitorCfgFlag_P1 TerminalClampManager_TCM_10ms_sys_AllTransistionDetmn_SeatOccupancyDetection_TCM_OccupancySeatbeltMonitorCfgFlag_P2 TerminalClampManager_TCM_10ms_sys_AllTransistionDetmn_SeatOccupancyDetection_TCM_OccupancySeatbeltMonitorCfgFlag_P3 /end SUB_GROUP
 /begin REF_MEASUREMENT ACM_SeatOccupancy2ndRowDri ACM_SeatOccupancy2ndRowMid ACM_SeatOccupancy2ndRowPas ACM_SeatOccupancyPassenger /end REF_MEASUREMENT
/end GROUP
/begin GROUP TerminalClampManager_TCM_10ms_sys_AllTransistionDetmn "TerminalClampManager/TCM_10ms_sys/AllTransistionDetmn"
 /begin SUB_GROUP TerminalClampManager_TCM_10ms_sys_AllTransistionDetmn_SeatOccupancyDetection TerminalClampManager_TCM_10ms_sys_AllTransistionDetmn_Transition2AccConditionDetmn TerminalClampManager_TCM_10ms_sys_AllTransistionDetmn_Transition2OffConditionDetmn TerminalClampManager_TCM_10ms_sys_AllTransistionDetmn_Transition2OnAndMotorOnConditionDetmn TerminalClampManager_TCM_10ms_sys_AllTransistionDetmn_Transition2OtaConditionDetmn /end SUB_GROUP
/end GROUP
/begin GROUP TerminalClampManager_TCM_10ms_sys "TerminalClampManager/TCM_10ms_sys"
 /begin SUB_GROUP TerminalClampManager_TCM_10ms_sys_AllTransistionDetmn TerminalClampManager_TCM_10ms_sys_ClampReqDetmn TerminalClampManager_TCM_10ms_sys_FullScreenChargeDisplayTimer TerminalClampManager_TCM_10ms_sys_IncompatibleWarning TerminalClampManager_TCM_10ms_sys_InternalWakeupLogic TerminalClampManager_TCM_10ms_sys_OperationPostprocess TerminalClampManager_TCM_10ms_sys_OperationStateRecovery TerminalClampManager_TCM_10ms_sys_TimerOutput TerminalClampManager_TCM_10ms_sys_TimerUnitConvertion /end SUB_GROUP
/end GROUP
/begin GROUP TerminalClampManager "TerminalClampManager" ROOT /begin SUB_GROUP TerminalClampManager_TCM_10ms_sys /end SUB_GROUP
 /begin REF_MEASUREMENT ACM_SeatOccupancy2ndRowDri ACM_SeatOccupancy2ndRowMid ACM_SeatOccupancy2ndRowPas ACM_SeatOccupancyPassenger ATA_AntiTheftStatus BCMFL_Clamp15FL BCMFL_Clamp30cFL BCMFL_Clamp30sFL BCMFL_ClampRFL BCMFR_Clamp15FR BCMFR_Clamp30cFR BCMFR_Clamp30sFR BCMFR_ClampRFR BCMRE_AlcoholockSwitch BCMRE_Clamp15RE BCMRE_Clamp30cRE BCMRE_Clamp30sRE BCMRE_ClampRRE BCMRE_FootKickOperationRequest BCMRE_TailgatePassiveEntryReq BMS_HVOnOffSts CVC_AccessoryModeRequest CVC_OtaRequest CVC_RemoteParkingRequest CVC_SocDisplay CVC_TransportModeSts FCAM_RemoteDrivingRequest IMMO_IMMOSts TCM_AccIdleTimer TCM_AccLowSocSaveModeTimer TCM_Clamp15Request TCM_Clamp30cRequest TCM_Clamp30sRequest TCM_ClampIncompatibleWarnFlag TCM_ClampRRequest TCM_Cluster0Request TCM_Cluster2Request TCM_FullScreenChgDisplayTimer TCM_OnIdleTimer TCM_OnLowSocSaveModeTimer VCU_VehChgSts /end REF_MEASUREMENT
/end GROUP
/begin GROUP SideMirrorAdjustManager_SMAM_Main_sys_UserprofileDataSave_Detect_Change1 "SideMirrorAdjustManager/SMAM_Main_sys/UserprofileDataSave/Detect\r\nChange1" /begin REF_MEASUREMENT S2S_SetMirrorAutoUnfold /end REF_MEASUREMENT /end GROUP
/begin GROUP SideMirrorAdjustManager_SMAM_Main_sys_UserprofileDataSave_Detect_Change "SideMirrorAdjustManager/SMAM_Main_sys/UserprofileDataSave/Detect\r\nChange" /begin REF_MEASUREMENT S2S_Autotilt /end REF_MEASUREMENT /end GROUP
/begin GROUP SideMirrorAdjustManager_SMAM_Main_sys_UserprofileDataSave "SideMirrorAdjustManager/SMAM_Main_sys/UserprofileDataSave"
 /begin SUB_GROUP SideMirrorAdjustManager_SMAM_Main_sys_UserprofileDataSave_Detect_Change SideMirrorAdjustManager_SMAM_Main_sys_UserprofileDataSave_Detect_Change1 /end SUB_GROUP
 /begin REF_MEASUREMENT BCMFL_STAT_LeftMirrorPosX BCMFL_STAT_LeftMirrorPosY BCMFR_STAT_RightMirrorPosX BCMFR_STAT_RightMirrorPosY MHU_UserProfileId S2S_Autotilt S2S_SetMirrorAutoUnfold /end REF_MEASUREMENT
/end GROUP
/begin GROUP SideMirrorAdjustManager_SMAM_Main_sys_UserprofileDataLoad_RightMiirorAngleLoad_If_Action_Subsystem5 "SideMirrorAdjustManager/SMAM_Main_sys/UserprofileDataLoad/RightMiirorAngleLoad/If Action\r\nSubsystem5" /end GROUP
/begin GROUP SideMirrorAdjustManager_SMAM_Main_sys_UserprofileDataLoad_RightMiirorAngleLoad_If_Action_Subsystem4 "SideMirrorAdjustManager/SMAM_Main_sys/UserprofileDataLoad/RightMiirorAngleLoad/If Action\r\nSubsystem4" /end GROUP
/begin GROUP SideMirrorAdjustManager_SMAM_Main_sys_UserprofileDataLoad_RightMiirorAngleLoad_If_Action_Subsystem3 "SideMirrorAdjustManager/SMAM_Main_sys/UserprofileDataLoad/RightMiirorAngleLoad/If Action\r\nSubsystem3" /end GROUP
/begin GROUP SideMirrorAdjustManager_SMAM_Main_sys_UserprofileDataLoad_RightMiirorAngleLoad_If_Action_Subsystem2 "SideMirrorAdjustManager/SMAM_Main_sys/UserprofileDataLoad/RightMiirorAngleLoad/If Action\r\nSubsystem2" /end GROUP
/begin GROUP SideMirrorAdjustManager_SMAM_Main_sys_UserprofileDataLoad_RightMiirorAngleLoad_If_Action_Subsystem1 "SideMirrorAdjustManager/SMAM_Main_sys/UserprofileDataLoad/RightMiirorAngleLoad/If Action\r\nSubsystem1" /end GROUP
/begin GROUP SideMirrorAdjustManager_SMAM_Main_sys_UserprofileDataLoad_RightMiirorAngleLoad_If_Action_Subsystem "SideMirrorAdjustManager/SMAM_Main_sys/UserprofileDataLoad/RightMiirorAngleLoad/If Action\r\nSubsystem" /end GROUP
/begin GROUP SideMirrorAdjustManager_SMAM_Main_sys_UserprofileDataLoad_RightMiirorAngleLoad "SideMirrorAdjustManager/SMAM_Main_sys/UserprofileDataLoad/RightMiirorAngleLoad"
 /begin SUB_GROUP SideMirrorAdjustManager_SMAM_Main_sys_UserprofileDataLoad_RightMiirorAngleLoad_If_Action_Subsystem SideMirrorAdjustManager_SMAM_Main_sys_UserprofileDataLoad_RightMiirorAngleLoad_If_Action_Subsystem1 SideMirrorAdjustManager_SMAM_Main_sys_UserprofileDataLoad_RightMiirorAngleLoad_If_Action_Subsystem2 SideMirrorAdjustManager_SMAM_Main_sys_UserprofileDataLoad_RightMiirorAngleLoad_If_Action_Subsystem3 SideMirrorAdjustManager_SMAM_Main_sys_UserprofileDataLoad_RightMiirorAngleLoad_If_Action_Subsystem4 SideMirrorAdjustManager_SMAM_Main_sys_UserprofileDataLoad_RightMiirorAngleLoad_If_Action_Subsystem5 /end SUB_GROUP
 /begin REF_MEASUREMENT BCMFR_STAT_RightMirrorPosX BCMFR_STAT_RightMirrorPosY /end REF_MEASUREMENT
/end GROUP
/begin GROUP SideMirrorAdjustManager_SMAM_Main_sys_UserprofileDataLoad_LeftMiirorAngleLoad_If_Action_Subsystem5 "SideMirrorAdjustManager/SMAM_Main_sys/UserprofileDataLoad/LeftMiirorAngleLoad/If Action\r\nSubsystem5" /end GROUP
/begin GROUP SideMirrorAdjustManager_SMAM_Main_sys_UserprofileDataLoad_LeftMiirorAngleLoad_If_Action_Subsystem4 "SideMirrorAdjustManager/SMAM_Main_sys/UserprofileDataLoad/LeftMiirorAngleLoad/If Action\r\nSubsystem4" /end GROUP
/begin GROUP SideMirrorAdjustManager_SMAM_Main_sys_UserprofileDataLoad_LeftMiirorAngleLoad_If_Action_Subsystem3 "SideMirrorAdjustManager/SMAM_Main_sys/UserprofileDataLoad/LeftMiirorAngleLoad/If Action\r\nSubsystem3" /end GROUP
/begin GROUP SideMirrorAdjustManager_SMAM_Main_sys_UserprofileDataLoad_LeftMiirorAngleLoad_If_Action_Subsystem2 "SideMirrorAdjustManager/SMAM_Main_sys/UserprofileDataLoad/LeftMiirorAngleLoad/If Action\r\nSubsystem2" /end GROUP
/begin GROUP SideMirrorAdjustManager_SMAM_Main_sys_UserprofileDataLoad_LeftMiirorAngleLoad_If_Action_Subsystem1 "SideMirrorAdjustManager/SMAM_Main_sys/UserprofileDataLoad/LeftMiirorAngleLoad/If Action\r\nSubsystem1" /end GROUP
/begin GROUP SideMirrorAdjustManager_SMAM_Main_sys_UserprofileDataLoad_LeftMiirorAngleLoad_If_Action_Subsystem "SideMirrorAdjustManager/SMAM_Main_sys/UserprofileDataLoad/LeftMiirorAngleLoad/If Action\r\nSubsystem" /end GROUP
/begin GROUP SideMirrorAdjustManager_SMAM_Main_sys_UserprofileDataLoad_LeftMiirorAngleLoad "SideMirrorAdjustManager/SMAM_Main_sys/UserprofileDataLoad/LeftMiirorAngleLoad"
 /begin SUB_GROUP SideMirrorAdjustManager_SMAM_Main_sys_UserprofileDataLoad_LeftMiirorAngleLoad_If_Action_Subsystem SideMirrorAdjustManager_SMAM_Main_sys_UserprofileDataLoad_LeftMiirorAngleLoad_If_Action_Subsystem1 SideMirrorAdjustManager_SMAM_Main_sys_UserprofileDataLoad_LeftMiirorAngleLoad_If_Action_Subsystem2 SideMirrorAdjustManager_SMAM_Main_sys_UserprofileDataLoad_LeftMiirorAngleLoad_If_Action_Subsystem3 SideMirrorAdjustManager_SMAM_Main_sys_UserprofileDataLoad_LeftMiirorAngleLoad_If_Action_Subsystem4 SideMirrorAdjustManager_SMAM_Main_sys_UserprofileDataLoad_LeftMiirorAngleLoad_If_Action_Subsystem5 /end SUB_GROUP
 /begin REF_MEASUREMENT BCMFL_STAT_LeftMirrorPosX BCMFL_STAT_LeftMirrorPosY /end REF_MEASUREMENT
/end GROUP
/begin GROUP SideMirrorAdjustManager_SMAM_Main_sys_UserprofileDataLoad "SideMirrorAdjustManager/SMAM_Main_sys/UserprofileDataLoad"
 /begin SUB_GROUP SideMirrorAdjustManager_SMAM_Main_sys_UserprofileDataLoad_LeftMiirorAngleLoad SideMirrorAdjustManager_SMAM_Main_sys_UserprofileDataLoad_RightMiirorAngleLoad /end SUB_GROUP
/end GROUP
/begin GROUP SideMirrorAdjustManager_SMAM_Main_sys_UserDataLoad_Detect_Change "SideMirrorAdjustManager/SMAM_Main_sys/UserDataLoad/Detect\r\nChange" /begin REF_MEASUREMENT MHU_UserProfileId /end REF_MEASUREMENT /end GROUP
/begin GROUP SideMirrorAdjustManager_SMAM_Main_sys_UserDataLoad "SideMirrorAdjustManager/SMAM_Main_sys/UserDataLoad"
 /begin SUB_GROUP SideMirrorAdjustManager_SMAM_Main_sys_UserDataLoad_Detect_Change /end SUB_GROUP
 /begin REF_MEASUREMENT MHU_UserProfileId /end REF_MEASUREMENT
/end GROUP
/begin GROUP SideMirrorAdjustManager_SMAM_Main_sys_Right_No_Req_Logic "SideMirrorAdjustManager/SMAM_Main_sys/Right_No_Req Logic" /begin REF_MEASUREMENT BCMFR_STAT_MirrorAdjustRight S2S_MirrorAdjustRightSetOff /end REF_MEASUREMENT /end GROUP
/begin GROUP SideMirrorAdjustManager_SMAM_Main_sys_PreconditionCalculation "SideMirrorAdjustManager/SMAM_Main_sys/PreconditionCalculation" /end GROUP
/begin GROUP SideMirrorAdjustManager_SMAM_Main_sys_MirrorHeating_Timer "SideMirrorAdjustManager/SMAM_Main_sys/MirrorHeating/Timer" /end GROUP
/begin GROUP SideMirrorAdjustManager_SMAM_Main_sys_MirrorHeating_SMAM_Ts_P "SideMirrorAdjustManager/SMAM_Main_sys/MirrorHeating/SMAM_Ts_P" /begin REF_CHARACTERISTIC SMAM_Ts_P /end REF_CHARACTERISTIC /end GROUP
/begin GROUP SideMirrorAdjustManager_SMAM_Main_sys_MirrorHeating_SMAM_HeatingTimer_P "SideMirrorAdjustManager/SMAM_Main_sys/MirrorHeating/SMAM_HeatingTimer_P" /begin REF_CHARACTERISTIC SMAM_HeatingTimer_P /end REF_CHARACTERISTIC /end GROUP
/begin GROUP SideMirrorAdjustManager_SMAM_Main_sys_MirrorHeating "SideMirrorAdjustManager/SMAM_Main_sys/MirrorHeating"
 /begin SUB_GROUP SideMirrorAdjustManager_SMAM_Main_sys_MirrorHeating_SMAM_HeatingTimer_P SideMirrorAdjustManager_SMAM_Main_sys_MirrorHeating_SMAM_Ts_P SideMirrorAdjustManager_SMAM_Main_sys_MirrorHeating_Timer /end SUB_GROUP
 /begin REF_MEASUREMENT BCMFL_STAT_LeftMirrorHeating BCMFR_STAT_RightMirrorHeating MHU_SetRearDefrost S2S_RearHeatedWindowSet /end REF_MEASUREMENT
/end GROUP
/begin GROUP SideMirrorAdjustManager_SMAM_Main_sys_MirrorFoldUnfold_S_R_Flip_Flop1 "SideMirrorAdjustManager/SMAM_Main_sys/MirrorFoldUnfold/S-R\r\nFlip-Flop1" /end GROUP
/begin GROUP SideMirrorAdjustManager_SMAM_Main_sys_MirrorFoldUnfold_S_R_Flip_Flop "SideMirrorAdjustManager/SMAM_Main_sys/MirrorFoldUnfold/S-R\r\nFlip-Flop" /end GROUP
/begin GROUP SideMirrorAdjustManager_SMAM_Main_sys_MirrorFoldUnfold_Detect_Increase3 "SideMirrorAdjustManager/SMAM_Main_sys/MirrorFoldUnfold/Detect\r\nIncrease3" /end GROUP
/begin GROUP SideMirrorAdjustManager_SMAM_Main_sys_MirrorFoldUnfold_Detect_Increase2 "SideMirrorAdjustManager/SMAM_Main_sys/MirrorFoldUnfold/Detect\r\nIncrease2" /end GROUP
/begin GROUP SideMirrorAdjustManager_SMAM_Main_sys_MirrorFoldUnfold_Detect_Increase1 "SideMirrorAdjustManager/SMAM_Main_sys/MirrorFoldUnfold/Detect\r\nIncrease1" /end GROUP
/begin GROUP SideMirrorAdjustManager_SMAM_Main_sys_MirrorFoldUnfold_Detect_Increase "SideMirrorAdjustManager/SMAM_Main_sys/MirrorFoldUnfold/Detect\r\nIncrease" /end GROUP
/begin GROUP SideMirrorAdjustManager_SMAM_Main_sys_MirrorFoldUnfold "SideMirrorAdjustManager/SMAM_Main_sys/MirrorFoldUnfold"
 /begin SUB_GROUP SideMirrorAdjustManager_SMAM_Main_sys_MirrorFoldUnfold_Detect_Increase SideMirrorAdjustManager_SMAM_Main_sys_MirrorFoldUnfold_Detect_Increase1 SideMirrorAdjustManager_SMAM_Main_sys_MirrorFoldUnfold_Detect_Increase2 SideMirrorAdjustManager_SMAM_Main_sys_MirrorFoldUnfold_Detect_Increase3 SideMirrorAdjustManager_SMAM_Main_sys_MirrorFoldUnfold_S_R_Flip_Flop SideMirrorAdjustManager_SMAM_Main_sys_MirrorFoldUnfold_S_R_Flip_Flop1 /end SUB_GROUP
 /begin REF_MEASUREMENT BCMFL_STAT_LeftMirrorFold BCMFR_STAT_RightMirrorFold S2S_LeftMirrorFoldRequest S2S_RightMirrorFoldRequest /end REF_MEASUREMENT
/end GROUP
/begin GROUP SideMirrorAdjustManager_SMAM_Main_sys_MirrorAdjustStateManagement "SideMirrorAdjustManager/SMAM_Main_sys/MirrorAdjustStateManagement" /end GROUP
/begin GROUP SideMirrorAdjustManager_SMAM_Main_sys_ManualChangeDetection "SideMirrorAdjustManager/SMAM_Main_sys/ManualChangeDetection"
 /begin REF_MEASUREMENT MFS_DownControl MFS_LeftControl MFS_RightControl MFS_UpControl S2S_MirrorAdjustLeftSetOn S2S_MirrorAdjustRightSetOn /end REF_MEASUREMENT
/end GROUP
/begin GROUP SideMirrorAdjustManager_SMAM_Main_sys_Left_No_Req_Logic "SideMirrorAdjustManager/SMAM_Main_sys/Left_No_Req Logic" /begin REF_MEASUREMENT BCMFL_STAT_MirrorAdjustLeft S2S_MirrorAdjustLeftSetOff /end REF_MEASUREMENT /end GROUP
/begin GROUP SideMirrorAdjustManager_SMAM_Main_sys_AdjustBoundaryDetecttion "SideMirrorAdjustManager/SMAM_Main_sys/AdjustBoundaryDetecttion"
 /begin REF_MEASUREMENT BCMFL_STAT_LeftMirrorPosX BCMFL_STAT_LeftMirrorPosY BCMFR_STAT_RightMirrorPosX BCMFR_STAT_RightMirrorPosY /end REF_MEASUREMENT
/end GROUP
/begin GROUP SideMirrorAdjustManager_SMAM_Main_sys "SideMirrorAdjustManager/SMAM_Main_sys"
 /begin SUB_GROUP SideMirrorAdjustManager_SMAM_Main_sys_AdjustBoundaryDetecttion SideMirrorAdjustManager_SMAM_Main_sys_Left_No_Req_Logic SideMirrorAdjustManager_SMAM_Main_sys_ManualChangeDetection SideMirrorAdjustManager_SMAM_Main_sys_MirrorAdjustStateManagement SideMirrorAdjustManager_SMAM_Main_sys_MirrorFoldUnfold SideMirrorAdjustManager_SMAM_Main_sys_MirrorHeating SideMirrorAdjustManager_SMAM_Main_sys_PreconditionCalculation SideMirrorAdjustManager_SMAM_Main_sys_Right_No_Req_Logic SideMirrorAdjustManager_SMAM_Main_sys_UserDataLoad SideMirrorAdjustManager_SMAM_Main_sys_UserprofileDataLoad SideMirrorAdjustManager_SMAM_Main_sys_UserprofileDataSave /end SUB_GROUP
/end GROUP
/begin GROUP SideMirrorAdjustManager "SideMirrorAdjustManager" ROOT /begin SUB_GROUP SideMirrorAdjustManager_SMAM_Main_sys /end SUB_GROUP
 /begin REF_MEASUREMENT BCMFL_STAT_LeftMirrorFold BCMFL_STAT_LeftMirrorHeating BCMFL_STAT_LeftMirrorPosX BCMFL_STAT_LeftMirrorPosY BCMFL_STAT_MirrorAdjustLeft BCMFR_STAT_MirrorAdjustRight BCMFR_STAT_RightMirrorFold BCMFR_STAT_RightMirrorHeating BCMFR_STAT_RightMirrorPosX BCMFR_STAT_RightMirrorPosY MFS_DownControl MFS_LeftControl MFS_RightControl MFS_UpControl MHU_SetRearDefrost MHU_UserProfileId S2S_Autotilt S2S_LeftMirrorFoldRequest S2S_MirrorAdjustLeftSetOff S2S_MirrorAdjustLeftSetOn S2S_MirrorAdjustRightSetOff S2S_MirrorAdjustRightSetOn S2S_RearHeatedWindowSet S2S_RightMirrorFoldRequest S2S_SetMirrorAutoUnfold SMAM_FoldSettingValidFlag SMAM_LHMirrorAdjustmentReq SMAM_LHMirrorAdjustmentSet SMAM_RHMirrorAdjustmentReq SMAM_RHMirrorAdjustmentSet SMAM_SetMirrorFoldLeft SMAM_SetMirrorFoldRight SMAM_SetRearHeatWindow SMAM_TiltSettingValidFlag /end REF_MEASUREMENT
/end GROUP
/begin GROUP Nv_User3NvMirrorData "" /end GROUP
/begin GROUP Nv_User2NvMirrorData "" /end GROUP
/begin GROUP Nv_User1NvMirrorData "" /end GROUP
/begin GROUP InteriorLightManager_ILM_Main_sys_ILM_Main_Vehicle_Operation_State_Processing_Compare_To_Constant5 "InteriorLightManager/ILM_Main_sys/ILM_Main/Vehicle Operation State Processing/Compare\r\nTo Constant5" /end GROUP
/begin GROUP InteriorLightManager_ILM_Main_sys_ILM_Main_Vehicle_Operation_State_Processing_Compare_To_Constant4 "InteriorLightManager/ILM_Main_sys/ILM_Main/Vehicle Operation State Processing/Compare\r\nTo Constant4" /end GROUP
/begin GROUP InteriorLightManager_ILM_Main_sys_ILM_Main_Vehicle_Operation_State_Processing_Compare_To_Constant1 "InteriorLightManager/ILM_Main_sys/ILM_Main/Vehicle Operation State Processing/Compare\r\nTo Constant1" /end GROUP
/begin GROUP InteriorLightManager_ILM_Main_sys_ILM_Main_Vehicle_Operation_State_Processing "InteriorLightManager/ILM_Main_sys/ILM_Main/Vehicle Operation State Processing"
 /begin SUB_GROUP InteriorLightManager_ILM_Main_sys_ILM_Main_Vehicle_Operation_State_Processing_Compare_To_Constant1 InteriorLightManager_ILM_Main_sys_ILM_Main_Vehicle_Operation_State_Processing_Compare_To_Constant4 InteriorLightManager_ILM_Main_sys_ILM_Main_Vehicle_Operation_State_Processing_Compare_To_Constant5 /end SUB_GROUP
/end GROUP
/begin GROUP InteriorLightManager_ILM_Main_sys_ILM_Main_Scuff_Light_Control "InteriorLightManager/ILM_Main_sys/ILM_Main/Scuff Light Control" /end GROUP
/begin GROUP InteriorLightManager_ILM_Main_sys_ILM_Main_Logo_Projector_Light_Control "InteriorLightManager/ILM_Main_sys/ILM_Main/Logo Projector Light Control" /end GROUP
/begin GROUP InteriorLightManager_ILM_Main_sys_ILM_Main_Frunk_Light_Control_Timer_AVLib_Timer "InteriorLightManager/ILM_Main_sys/ILM_Main/Frunk Light Control/Timer/AVLib_Timer" /end GROUP
/begin GROUP InteriorLightManager_ILM_Main_sys_ILM_Main_Frunk_Light_Control_Timer "InteriorLightManager/ILM_Main_sys/ILM_Main/Frunk Light Control/Timer"
 /begin SUB_GROUP InteriorLightManager_ILM_Main_sys_ILM_Main_Frunk_Light_Control_Timer_AVLib_Timer /end SUB_GROUP
/end GROUP
/begin GROUP InteriorLightManager_ILM_Main_sys_ILM_Main_Frunk_Light_Control_Detect_Rise_Positive "InteriorLightManager/ILM_Main_sys/ILM_Main/Frunk Light Control/Detect Rise\r\nPositive" /end GROUP
/begin GROUP InteriorLightManager_ILM_Main_sys_ILM_Main_Frunk_Light_Control "InteriorLightManager/ILM_Main_sys/ILM_Main/Frunk Light Control"
 /begin SUB_GROUP InteriorLightManager_ILM_Main_sys_ILM_Main_Frunk_Light_Control_Detect_Rise_Positive InteriorLightManager_ILM_Main_sys_ILM_Main_Frunk_Light_Control_Timer /end SUB_GROUP
/end GROUP
/begin GROUP InteriorLightManager_ILM_Main_sys_ILM_Main_Footwell_Light_Control "InteriorLightManager/ILM_Main_sys/ILM_Main/Footwell Light Control" /begin REF_MEASUREMENT S2S_FootwellLightMode /end REF_MEASUREMENT /end GROUP
/begin GROUP InteriorLightManager_ILM_Main_sys_ILM_Main_Door_Status_Calc "InteriorLightManager/ILM_Main_sys/ILM_Main/Door Status Calc" /end GROUP
/begin GROUP InteriorLightManager_ILM_Main_sys_ILM_Main_Dome_Light_Control_VEHICLE_UNLOCKED_DOME_LIGHT_ON_DURATION "InteriorLightManager/ILM_Main_sys/ILM_Main/Dome Light Control/VEHICLE_UNLOCKED_DOME_LIGHT_ON_DURATION" /begin REF_CHARACTERISTIC VEHICLE_UNLOCKED_DOME_LIGHT_ON_DURATION /end REF_CHARACTERISTIC /end GROUP
/begin GROUP InteriorLightManager_ILM_Main_sys_ILM_Main_Dome_Light_Control_Subsystem_Detect_Rise_Positive4 "InteriorLightManager/ILM_Main_sys/ILM_Main/Dome Light Control/Subsystem/Detect Rise\r\nPositive4" /end GROUP
/begin GROUP InteriorLightManager_ILM_Main_sys_ILM_Main_Dome_Light_Control_Subsystem5_Detect_Rise_Positive1 "InteriorLightManager/ILM_Main_sys/ILM_Main/Dome Light Control/Subsystem5/Detect Rise\r\nPositive1" /end GROUP
/begin GROUP InteriorLightManager_ILM_Main_sys_ILM_Main_Dome_Light_Control_Subsystem5_Detect_Rise_Positive "InteriorLightManager/ILM_Main_sys/ILM_Main/Dome Light Control/Subsystem5/Detect Rise\r\nPositive" /end GROUP
/begin GROUP InteriorLightManager_ILM_Main_sys_ILM_Main_Dome_Light_Control_Subsystem5 "InteriorLightManager/ILM_Main_sys/ILM_Main/Dome Light Control/Subsystem5"
 /begin SUB_GROUP InteriorLightManager_ILM_Main_sys_ILM_Main_Dome_Light_Control_Subsystem5_Detect_Rise_Positive InteriorLightManager_ILM_Main_sys_ILM_Main_Dome_Light_Control_Subsystem5_Detect_Rise_Positive1 /end SUB_GROUP
/end GROUP
/begin GROUP InteriorLightManager_ILM_Main_sys_ILM_Main_Dome_Light_Control_Subsystem4 "InteriorLightManager/ILM_Main_sys/ILM_Main/Dome Light Control/Subsystem4" /end GROUP
/begin GROUP InteriorLightManager_ILM_Main_sys_ILM_Main_Dome_Light_Control_Subsystem3_Detect_Rise_Positive3 "InteriorLightManager/ILM_Main_sys/ILM_Main/Dome Light Control/Subsystem3/Detect Rise\r\nPositive3" /end GROUP
/begin GROUP InteriorLightManager_ILM_Main_sys_ILM_Main_Dome_Light_Control_Subsystem3_Detect_Rise_Positive2 "InteriorLightManager/ILM_Main_sys/ILM_Main/Dome Light Control/Subsystem3/Detect Rise\r\nPositive2" /end GROUP
/begin GROUP InteriorLightManager_ILM_Main_sys_ILM_Main_Dome_Light_Control_Subsystem3_Detect_Rise_Positive1 "InteriorLightManager/ILM_Main_sys/ILM_Main/Dome Light Control/Subsystem3/Detect Rise\r\nPositive1" /end GROUP
/begin GROUP InteriorLightManager_ILM_Main_sys_ILM_Main_Dome_Light_Control_Subsystem3_Detect_Rise_Positive "InteriorLightManager/ILM_Main_sys/ILM_Main/Dome Light Control/Subsystem3/Detect Rise\r\nPositive" /end GROUP
/begin GROUP InteriorLightManager_ILM_Main_sys_ILM_Main_Dome_Light_Control_Subsystem3 "InteriorLightManager/ILM_Main_sys/ILM_Main/Dome Light Control/Subsystem3"
 /begin SUB_GROUP InteriorLightManager_ILM_Main_sys_ILM_Main_Dome_Light_Control_Subsystem3_Detect_Rise_Positive InteriorLightManager_ILM_Main_sys_ILM_Main_Dome_Light_Control_Subsystem3_Detect_Rise_Positive1 InteriorLightManager_ILM_Main_sys_ILM_Main_Dome_Light_Control_Subsystem3_Detect_Rise_Positive2 InteriorLightManager_ILM_Main_sys_ILM_Main_Dome_Light_Control_Subsystem3_Detect_Rise_Positive3 /end SUB_GROUP
/end GROUP
/begin GROUP InteriorLightManager_ILM_Main_sys_ILM_Main_Dome_Light_Control_Subsystem1_Detect_Rise_Positive5 "InteriorLightManager/ILM_Main_sys/ILM_Main/Dome Light Control/Subsystem1/Detect Rise\r\nPositive5" /end GROUP
/begin GROUP InteriorLightManager_ILM_Main_sys_ILM_Main_Dome_Light_Control_Subsystem1 "InteriorLightManager/ILM_Main_sys/ILM_Main/Dome Light Control/Subsystem1"
 /begin SUB_GROUP InteriorLightManager_ILM_Main_sys_ILM_Main_Dome_Light_Control_Subsystem1_Detect_Rise_Positive5 /end SUB_GROUP
/end GROUP
/begin GROUP InteriorLightManager_ILM_Main_sys_ILM_Main_Dome_Light_Control_Subsystem "InteriorLightManager/ILM_Main_sys/ILM_Main/Dome Light Control/Subsystem"
 /begin SUB_GROUP InteriorLightManager_ILM_Main_sys_ILM_Main_Dome_Light_Control_Subsystem_Detect_Rise_Positive4 /end SUB_GROUP
/end GROUP
/begin GROUP InteriorLightManager_ILM_Main_sys_ILM_Main_Dome_Light_Control_DOME_LIGHT_ON_DURATION "InteriorLightManager/ILM_Main_sys/ILM_Main/Dome Light Control/DOME_LIGHT_ON_DURATION" /begin REF_CHARACTERISTIC DOME_LIGHT_ON_DURATION /end REF_CHARACTERISTIC /end GROUP
/begin GROUP InteriorLightManager_ILM_Main_sys_ILM_Main_Dome_Light_Control_CRASHED_DOME_LIGHT_ON_DURATION "InteriorLightManager/ILM_Main_sys/ILM_Main/Dome Light Control/CRASHED_DOME_LIGHT_ON_DURATION" /begin REF_CHARACTERISTIC CRASHED_DOME_LIGHT_ON_DURATION /end REF_CHARACTERISTIC /end GROUP
/begin GROUP InteriorLightManager_ILM_Main_sys_ILM_Main_Dome_Light_Control "InteriorLightManager/ILM_Main_sys/ILM_Main/Dome Light Control"
 /begin SUB_GROUP InteriorLightManager_ILM_Main_sys_ILM_Main_Dome_Light_Control_CRASHED_DOME_LIGHT_ON_DURATION InteriorLightManager_ILM_Main_sys_ILM_Main_Dome_Light_Control_DOME_LIGHT_ON_DURATION InteriorLightManager_ILM_Main_sys_ILM_Main_Dome_Light_Control_Subsystem InteriorLightManager_ILM_Main_sys_ILM_Main_Dome_Light_Control_Subsystem1 InteriorLightManager_ILM_Main_sys_ILM_Main_Dome_Light_Control_Subsystem3 InteriorLightManager_ILM_Main_sys_ILM_Main_Dome_Light_Control_Subsystem4 InteriorLightManager_ILM_Main_sys_ILM_Main_Dome_Light_Control_Subsystem5 InteriorLightManager_ILM_Main_sys_ILM_Main_Dome_Light_Control_VEHICLE_UNLOCKED_DOME_LIGHT_ON_DURATION /end SUB_GROUP
 /begin REF_MEASUREMENT S2S_FrontDomeLampSet S2S_RearDomeLampSet /end REF_MEASUREMENT
/end GROUP
/begin GROUP InteriorLightManager_ILM_Main_sys_ILM_Main_Courtesy_Light_Control "InteriorLightManager/ILM_Main_sys/ILM_Main/Courtesy Light Control" /end GROUP
/begin GROUP InteriorLightManager_ILM_Main_sys_ILM_Main_Cargo_Light_Control_Timer_AVLib_Timer "InteriorLightManager/ILM_Main_sys/ILM_Main/Cargo Light Control/Timer/AVLib_Timer" /end GROUP
/begin GROUP InteriorLightManager_ILM_Main_sys_ILM_Main_Cargo_Light_Control_Timer "InteriorLightManager/ILM_Main_sys/ILM_Main/Cargo Light Control/Timer"
 /begin SUB_GROUP InteriorLightManager_ILM_Main_sys_ILM_Main_Cargo_Light_Control_Timer_AVLib_Timer /end SUB_GROUP
/end GROUP
/begin GROUP InteriorLightManager_ILM_Main_sys_ILM_Main_Cargo_Light_Control_Detect_Rise_Positive "InteriorLightManager/ILM_Main_sys/ILM_Main/Cargo Light Control/Detect Rise\r\nPositive" /end GROUP
/begin GROUP InteriorLightManager_ILM_Main_sys_ILM_Main_Cargo_Light_Control "InteriorLightManager/ILM_Main_sys/ILM_Main/Cargo Light Control"
 /begin SUB_GROUP InteriorLightManager_ILM_Main_sys_ILM_Main_Cargo_Light_Control_Detect_Rise_Positive InteriorLightManager_ILM_Main_sys_ILM_Main_Cargo_Light_Control_Timer /end SUB_GROUP
/end GROUP
/begin GROUP InteriorLightManager_ILM_Main_sys_ILM_Main_Background_Illumination_MIN_BRIGHTNESS_ILLUMINATION1 "InteriorLightManager/ILM_Main_sys/ILM_Main/Background Illumination/MIN_BRIGHTNESS_ILLUMINATION1" /begin REF_CHARACTERISTIC MIN_BRIGHTNESS_ILLUMINATION /end REF_CHARACTERISTIC /end GROUP
/begin GROUP InteriorLightManager_ILM_Main_sys_ILM_Main_Background_Illumination_MIN_BRIGHTNESS_ILLUMINATION "InteriorLightManager/ILM_Main_sys/ILM_Main/Background Illumination/MIN_BRIGHTNESS_ILLUMINATION" /begin REF_CHARACTERISTIC MIN_BRIGHTNESS_ILLUMINATION /end REF_CHARACTERISTIC /end GROUP
/begin GROUP InteriorLightManager_ILM_Main_sys_ILM_Main_Background_Illumination "InteriorLightManager/ILM_Main_sys/ILM_Main/Background Illumination"
 /begin SUB_GROUP InteriorLightManager_ILM_Main_sys_ILM_Main_Background_Illumination_MIN_BRIGHTNESS_ILLUMINATION InteriorLightManager_ILM_Main_sys_ILM_Main_Background_Illumination_MIN_BRIGHTNESS_ILLUMINATION1 /end SUB_GROUP
 /begin REF_MEASUREMENT BCMFL_SwitchLightBrightnessSts S2S_SwitchLightBrightness /end REF_MEASUREMENT
/end GROUP
/begin GROUP InteriorLightManager_ILM_Main_sys_ILM_Main_Ambient_Light_Control_If_Action_Subsystem2 "InteriorLightManager/ILM_Main_sys/ILM_Main/Ambient Light Control/If Action\r\nSubsystem2" /begin REF_MEASUREMENT S2S_AmbLightTypeReq /end REF_MEASUREMENT /end GROUP
/begin GROUP InteriorLightManager_ILM_Main_sys_ILM_Main_Ambient_Light_Control_If_Action_Subsystem1 "InteriorLightManager/ILM_Main_sys/ILM_Main/Ambient Light Control/If Action\r\nSubsystem1" /begin REF_MEASUREMENT PAS_LeftDoorAmbLightReq PAS_RightDoorAmbLightReq /end REF_MEASUREMENT /end GROUP
/begin GROUP InteriorLightManager_ILM_Main_sys_ILM_Main_Ambient_Light_Control_If_Action_Subsystem "InteriorLightManager/ILM_Main_sys/ILM_Main/Ambient Light Control/If Action\r\nSubsystem" /begin REF_MEASUREMENT PAS_LeftDoorAmbLightReq PAS_RightDoorAmbLightReq /end REF_MEASUREMENT /end GROUP
/begin GROUP InteriorLightManager_ILM_Main_sys_ILM_Main_Ambient_Light_Control_AmbLightScenario "InteriorLightManager/ILM_Main_sys/ILM_Main/Ambient Light Control/AmbLightScenario" /begin REF_MEASUREMENT PAS_LeftDoorAmbLightReq PAS_RightDoorAmbLightReq /end REF_MEASUREMENT /end GROUP
/begin GROUP InteriorLightManager_ILM_Main_sys_ILM_Main_Ambient_Light_Control "InteriorLightManager/ILM_Main_sys/ILM_Main/Ambient Light Control"
 /begin SUB_GROUP InteriorLightManager_ILM_Main_sys_ILM_Main_Ambient_Light_Control_AmbLightScenario InteriorLightManager_ILM_Main_sys_ILM_Main_Ambient_Light_Control_If_Action_Subsystem InteriorLightManager_ILM_Main_sys_ILM_Main_Ambient_Light_Control_If_Action_Subsystem1 InteriorLightManager_ILM_Main_sys_ILM_Main_Ambient_Light_Control_If_Action_Subsystem2 /end SUB_GROUP
/end GROUP
/begin GROUP InteriorLightManager_ILM_Main_sys_ILM_Main "InteriorLightManager/ILM_Main_sys/ILM_Main"
 /begin SUB_GROUP InteriorLightManager_ILM_Main_sys_ILM_Main_Ambient_Light_Control InteriorLightManager_ILM_Main_sys_ILM_Main_Background_Illumination InteriorLightManager_ILM_Main_sys_ILM_Main_Cargo_Light_Control InteriorLightManager_ILM_Main_sys_ILM_Main_Courtesy_Light_Control InteriorLightManager_ILM_Main_sys_ILM_Main_Dome_Light_Control InteriorLightManager_ILM_Main_sys_ILM_Main_Door_Status_Calc InteriorLightManager_ILM_Main_sys_ILM_Main_Footwell_Light_Control InteriorLightManager_ILM_Main_sys_ILM_Main_Frunk_Light_Control InteriorLightManager_ILM_Main_sys_ILM_Main_Logo_Projector_Light_Control InteriorLightManager_ILM_Main_sys_ILM_Main_Scuff_Light_Control InteriorLightManager_ILM_Main_sys_ILM_Main_Vehicle_Operation_State_Processing /end SUB_GROUP
/end GROUP
/begin GROUP InteriorLightManager_ILM_Main_sys "InteriorLightManager/ILM_Main_sys" /begin SUB_GROUP InteriorLightManager_ILM_Main_sys_ILM_Main /end SUB_GROUP /end GROUP
/begin GROUP InteriorLightManager "InteriorLightManager" ROOT /begin SUB_GROUP InteriorLightManager_ILM_Main_sys /end SUB_GROUP
 /begin REF_MEASUREMENT BCMFL_FLDoorCourtesyLightSts BCMFL_FLFootwellLightSts BCMFL_FLProjectorLightSts BCMFL_FLScuffLightSts BCMFL_FrontDomeLampStatus BCMFL_SwitchLightBrightnessSts BCMFR_FRDoorCourtesyLightSts BCMFR_FRFootwellLightSts BCMFR_FRProjectorLightSts BCMFR_FRScuffLightSts BCMRE_BonnetLightSts BCMRE_CargoLightSts BCMRE_RLDoorCourtesyLightSts BCMRE_RLProjectorLightSts BCMRE_RRProjectorLightSts BCMRE_RearDomeLampStatus ILM_AmbLightBrightnessReq ILM_AmbLightColorBlue ILM_AmbLightColorGreen ILM_AmbLightColorRed ILM_AmbLightN1Req ILM_AmbLightN2Req ILM_AmbLightT1Req ILM_AmbLightT2Req ILM_AmbLightT3Req ILM_AmbLightT4Req ILM_AmbLightTypeReq ILM_AmbLightZoneConsLReq_Z7 ILM_AmbLightZoneConsLReq_Z7B ILM_AmbLightZoneConsRLReq_Z9 ILM_AmbLightZoneConsRRReq_Z10 ILM_AmbLightZoneConsRReq_Z8 ILM_AmbLightZoneConsRReq_Z8B ILM_AmbLightZoneFLReq_Z3 ILM_AmbLightZoneFLReq_Z3B ILM_AmbLightZoneFRReq_Z2 ILM_AmbLightZoneFRReq_Z2B ILM_AmbLightZoneIPDrivReq_Z1 ILM_AmbLightZoneIPPassReq_Z6 ILM_AmbLightZoneIPPassReq_Z6B ILM_AmbLightZoneRLReq_Z5 ILM_AmbLightZoneRLReq_Z5B ILM_AmbLightZoneRRReq_Z4 ILM_AmbLightZoneRRReq_Z4B ILM_BonnetLightReq ILM_CargoLightReq ILM_FLDoorCourtesyLightReq ILM_FLFootwellLightReq ILM_FLProjectorLightReq ILM_FLScuffLightReq ILM_FRDoorCourtesyLightReq ILM_FRFootwellLightReq ILM_FRProjectorLightReq ILM_FRScuffLightReq ILM_FrontDomeLampReq ILM_PWM_FN_ILUM_LIN ILM_RLDoorCourtesyLightReq ILM_RLProjectorLightReq ILM_RRDoorCourtesyLightReq ILM_RRProjectorLightReq ILM_RearDomeLampReq ILM_SwitchLightBrightnessNot ILM_SwitchLightBrightnessSet PAS_LeftDoorAmbLightReq PAS_RightDoorAmbLightReq S2S_AmbLightAllZoneReq S2S_AmbLightBrightnessReq S2S_AmbLightColorBlue S2S_AmbLightColorGreen S2S_AmbLightColorRed S2S_AmbLightTypeReq S2S_FootwellLightMode S2S_FrontDomeLampSet S2S_RearDomeLampSet S2S_SwitchLightBrightness /end REF_MEASUREMENT
/end GROUP
/begin GROUP Immobilizer "Immobilizer" ROOT /end GROUP
/begin GROUP HornControlManager_HCM_Main_sys_HCM_Main_If_Action_Subsystem1 "HornControlManager/HCM_Main_sys/HCM_Main/If Action\r\nSubsystem1" /begin REF_MEASUREMENT ATA_HornRequest /end REF_MEASUREMENT /end GROUP
/begin GROUP HornControlManager_HCM_Main_sys_HCM_Main_HornControlByPanicAlarmButton_PANIC_ALARM_HORN_ON_DURATION "HornControlManager/HCM_Main_sys/HCM_Main/HornControlByPanicAlarmButton/PANIC_ALARM_HORN_ON_DURATION" /begin REF_CHARACTERISTIC PANIC_ALARM_HORN_ON_DURATION /end REF_CHARACTERISTIC /end GROUP
/begin GROUP HornControlManager_HCM_Main_sys_HCM_Main_HornControlByPanicAlarmButton_PANIC_ALARM_HORN_OFF_DURATION "HornControlManager/HCM_Main_sys/HCM_Main/HornControlByPanicAlarmButton/PANIC_ALARM_HORN_OFF_DURATION" /begin REF_CHARACTERISTIC PANIC_ALARM_HORN_OFF_DURATION /end REF_CHARACTERISTIC /end GROUP
/begin GROUP HornControlManager_HCM_Main_sys_HCM_Main_HornControlByPanicAlarmButton_HornRequestGenerator "HornControlManager/HCM_Main_sys/HCM_Main/HornControlByPanicAlarmButton/HornRequestGenerator" /end GROUP
/begin GROUP HornControlManager_HCM_Main_sys_HCM_Main_HornControlByPanicAlarmButton "HornControlManager/HCM_Main_sys/HCM_Main/HornControlByPanicAlarmButton"
 /begin SUB_GROUP HornControlManager_HCM_Main_sys_HCM_Main_HornControlByPanicAlarmButton_HornRequestGenerator HornControlManager_HCM_Main_sys_HCM_Main_HornControlByPanicAlarmButton_PANIC_ALARM_HORN_OFF_DURATION HornControlManager_HCM_Main_sys_HCM_Main_HornControlByPanicAlarmButton_PANIC_ALARM_HORN_ON_DURATION /end SUB_GROUP
/end GROUP
/begin GROUP HornControlManager_HCM_Main_sys_HCM_Main_HornControlByLockUnlock_TurnOffDelay "HornControlManager/HCM_Main_sys/HCM_Main/HornControlByLockUnlock/TurnOffDelay" /end GROUP
/begin GROUP HornControlManager_HCM_Main_sys_HCM_Main_HornControlByLockUnlock_KEYFOB_PE_HORN_ON_DURATION1 "HornControlManager/HCM_Main_sys/HCM_Main/HornControlByLockUnlock/KEYFOB_PE_HORN_ON_DURATION1" /begin REF_CHARACTERISTIC KEYFOB_PE_HORN_ON_DURATION /end REF_CHARACTERISTIC /end GROUP
/begin GROUP HornControlManager_HCM_Main_sys_HCM_Main_HornControlByLockUnlock_KEYFOB_PE_HORN_ON_DURATION "HornControlManager/HCM_Main_sys/HCM_Main/HornControlByLockUnlock/KEYFOB_PE_HORN_ON_DURATION" /begin REF_CHARACTERISTIC KEYFOB_PE_HORN_ON_DURATION /end REF_CHARACTERISTIC /end GROUP
/begin GROUP HornControlManager_HCM_Main_sys_HCM_Main_HornControlByLockUnlock_KEYFOB_PE_HORN_OFF_DURATION1 "HornControlManager/HCM_Main_sys/HCM_Main/HornControlByLockUnlock/KEYFOB_PE_HORN_OFF_DURATION1" /begin REF_CHARACTERISTIC KEYFOB_PE_HORN_OFF_DURATION /end REF_CHARACTERISTIC /end GROUP
/begin GROUP HornControlManager_HCM_Main_sys_HCM_Main_HornControlByLockUnlock_KEYFOB_PE_HORN_OFF_DURATION "HornControlManager/HCM_Main_sys/HCM_Main/HornControlByLockUnlock/KEYFOB_PE_HORN_OFF_DURATION" /begin REF_CHARACTERISTIC KEYFOB_PE_HORN_OFF_DURATION /end REF_CHARACTERISTIC /end GROUP
/begin GROUP HornControlManager_HCM_Main_sys_HCM_Main_HornControlByLockUnlock_KEYFOB_PE_HORN_CYCLE1 "HornControlManager/HCM_Main_sys/HCM_Main/HornControlByLockUnlock/KEYFOB_PE_HORN_CYCLE1" /begin REF_CHARACTERISTIC KEYFOB_PE_HORN_CYCLE /end REF_CHARACTERISTIC /end GROUP
/begin GROUP HornControlManager_HCM_Main_sys_HCM_Main_HornControlByLockUnlock_KEYFOB_PE_HORN_CYCLE "HornControlManager/HCM_Main_sys/HCM_Main/HornControlByLockUnlock/KEYFOB_PE_HORN_CYCLE" /begin REF_CHARACTERISTIC KEYFOB_PE_HORN_CYCLE /end REF_CHARACTERISTIC /end GROUP
/begin GROUP HornControlManager_HCM_Main_sys_HCM_Main_HornControlByLockUnlock_HornRequestGenerator "HornControlManager/HCM_Main_sys/HCM_Main/HornControlByLockUnlock/HornRequestGenerator" /end GROUP
/begin GROUP HornControlManager_HCM_Main_sys_HCM_Main_HornControlByLockUnlock_HCM_Ts_P1 "HornControlManager/HCM_Main_sys/HCM_Main/HornControlByLockUnlock/HCM_Ts_P1" /begin REF_CHARACTERISTIC HCM_Ts_P /end REF_CHARACTERISTIC /end GROUP
/begin GROUP HornControlManager_HCM_Main_sys_HCM_Main_HornControlByLockUnlock "HornControlManager/HCM_Main_sys/HCM_Main/HornControlByLockUnlock"
 /begin SUB_GROUP HornControlManager_HCM_Main_sys_HCM_Main_HornControlByLockUnlock_HCM_Ts_P1 HornControlManager_HCM_Main_sys_HCM_Main_HornControlByLockUnlock_HornRequestGenerator HornControlManager_HCM_Main_sys_HCM_Main_HornControlByLockUnlock_KEYFOB_PE_HORN_CYCLE HornControlManager_HCM_Main_sys_HCM_Main_HornControlByLockUnlock_KEYFOB_PE_HORN_CYCLE1 HornControlManager_HCM_Main_sys_HCM_Main_HornControlByLockUnlock_KEYFOB_PE_HORN_OFF_DURATION HornControlManager_HCM_Main_sys_HCM_Main_HornControlByLockUnlock_KEYFOB_PE_HORN_OFF_DURATION1 HornControlManager_HCM_Main_sys_HCM_Main_HornControlByLockUnlock_KEYFOB_PE_HORN_ON_DURATION HornControlManager_HCM_Main_sys_HCM_Main_HornControlByLockUnlock_KEYFOB_PE_HORN_ON_DURATION1 HornControlManager_HCM_Main_sys_HCM_Main_HornControlByLockUnlock_TurnOffDelay /end SUB_GROUP
 /begin REF_MEASUREMENT CLM_HornONReminder /end REF_MEASUREMENT
/end GROUP
/begin GROUP HornControlManager_HCM_Main_sys_HCM_Main_HornControlByCAPP_HornRequestGenerator "HornControlManager/HCM_Main_sys/HCM_Main/HornControlByCAPP/HornRequestGenerator" /end GROUP
/begin GROUP HornControlManager_HCM_Main_sys_HCM_Main_HornControlByCAPP_Detect_Rise_Positive "HornControlManager/HCM_Main_sys/HCM_Main/HornControlByCAPP/Detect Rise\r\nPositive" /end GROUP
/begin GROUP HornControlManager_HCM_Main_sys_HCM_Main_HornControlByCAPP_CAPP_HORN_ON_DURATION "HornControlManager/HCM_Main_sys/HCM_Main/HornControlByCAPP/CAPP_HORN_ON_DURATION" /begin REF_CHARACTERISTIC CAPP_HORN_ON_DURATION /end REF_CHARACTERISTIC /end GROUP
/begin GROUP HornControlManager_HCM_Main_sys_HCM_Main_HornControlByCAPP_CAPP_HORN_OFF_DURATION "HornControlManager/HCM_Main_sys/HCM_Main/HornControlByCAPP/CAPP_HORN_OFF_DURATION" /begin REF_CHARACTERISTIC CAPP_HORN_OFF_DURATION /end REF_CHARACTERISTIC /end GROUP
/begin GROUP HornControlManager_HCM_Main_sys_HCM_Main_HornControlByCAPP_CAPP_HORN_CYCLE "HornControlManager/HCM_Main_sys/HCM_Main/HornControlByCAPP/CAPP_HORN_CYCLE" /begin REF_CHARACTERISTIC CAPP_HORN_CYCLE /end REF_CHARACTERISTIC /end GROUP
/begin GROUP HornControlManager_HCM_Main_sys_HCM_Main_HornControlByCAPP "HornControlManager/HCM_Main_sys/HCM_Main/HornControlByCAPP"
 /begin SUB_GROUP HornControlManager_HCM_Main_sys_HCM_Main_HornControlByCAPP_CAPP_HORN_CYCLE HornControlManager_HCM_Main_sys_HCM_Main_HornControlByCAPP_CAPP_HORN_OFF_DURATION HornControlManager_HCM_Main_sys_HCM_Main_HornControlByCAPP_CAPP_HORN_ON_DURATION HornControlManager_HCM_Main_sys_HCM_Main_HornControlByCAPP_Detect_Rise_Positive HornControlManager_HCM_Main_sys_HCM_Main_HornControlByCAPP_HornRequestGenerator /end SUB_GROUP
 /begin REF_MEASUREMENT S2S_CAPPHornRequest /end REF_MEASUREMENT
/end GROUP
/begin GROUP HornControlManager_HCM_Main_sys_HCM_Main_HornControlByAtiTheft_HornRequestGenerater "HornControlManager/HCM_Main_sys/HCM_Main/HornControlByAtiTheft/HornRequestGenerater" /begin REF_MEASUREMENT ATA_HornRequest /end REF_MEASUREMENT /end GROUP
/begin GROUP HornControlManager_HCM_Main_sys_HCM_Main_HornControlByAtiTheft_ALARM_TRIGGERED_HORN_ON_DURATION "HornControlManager/HCM_Main_sys/HCM_Main/HornControlByAtiTheft/ALARM_TRIGGERED_HORN_ON_DURATION" /begin REF_CHARACTERISTIC ALARM_TRIGGERED_HORN_ON_DURATION /end REF_CHARACTERISTIC /end GROUP
/begin GROUP HornControlManager_HCM_Main_sys_HCM_Main_HornControlByAtiTheft_ALARM_TRIGGERED_HORN_OFF_DURATION "HornControlManager/HCM_Main_sys/HCM_Main/HornControlByAtiTheft/ALARM_TRIGGERED_HORN_OFF_DURATION" /begin REF_CHARACTERISTIC ALARM_TRIGGERED_HORN_OFF_DURATION /end REF_CHARACTERISTIC /end GROUP
/begin GROUP HornControlManager_HCM_Main_sys_HCM_Main_HornControlByAtiTheft "HornControlManager/HCM_Main_sys/HCM_Main/HornControlByAtiTheft"
 /begin SUB_GROUP HornControlManager_HCM_Main_sys_HCM_Main_HornControlByAtiTheft_ALARM_TRIGGERED_HORN_OFF_DURATION HornControlManager_HCM_Main_sys_HCM_Main_HornControlByAtiTheft_ALARM_TRIGGERED_HORN_ON_DURATION HornControlManager_HCM_Main_sys_HCM_Main_HornControlByAtiTheft_HornRequestGenerater /end SUB_GROUP
/end GROUP
/begin GROUP HornControlManager_HCM_Main_sys_HCM_Main "HornControlManager/HCM_Main_sys/HCM_Main"
 /begin SUB_GROUP HornControlManager_HCM_Main_sys_HCM_Main_HornControlByAtiTheft HornControlManager_HCM_Main_sys_HCM_Main_HornControlByCAPP HornControlManager_HCM_Main_sys_HCM_Main_HornControlByLockUnlock HornControlManager_HCM_Main_sys_HCM_Main_HornControlByPanicAlarmButton HornControlManager_HCM_Main_sys_HCM_Main_If_Action_Subsystem1 /end SUB_GROUP
/end GROUP
/begin GROUP HornControlManager_HCM_Main_sys "HornControlManager/HCM_Main_sys" /begin SUB_GROUP HornControlManager_HCM_Main_sys_HCM_Main /end SUB_GROUP /end GROUP
/begin GROUP HornControlManager "HornControlManager" ROOT /begin SUB_GROUP HornControlManager_HCM_Main_sys /end SUB_GROUP
 /begin REF_MEASUREMENT ATA_HornRequest BCMFL_HornSts CLM_HornONReminder HCM_HornRequest S2S_CAPPHornRequest /end REF_MEASUREMENT
/end GROUP
/begin GROUP ExteriorLightManager_ELM_Main_sys_ELM_Main_LightStsDetmn_TurnIndicatorLightStsDetmn "ExteriorLightManager/ELM_Main_sys/ELM_Main/LightStsDetmn/TurnIndicatorLightStsDetmn"
 /begin REF_MEASUREMENT BCMFL_FLTurnLightStatus BCMFL_FRTurnLightStatus BCMRE_RLTurnLightStatus BCMRE_RRTurnLightStatus /end REF_MEASUREMENT
/end GROUP
/begin GROUP ExteriorLightManager_ELM_Main_sys_ELM_Main_LightStsDetmn_ReverseLampStsDetmn "ExteriorLightManager/ELM_Main_sys/ELM_Main/LightStsDetmn/ReverseLampStsDetmn" /begin REF_MEASUREMENT BCMFL_LeftReverseLampStatus BCMFR_RightReverseLampStatus /end REF_MEASUREMENT /end GROUP
/begin GROUP ExteriorLightManager_ELM_Main_sys_ELM_Main_LightStsDetmn_RearFogStsDetmn "ExteriorLightManager/ELM_Main_sys/ELM_Main/LightStsDetmn/RearFogStsDetmn" /begin REF_MEASUREMENT BCMRE_RLFogLightStatus BCMRE_RRFogLightStatus /end REF_MEASUREMENT /end GROUP
/begin GROUP ExteriorLightManager_ELM_Main_sys_ELM_Main_LightStsDetmn_PositionLightStsDetmn "ExteriorLightManager/ELM_Main_sys/ELM_Main/LightStsDetmn/PositionLightStsDetmn"
 /begin REF_MEASUREMENT BCMFL_FLPosLightStatus BCMFR_FRPosLightStatus BCMRE_LicensePlateLampStatus BCMRE_RLPosLightStatus BCMRE_RRPosLightStatus /end REF_MEASUREMENT
/end GROUP
/begin GROUP ExteriorLightManager_ELM_Main_sys_ELM_Main_LightStsDetmn_LowBeamStsDetmn "ExteriorLightManager/ELM_Main_sys/ELM_Main/LightStsDetmn/LowBeamStsDetmn" /begin REF_MEASUREMENT BCMFL_FLLowBeamStatus BCMFR_FRLowBeamStatus /end REF_MEASUREMENT /end GROUP
/begin GROUP ExteriorLightManager_ELM_Main_sys_ELM_Main_LightStsDetmn_HighBeamStsDetmn "ExteriorLightManager/ELM_Main_sys/ELM_Main/LightStsDetmn/HighBeamStsDetmn" /begin REF_MEASUREMENT BCMFL_FLHighBeamStatus BCMFR_FRHighBeamStatus /end REF_MEASUREMENT /end GROUP
/begin GROUP ExteriorLightManager_ELM_Main_sys_ELM_Main_LightStsDetmn_FrontFogStsDetmn "ExteriorLightManager/ELM_Main_sys/ELM_Main/LightStsDetmn/FrontFogStsDetmn" /begin REF_MEASUREMENT BCMFR_FLFogLightStatus BCMFR_FRFogLightStatus /end REF_MEASUREMENT /end GROUP
/begin GROUP ExteriorLightManager_ELM_Main_sys_ELM_Main_LightStsDetmn_BrakeLightStsDetmn "ExteriorLightManager/ELM_Main_sys/ELM_Main/LightStsDetmn/BrakeLightStsDetmn"
 /begin REF_MEASUREMENT BCMRE_CMBrakeLightStatus BCMRE_LeftBrakeLightStatus BCMRE_RightBrakeLightStatus /end REF_MEASUREMENT
/end GROUP
/begin GROUP ExteriorLightManager_ELM_Main_sys_ELM_Main_LightStsDetmn "ExteriorLightManager/ELM_Main_sys/ELM_Main/LightStsDetmn"
 /begin SUB_GROUP ExteriorLightManager_ELM_Main_sys_ELM_Main_LightStsDetmn_BrakeLightStsDetmn ExteriorLightManager_ELM_Main_sys_ELM_Main_LightStsDetmn_FrontFogStsDetmn ExteriorLightManager_ELM_Main_sys_ELM_Main_LightStsDetmn_HighBeamStsDetmn ExteriorLightManager_ELM_Main_sys_ELM_Main_LightStsDetmn_LowBeamStsDetmn ExteriorLightManager_ELM_Main_sys_ELM_Main_LightStsDetmn_PositionLightStsDetmn ExteriorLightManager_ELM_Main_sys_ELM_Main_LightStsDetmn_RearFogStsDetmn ExteriorLightManager_ELM_Main_sys_ELM_Main_LightStsDetmn_ReverseLampStsDetmn ExteriorLightManager_ELM_Main_sys_ELM_Main_LightStsDetmn_TurnIndicatorLightStsDetmn /end SUB_GROUP
/end GROUP
/begin GROUP ExteriorLightManager_ELM_Main_sys_ELM_Main_LightActuator_TurnIndicatorLightActuator_BYPASS_REQUEST_INDICATOR_LIGHT "ExteriorLightManager/ELM_Main_sys/ELM_Main/LightActuator/TurnIndicatorLightActuator/BYPASS_REQUEST_INDICATOR_LIGHT" /begin REF_CHARACTERISTIC BYPASS_REQUEST_INDICATOR_LIGHT /end REF_CHARACTERISTIC /end GROUP
/begin GROUP ExteriorLightManager_ELM_Main_sys_ELM_Main_LightActuator_TurnIndicatorLightActuator_BYPASS_REQUEST_ALL_LIGHT "ExteriorLightManager/ELM_Main_sys/ELM_Main/LightActuator/TurnIndicatorLightActuator/BYPASS_REQUEST_ALL_LIGHT" /begin REF_CHARACTERISTIC BYPASS_REQUEST_ALL_LIGHT /end REF_CHARACTERISTIC /end GROUP
/begin GROUP ExteriorLightManager_ELM_Main_sys_ELM_Main_LightActuator_TurnIndicatorLightActuator_BYPASS_CONTROL_CONSTANT_INDICATOR_LIGHT1 "ExteriorLightManager/ELM_Main_sys/ELM_Main/LightActuator/TurnIndicatorLightActuator/BYPASS_CONTROL_CONSTANT_INDICATOR_LIGHT1" /begin REF_CHARACTERISTIC BYPASS_CONTROL_CONSTANT_INDICATOR_LIGHT /end REF_CHARACTERISTIC /end GROUP
/begin GROUP ExteriorLightManager_ELM_Main_sys_ELM_Main_LightActuator_TurnIndicatorLightActuator_BYPASS_CONTROL_CONSTANT_ALL_LIGHT1 "ExteriorLightManager/ELM_Main_sys/ELM_Main/LightActuator/TurnIndicatorLightActuator/BYPASS_CONTROL_CONSTANT_ALL_LIGHT1" /begin REF_CHARACTERISTIC BYPASS_CONTROL_CONSTANT_ALL_LIGHT /end REF_CHARACTERISTIC /end GROUP
/begin GROUP ExteriorLightManager_ELM_Main_sys_ELM_Main_LightActuator_ReverseLampActuator_BYPASS_REQUEST_ALL_LIGHT "ExteriorLightManager/ELM_Main_sys/ELM_Main/LightActuator/ReverseLampActuator/BYPASS_REQUEST_ALL_LIGHT" /begin REF_CHARACTERISTIC BYPASS_REQUEST_ALL_LIGHT /end REF_CHARACTERISTIC /end GROUP
/begin GROUP ExteriorLightManager_ELM_Main_sys_ELM_Main_LightActuator_ReverseLampActuator_BYPASS_CONTROL_CONSTANT_ALL_LIGHT1 "ExteriorLightManager/ELM_Main_sys/ELM_Main/LightActuator/ReverseLampActuator/BYPASS_CONTROL_CONSTANT_ALL_LIGHT1" /begin REF_CHARACTERISTIC BYPASS_CONTROL_CONSTANT_ALL_LIGHT /end REF_CHARACTERISTIC /end GROUP
/begin GROUP ExteriorLightManager_ELM_Main_sys_ELM_Main_LightActuator_ReverseLampActuator "ExteriorLightManager/ELM_Main_sys/ELM_Main/LightActuator/ReverseLampActuator" /begin REF_MEASUREMENT BCMFL_LeftReverseLampStatus BCMFR_RightReverseLampStatus /end REF_MEASUREMENT /end GROUP
/begin GROUP ExteriorLightManager_ELM_Main_sys_ELM_Main_LightActuator_PositionLightActuator_BYPASS_REQUEST_ALL_LIGHT "ExteriorLightManager/ELM_Main_sys/ELM_Main/LightActuator/PositionLightActuator/BYPASS_REQUEST_ALL_LIGHT" /begin REF_CHARACTERISTIC BYPASS_REQUEST_ALL_LIGHT /end REF_CHARACTERISTIC /end GROUP
/begin GROUP ExteriorLightManager_ELM_Main_sys_ELM_Main_LightActuator_PositionLightActuator_BYPASS_CONTROL_CONSTANT_ALL_LIGHT1 "ExteriorLightManager/ELM_Main_sys/ELM_Main/LightActuator/PositionLightActuator/BYPASS_CONTROL_CONSTANT_ALL_LIGHT1" /begin REF_CHARACTERISTIC BYPASS_CONTROL_CONSTANT_ALL_LIGHT /end REF_CHARACTERISTIC /end GROUP
/begin GROUP ExteriorLightManager_ELM_Main_sys_ELM_Main_LightActuator_PositionLightActuator "ExteriorLightManager/ELM_Main_sys/ELM_Main/LightActuator/PositionLightActuator"
 /begin REF_MEASUREMENT BCMFL_FLPosLightStatus BCMFR_FRPosLightStatus BCMRE_RLPosLightStatus BCMRE_RRPosLightStatus /end REF_MEASUREMENT
/end GROUP
/begin GROUP ExteriorLightManager_ELM_Main_sys_ELM_Main_LightActuator_MirrorLEDActuator_BYPASS_REQUEST_ALL_LIGHT "ExteriorLightManager/ELM_Main_sys/ELM_Main/LightActuator/MirrorLEDActuator/BYPASS_REQUEST_ALL_LIGHT" /begin REF_CHARACTERISTIC BYPASS_REQUEST_ALL_LIGHT /end REF_CHARACTERISTIC /end GROUP
/begin GROUP ExteriorLightManager_ELM_Main_sys_ELM_Main_LightActuator_MirrorLEDActuator_BYPASS_CONTROL_CONSTANT_ALL_LIGHT1 "ExteriorLightManager/ELM_Main_sys/ELM_Main/LightActuator/MirrorLEDActuator/BYPASS_CONTROL_CONSTANT_ALL_LIGHT1" /begin REF_CHARACTERISTIC BYPASS_CONTROL_CONSTANT_ALL_LIGHT /end REF_CHARACTERISTIC /end GROUP
/begin GROUP ExteriorLightManager_ELM_Main_sys_ELM_Main_LightActuator_LowBeamLightActuator_BYPASS_REQUEST_ALL_LIGHT "ExteriorLightManager/ELM_Main_sys/ELM_Main/LightActuator/LowBeamLightActuator/BYPASS_REQUEST_ALL_LIGHT" /begin REF_CHARACTERISTIC BYPASS_REQUEST_ALL_LIGHT /end REF_CHARACTERISTIC /end GROUP
/begin GROUP ExteriorLightManager_ELM_Main_sys_ELM_Main_LightActuator_LowBeamLightActuator_BYPASS_CONTROL_CONSTANT_ALL_LIGHT1 "ExteriorLightManager/ELM_Main_sys/ELM_Main/LightActuator/LowBeamLightActuator/BYPASS_CONTROL_CONSTANT_ALL_LIGHT1" /begin REF_CHARACTERISTIC BYPASS_CONTROL_CONSTANT_ALL_LIGHT /end REF_CHARACTERISTIC /end GROUP
/begin GROUP ExteriorLightManager_ELM_Main_sys_ELM_Main_LightActuator_LowBeamLightActuator "ExteriorLightManager/ELM_Main_sys/ELM_Main/LightActuator/LowBeamLightActuator" /begin REF_MEASUREMENT BCMFL_FLLowBeamStatus BCMFR_FRLowBeamStatus /end REF_MEASUREMENT /end GROUP
/begin GROUP ExteriorLightManager_ELM_Main_sys_ELM_Main_LightActuator_LicensePlateLampActuator_BYPASS_REQUEST_ALL_LIGHT "ExteriorLightManager/ELM_Main_sys/ELM_Main/LightActuator/LicensePlateLampActuator/BYPASS_REQUEST_ALL_LIGHT" /begin REF_CHARACTERISTIC BYPASS_REQUEST_ALL_LIGHT /end REF_CHARACTERISTIC /end GROUP
/begin GROUP ExteriorLightManager_ELM_Main_sys_ELM_Main_LightActuator_LicensePlateLampActuator_BYPASS_CONTROL_CONSTANT_ALL_LIGHT1 "ExteriorLightManager/ELM_Main_sys/ELM_Main/LightActuator/LicensePlateLampActuator/BYPASS_CONTROL_CONSTANT_ALL_LIGHT1" /begin REF_CHARACTERISTIC BYPASS_CONTROL_CONSTANT_ALL_LIGHT /end REF_CHARACTERISTIC /end GROUP
/begin GROUP ExteriorLightManager_ELM_Main_sys_ELM_Main_LightActuator_LicensePlateLampActuator "ExteriorLightManager/ELM_Main_sys/ELM_Main/LightActuator/LicensePlateLampActuator" /begin REF_MEASUREMENT BCMRE_LicensePlateLampStatus /end REF_MEASUREMENT /end GROUP
/begin GROUP ExteriorLightManager_ELM_Main_sys_ELM_Main_LightActuator_HighBeamLightActuator_BYPASS_REQUEST_ALL_LIGHT "ExteriorLightManager/ELM_Main_sys/ELM_Main/LightActuator/HighBeamLightActuator/BYPASS_REQUEST_ALL_LIGHT" /begin REF_CHARACTERISTIC BYPASS_REQUEST_ALL_LIGHT /end REF_CHARACTERISTIC /end GROUP
/begin GROUP ExteriorLightManager_ELM_Main_sys_ELM_Main_LightActuator_HighBeamLightActuator_BYPASS_CONTROL_CONSTANT_ALL_LIGHT1 "ExteriorLightManager/ELM_Main_sys/ELM_Main/LightActuator/HighBeamLightActuator/BYPASS_CONTROL_CONSTANT_ALL_LIGHT1" /begin REF_CHARACTERISTIC BYPASS_CONTROL_CONSTANT_ALL_LIGHT /end REF_CHARACTERISTIC /end GROUP
/begin GROUP ExteriorLightManager_ELM_Main_sys_ELM_Main_LightActuator_HighBeamLightActuator "ExteriorLightManager/ELM_Main_sys/ELM_Main/LightActuator/HighBeamLightActuator" /begin REF_MEASUREMENT BCMFL_FLHighBeamStatus BCMFR_FRHighBeamStatus /end REF_MEASUREMENT /end GROUP
/begin GROUP ExteriorLightManager_ELM_Main_sys_ELM_Main_LightActuator_FogLightActuator_BYPASS_REQUEST_ALL_LIGHT "ExteriorLightManager/ELM_Main_sys/ELM_Main/LightActuator/FogLightActuator/BYPASS_REQUEST_ALL_LIGHT" /begin REF_CHARACTERISTIC BYPASS_REQUEST_ALL_LIGHT /end REF_CHARACTERISTIC /end GROUP
/begin GROUP ExteriorLightManager_ELM_Main_sys_ELM_Main_LightActuator_FogLightActuator_BYPASS_CONTROL_CONSTANT_ALL_LIGHT1 "ExteriorLightManager/ELM_Main_sys/ELM_Main/LightActuator/FogLightActuator/BYPASS_CONTROL_CONSTANT_ALL_LIGHT1" /begin REF_CHARACTERISTIC BYPASS_CONTROL_CONSTANT_ALL_LIGHT /end REF_CHARACTERISTIC /end GROUP
/begin GROUP ExteriorLightManager_ELM_Main_sys_ELM_Main_LightActuator_FogLightActuator "ExteriorLightManager/ELM_Main_sys/ELM_Main/LightActuator/FogLightActuator"
 /begin REF_MEASUREMENT BCMFR_FLFogLightStatus BCMFR_FRFogLightStatus BCMRE_RLFogLightStatus BCMRE_RRFogLightStatus /end REF_MEASUREMENT
/end GROUP
/begin GROUP ExteriorLightManager_ELM_Main_sys_ELM_Main_LightActuator_DaytimeRunningLightActuator_BYPASS_REQUEST_ALL_LIGHT "ExteriorLightManager/ELM_Main_sys/ELM_Main/LightActuator/DaytimeRunningLightActuator/BYPASS_REQUEST_ALL_LIGHT" /begin REF_CHARACTERISTIC BYPASS_REQUEST_ALL_LIGHT /end REF_CHARACTERISTIC /end GROUP
/begin GROUP ExteriorLightManager_ELM_Main_sys_ELM_Main_LightActuator_DaytimeRunningLightActuator_BYPASS_CONTROL_CONSTANT_ALL_LIGHT1 "ExteriorLightManager/ELM_Main_sys/ELM_Main/LightActuator/DaytimeRunningLightActuator/BYPASS_CONTROL_CONSTANT_ALL_LIGHT1" /begin REF_CHARACTERISTIC BYPASS_CONTROL_CONSTANT_ALL_LIGHT /end REF_CHARACTERISTIC /end GROUP
/begin GROUP ExteriorLightManager_ELM_Main_sys_ELM_Main_LightActuator_BrakeLightActuator_BYPASS_REQUEST_ALL_LIGHT "ExteriorLightManager/ELM_Main_sys/ELM_Main/LightActuator/BrakeLightActuator/BYPASS_REQUEST_ALL_LIGHT" /begin REF_CHARACTERISTIC BYPASS_REQUEST_ALL_LIGHT /end REF_CHARACTERISTIC /end GROUP
/begin GROUP ExteriorLightManager_ELM_Main_sys_ELM_Main_LightActuator_BrakeLightActuator_BYPASS_CONTROL_CONSTANT_ALL_LIGHT1 "ExteriorLightManager/ELM_Main_sys/ELM_Main/LightActuator/BrakeLightActuator/BYPASS_CONTROL_CONSTANT_ALL_LIGHT1" /begin REF_CHARACTERISTIC BYPASS_CONTROL_CONSTANT_ALL_LIGHT /end REF_CHARACTERISTIC /end GROUP
/begin GROUP ExteriorLightManager_ELM_Main_sys_ELM_Main_LightActuator_BrakeLightActuator "ExteriorLightManager/ELM_Main_sys/ELM_Main/LightActuator/BrakeLightActuator"
 /begin REF_MEASUREMENT BCMRE_CMBrakeLightStatus BCMRE_LeftBrakeLightStatus BCMRE_RightBrakeLightStatus /end REF_MEASUREMENT
/end GROUP
/begin GROUP ExteriorLightManager_ELM_Main_sys_ELM_Main_IntelligentExteriorLightingControl_AutoHighBeam "ExteriorLightManager/ELM_Main_sys/ELM_Main/IntelligentExteriorLightingControl/AutoHighBeam" /begin REF_MEASUREMENT BCMFL_FLHighBeamStatus BCMFR_FRHighBeamStatus /end REF_MEASUREMENT /end GROUP
/begin GROUP ExteriorLightManager "ExteriorLightManager" ROOT
 /begin REF_MEASUREMENT BCMFL_FLHighBeamStatus BCMFL_FLLowBeamStatus BCMFL_FLPosLightStatus BCMFL_FLTurnLightStatus BCMFL_FRTurnLightStatus BCMFL_LeftReverseLampStatus BCMFR_FLFogLightStatus BCMFR_FRFogLightStatus BCMFR_FRHighBeamStatus BCMFR_FRLowBeamStatus BCMFR_FRPosLightStatus BCMFR_RightReverseLampStatus BCMRE_CMBrakeLightStatus BCMRE_LeftBrakeLightStatus BCMRE_LicensePlateLampStatus BCMRE_RLFogLightStatus BCMRE_RLPosLightStatus BCMRE_RLTurnLightStatus BCMRE_RRFogLightStatus BCMRE_RRPosLightStatus BCMRE_RRTurnLightStatus BCMRE_RightBrakeLightStatus /end REF_MEASUREMENT
/end GROUP
/begin MEASUREMENT WWM_WiperServiceModeSet "" UBYTE CM_uint8 0 0 0 255 ECU_ADDRESS 0x3434C9D8 /* @ECU_Address@WWM_WiperServiceModeSet@ */ /end MEASUREMENT
/begin MEASUREMENT WWM_RearWiperSet "" UBYTE CM_uint8 0 0 0 255 ECU_ADDRESS 0x3434C9D9 /* @ECU_Address@WWM_RearWiperSet@ */ /end MEASUREMENT
/begin MEASUREMENT WWM_RearWiperAutoMode "" UBYTE CM_uint8 0 0 0 255 ECU_ADDRESS 0x3434C9DA /* @ECU_Address@WWM_RearWiperAutoMode@ */ /end MEASUREMENT
/begin MEASUREMENT WWM_RearWasherFluidSpayReq "" UBYTE CM_uint8 0 0 0 255 ECU_ADDRESS 0x3434C9DB /* @ECU_Address@WWM_RearWasherFluidSpayReq@ */ /end MEASUREMENT
/begin MEASUREMENT WWM_RLSSensitivityLevelSet "" UBYTE CM_uint8 0 0 0 255 ECU_ADDRESS 0x3434C9DC /* @ECU_Address@WWM_RLSSensitivityLevelSet@ */ /end MEASUREMENT
/begin MEASUREMENT WWM_Nv_RearWiperAutoModeSet "" UBYTE CM_uint8 0 0 0 255 ECU_ADDRESS 0x3434CC3F /* @ECU_Address@WWM_Nv_RearWiperAutoModeSet@ */ /end MEASUREMENT
/begin MEASUREMENT WWM_FrontWiperStepTimeSet "" UBYTE CM_uint8 0 0 0 255 ECU_ADDRESS 0x3434C9DD /* @ECU_Address@WWM_FrontWiperStepTimeSet@ */ /end MEASUREMENT
/begin MEASUREMENT WWM_FrontWiperSpeedSet "" UBYTE CM_uint8 0 0 0 255 ECU_ADDRESS 0x3434C9DE /* @ECU_Address@WWM_FrontWiperSpeedSet@ */ /end MEASUREMENT
/begin MEASUREMENT WWM_FrontWasherFluidSpayReq "" UBYTE CM_uint8 0 0 0 255 ECU_ADDRESS 0x3434C9DF /* @ECU_Address@WWM_FrontWasherFluidSpayReq@ */ /end MEASUREMENT
/begin MEASUREMENT WWM_AutoOrIntervalModeSts "" UBYTE CM_uint8 0 0 0 255 ECU_ADDRESS 0x3434CC3E /* @ECU_Address@WWM_AutoOrIntervalModeSts@ */ /end MEASUREMENT
/begin MEASUREMENT WWM_AutoModeLEDSts "" UBYTE CM_uint8 0 0 0 255 ECU_ADDRESS 0x3434CC3D /* @ECU_Address@WWM_AutoModeLEDSts@ */ /end MEASUREMENT
/begin MEASUREMENT S2S_WiperServiceModeSet "" UBYTE CM_uint8 0 0 0 255 ECU_ADDRESS 0x3434C7B3 /* @ECU_Address@S2S_WiperServiceModeSet@ */ /end MEASUREMENT
/begin MEASUREMENT S2S_RearWiperAutoModeSet "" UBYTE CM_uint8 0 0 0 255 ECU_ADDRESS 0x3434C7B4 /* @ECU_Address@S2S_RearWiperAutoModeSet@ */ /end MEASUREMENT
/begin MEASUREMENT Nv_RearWiperAutoModeSet "" UBYTE CM_uint8 0 0 0 255 ECU_ADDRESS 0x3434CB3C /* @ECU_Address@Nv_RearWiperAutoModeSet@ */ /end MEASUREMENT
/begin MEASUREMENT COM_WiperServiceModeSts "" UBYTE CM_uint8 0 0 0 255 ECU_ADDRESS 0x3434CA39 /* @ECU_Address@COM_WiperServiceModeSts@ */ /end MEASUREMENT
/begin MEASUREMENT COM_WasherPumpSts "" UBYTE CM_uint8 0 0 0 255 ECU_ADDRESS 0x3434CA3A /* @ECU_Address@COM_WasherPumpSts@ */ /end MEASUREMENT
/begin MEASUREMENT COM_ThumbWheelSts "" UBYTE CM_uint8 0 0 0 255 ECU_ADDRESS 0x3434CB3D /* @ECU_Address@COM_ThumbWheelSts@ */ /end MEASUREMENT
/begin MEASUREMENT COM_RightStalkSwitchSts "" UBYTE CM_uint8 0 0 0 255 ECU_ADDRESS 0x3434CB3E /* @ECU_Address@COM_RightStalkSwitchSts@ */ /end MEASUREMENT
/begin MEASUREMENT COM_RearWiperWorkingSts "" UBYTE CM_uint8 0 0 0 255 ECU_ADDRESS 0x3434CA3B /* @ECU_Address@COM_RearWiperWorkingSts@ */ /end MEASUREMENT
/begin MEASUREMENT COM_RearWiperParkPosSts "" UBYTE CM_uint8 0 0 0 255 ECU_ADDRESS 0x3434CA3C /* @ECU_Address@COM_RearWiperParkPosSts@ */ /end MEASUREMENT
/begin MEASUREMENT COM_RLSWiperSpeedReq "" UBYTE CM_uint8 0 0 0 255 ECU_ADDRESS 0x3434CA3D /* @ECU_Address@COM_RLSWiperSpeedReq@ */ /end MEASUREMENT
/begin MEASUREMENT COM_FrontWiperSts "" UBYTE CM_uint8 0 0 0 255 ECU_ADDRESS 0x3434CA0D /* @ECU_Address@COM_FrontWiperSts@ */ /end MEASUREMENT
/begin MEASUREMENT COM_FrontWiperStepTimeSts "" UBYTE CM_uint8 0 0 0 255 ECU_ADDRESS 0x3434CA3F /* @ECU_Address@COM_FrontWiperStepTimeSts@ */ /end MEASUREMENT
/begin MEASUREMENT COM_FrontWiperParkPosSts "" UBYTE CM_uint8 0 0 0 255 ECU_ADDRESS 0x3434CA40 /* @ECU_Address@COM_FrontWiperParkPosSts@ */ /end MEASUREMENT
/begin MEASUREMENT WCM_WindowsControlGlobal "" UBYTE CM_uint8 0 0 0 255 ECU_ADDRESS 0x3434CC3C /* @ECU_Address@WCM_WindowsControlGlobal@ */ /end MEASUREMENT
/begin MEASUREMENT WCM_WindowControlFR "" UBYTE CM_uint8 0 0 0 255 ECU_ADDRESS 0x3434CC39 /* @ECU_Address@WCM_WindowControlFR@ */ /end MEASUREMENT
/begin MEASUREMENT WCM_WindowControlFL "" UBYTE CM_uint8 0 0 0 255 ECU_ADDRESS 0x3434CC38 /* @ECU_Address@WCM_WindowControlFL@ */ /end MEASUREMENT
/begin MEASUREMENT S2S_WindowVoiceControlRR "" UBYTE CM_uint8 0 0 0 255 ECU_ADDRESS 0x3434C7B9 /* @ECU_Address@S2S_WindowVoiceControlRR@ */ /end MEASUREMENT
/begin MEASUREMENT S2S_WindowVoiceControlRL "" UBYTE CM_uint8 0 0 0 255 ECU_ADDRESS 0x3434C7B8 /* @ECU_Address@S2S_WindowVoiceControlRL@ */ /end MEASUREMENT
/begin MEASUREMENT S2S_WindowVoiceControlFR "" UBYTE CM_uint8 0 0 0 255 ECU_ADDRESS 0x3434C7B7 /* @ECU_Address@S2S_WindowVoiceControlFR@ */ /end MEASUREMENT
/begin MEASUREMENT S2S_WindowVoiceControlFL "" UBYTE CM_uint8 0 0 0 255 ECU_ADDRESS 0x3434C7B6 /* @ECU_Address@S2S_WindowVoiceControlFL@ */ /end MEASUREMENT
/begin MEASUREMENT S2S_WindowCAppControlRR "" UBYTE CM_uint8 0 0 0 255 ECU_ADDRESS 0x3434C7BD /* @ECU_Address@S2S_WindowCAppControlRR@ */ /end MEASUREMENT
/begin MEASUREMENT S2S_WindowCAppControlRL "" UBYTE CM_uint8 0 0 0 255 ECU_ADDRESS 0x3434C7BC /* @ECU_Address@S2S_WindowCAppControlRL@ */ /end MEASUREMENT
/begin MEASUREMENT S2S_WindowCAppControlFR "" UBYTE CM_uint8 0 0 0 255 ECU_ADDRESS 0x3434C7BB /* @ECU_Address@S2S_WindowCAppControlFR@ */ /end MEASUREMENT
/begin MEASUREMENT S2S_WindowCAppControlFL "" UBYTE CM_uint8 0 0 0 255 ECU_ADDRESS 0x3434C7BA /* @ECU_Address@S2S_WindowCAppControlFL@ */ /end MEASUREMENT
/begin MEASUREMENT S2S_WashModeSet "" UBYTE CM_uint8 0 0 0 255 ECU_ADDRESS 0x3434C7B5 /* @ECU_Address@S2S_WashModeSet@ */ /end MEASUREMENT
/begin MEASUREMENT P_WCM_WindowControlRR "" UBYTE CM_uint8 0 0 0 255 ECU_ADDRESS 0x3434CC3B /* @ECU_Address@P_WCM_WindowControlRR@ */ /end MEASUREMENT
/begin MEASUREMENT P_WCM_WindowControlRL "" UBYTE CM_uint8 0 0 0 255 ECU_ADDRESS 0x3434CC3A /* @ECU_Address@P_WCM_WindowControlRL@ */ /end MEASUREMENT
/begin MEASUREMENT COM_WindowsRRAntiPinchWarn "" UBYTE CM_uint8 0 0 0 255 ECU_ADDRESS 0x3434CA41 /* @ECU_Address@COM_WindowsRRAntiPinchWarn@ */ /end MEASUREMENT
/begin MEASUREMENT COM_WindowsRLAntiPinchWarn "" UBYTE CM_uint8 0 0 0 255 ECU_ADDRESS 0x3434CA42 /* @ECU_Address@COM_WindowsRLAntiPinchWarn@ */ /end MEASUREMENT
/begin MEASUREMENT COM_WindowsFRAntiPinchWarn "" UBYTE CM_uint8 0 0 0 255 ECU_ADDRESS 0x3434CA43 /* @ECU_Address@COM_WindowsFRAntiPinchWarn@ */ /end MEASUREMENT
/begin MEASUREMENT COM_WindowsFLAntiPinchWarn "" UBYTE CM_uint8 0 0 0 255 ECU_ADDRESS 0x3434CA44 /* @ECU_Address@COM_WindowsFLAntiPinchWarn@ */ /end MEASUREMENT
/begin MEASUREMENT COM_WindowRRThermalProtect "" UBYTE CM_uint8 0 0 0 255 ECU_ADDRESS 0x3434CA45 /* @ECU_Address@COM_WindowRRThermalProtect@ */ /end MEASUREMENT
/begin MEASUREMENT COM_WindowRRSuppressionWarn "" UBYTE CM_uint8 0 0 0 255 ECU_ADDRESS 0x3434C9C0 /* @ECU_Address@COM_WindowRRSuppressionWarn@ */ /end MEASUREMENT
/begin MEASUREMENT COM_WindowRRLockActive "" UBYTE CM_uint8 0 0 0 255 ECU_ADDRESS 0x3434CA47 /* @ECU_Address@COM_WindowRRLockActive@ */ /end MEASUREMENT
/begin MEASUREMENT COM_WindowRRLearningSts "" UBYTE CM_uint8 0 0 0 255 ECU_ADDRESS 0x3434C9C1 /* @ECU_Address@COM_WindowRRLearningSts@ */ /end MEASUREMENT
/begin MEASUREMENT COM_WindowRLThermalProtect "" UBYTE CM_uint8 0 0 0 255 ECU_ADDRESS 0x3434CA49 /* @ECU_Address@COM_WindowRLThermalProtect@ */ /end MEASUREMENT
/begin MEASUREMENT COM_WindowRLSuppressionWarn "" UBYTE CM_uint8 0 0 0 255 ECU_ADDRESS 0x3434CA4A /* @ECU_Address@COM_WindowRLSuppressionWarn@ */ /end MEASUREMENT
/begin MEASUREMENT COM_WindowRLLockActive "" UBYTE CM_uint8 0 0 0 255 ECU_ADDRESS 0x3434CA4B /* @ECU_Address@COM_WindowRLLockActive@ */ /end MEASUREMENT
/begin MEASUREMENT COM_WindowRLLearningSts "" UBYTE CM_uint8 0 0 0 255 ECU_ADDRESS 0x3434CA4C /* @ECU_Address@COM_WindowRLLearningSts@ */ /end MEASUREMENT
/begin MEASUREMENT COM_WindowPositionRR "" UBYTE CM_uint8 0 0 0 255 ECU_ADDRESS 0x3434CA4D /* @ECU_Address@COM_WindowPositionRR@ */ /end MEASUREMENT
/begin MEASUREMENT COM_WindowPositionRL "" UBYTE CM_uint8 0 0 0 255 ECU_ADDRESS 0x3434CA4E /* @ECU_Address@COM_WindowPositionRL@ */ /end MEASUREMENT
/begin MEASUREMENT COM_WindowPositionFR "" UBYTE CM_uint8 0 0 0 255 ECU_ADDRESS 0x3434CA4F /* @ECU_Address@COM_WindowPositionFR@ */ /end MEASUREMENT
/begin MEASUREMENT COM_WindowPositionFL "" UBYTE CM_uint8 0 0 0 255 ECU_ADDRESS 0x3434CA50 /* @ECU_Address@COM_WindowPositionFL@ */ /end MEASUREMENT
/begin MEASUREMENT COM_WindowLockDSBBtnPress "" UBYTE CM_uint8 0 0 0 255 ECU_ADDRESS 0x3434CA51 /* @ECU_Address@COM_WindowLockDSBBtnPress@ */ /end MEASUREMENT
/begin MEASUREMENT COM_WindowFRThermalProtect "" UBYTE CM_uint8 0 0 0 255 ECU_ADDRESS 0x3434CA52 /* @ECU_Address@COM_WindowFRThermalProtect@ */ /end MEASUREMENT
/begin MEASUREMENT COM_WindowFRSuppressionWarn "" UBYTE CM_uint8 0 0 0 255 ECU_ADDRESS 0x3434CA53 /* @ECU_Address@COM_WindowFRSuppressionWarn@ */ /end MEASUREMENT
/begin MEASUREMENT COM_WindowFRLockActive "" UBYTE CM_uint8 0 0 0 255 ECU_ADDRESS 0x3434CA54 /* @ECU_Address@COM_WindowFRLockActive@ */ /end MEASUREMENT
/begin MEASUREMENT COM_WindowFRLearningSts "" UBYTE CM_uint8 0 0 0 255 ECU_ADDRESS 0x3434CA55 /* @ECU_Address@COM_WindowFRLearningSts@ */ /end MEASUREMENT
/begin MEASUREMENT COM_WindowFLThermalProtect "" UBYTE CM_uint8 0 0 0 255 ECU_ADDRESS 0x3434CA56 /* @ECU_Address@COM_WindowFLThermalProtect@ */ /end MEASUREMENT
/begin MEASUREMENT COM_WindowFLSuppressionWarn "" UBYTE CM_uint8 0 0 0 255 ECU_ADDRESS 0x3434CA57 /* @ECU_Address@COM_WindowFLSuppressionWarn@ */ /end MEASUREMENT
/begin MEASUREMENT COM_WindowFLLockActive "" UBYTE CM_uint8 0 0 0 255 ECU_ADDRESS 0x3434CA58 /* @ECU_Address@COM_WindowFLLockActive@ */ /end MEASUREMENT
/begin MEASUREMENT COM_WindowFLLearningSts "" UBYTE CM_uint8 0 0 0 255 ECU_ADDRESS 0x3434CA59 /* @ECU_Address@COM_WindowFLLearningSts@ */ /end MEASUREMENT
/begin MEASUREMENT COM_WindowDSBBtnPressRR "" UBYTE CM_uint8 0 0 0 255 ECU_ADDRESS 0x3434C7C7 /* @ECU_Address@COM_WindowDSBBtnPressRR@ */ /end MEASUREMENT
/begin MEASUREMENT COM_WindowDSBBtnPressRL "" UBYTE CM_uint8 0 0 0 255 ECU_ADDRESS 0x3434C7C6 /* @ECU_Address@COM_WindowDSBBtnPressRL@ */ /end MEASUREMENT
/begin MEASUREMENT COM_WindowDSBBtnPressFR "" UBYTE CM_uint8 0 0 0 255 ECU_ADDRESS 0x3434C7C5 /* @ECU_Address@COM_WindowDSBBtnPressFR@ */ /end MEASUREMENT
/begin MEASUREMENT COM_WindowDSBBtnPressFL "" UBYTE CM_uint8 0 0 0 255 ECU_ADDRESS 0x3434C7C4 /* @ECU_Address@COM_WindowDSBBtnPressFL@ */ /end MEASUREMENT
/begin MEASUREMENT COM_WindowBtnPressRR "" UBYTE CM_uint8 0 0 0 255 ECU_ADDRESS 0x3434CA5A /* @ECU_Address@COM_WindowBtnPressRR@ */ /end MEASUREMENT
/begin MEASUREMENT COM_WindowBtnPressRL "" UBYTE CM_uint8 0 0 0 255 ECU_ADDRESS 0x3434CA5B /* @ECU_Address@COM_WindowBtnPressRL@ */ /end MEASUREMENT
/begin MEASUREMENT COM_WindowBtnPressFR "" UBYTE CM_uint8 0 0 0 255 ECU_ADDRESS 0x3434CA5C /* @ECU_Address@COM_WindowBtnPressFR@ */ /end MEASUREMENT
/begin MEASUREMENT VSM_DigitSpeed "" UWORD CM_uint16 0 0 0 65535 ECU_ADDRESS 0x3434CA26 /* @ECU_Address@VSM_DigitSpeed@ */ /end MEASUREMENT
/begin MEASUREMENT MHU_STAT_MileageUnit "" UBYTE CM_uint8 0 0 0 255 ECU_ADDRESS 0x3434CA5D /* @ECU_Address@MHU_STAT_MileageUnit@ */ /end MEASUREMENT
/begin MEASUREMENT BSW_VehicleSpdE2ESts "" UBYTE CM_uint8 0 0 0 255 ECU_ADDRESS 0x3434CB3F /* @ECU_Address@BSW_VehicleSpdE2ESts@ */ /end MEASUREMENT
/begin MEASUREMENT VCU_VehChgSts "" UBYTE CM_uint8 0 0 0 255 ECU_ADDRESS 0x3434CA6E /* @ECU_Address@VCU_VehChgSts@ */ /end MEASUREMENT
/begin MEASUREMENT TCM_OnLowSocSaveModeTimer "" UBYTE CM_uint8 0 0 0 255 ECU_ADDRESS 0x3434C9E1 /* @ECU_Address@TCM_OnLowSocSaveModeTimer@ */ /end MEASUREMENT
/begin MEASUREMENT TCM_OnIdleTimer "" UWORD CM_uint16 0 0 0 65535 ECU_ADDRESS 0x3434CAB8 /* @ECU_Address@TCM_OnIdleTimer@ */ /end MEASUREMENT
/begin MEASUREMENT TCM_FullScreenChgDisplayTimer "" UWORD CM_uint16 0 0 0 65535 ECU_ADDRESS 0x3434CBE6 /* @ECU_Address@TCM_FullScreenChgDisplayTimer@ */ /end MEASUREMENT
/begin MEASUREMENT TCM_Cluster2Request "" UBYTE CM_uint8 0 0 0 255 ECU_ADDRESS 0x3434CBE4 /* @ECU_Address@TCM_Cluster2Request@ */ /end MEASUREMENT
/begin MEASUREMENT TCM_Cluster0Request "" UBYTE CM_uint8 0 0 0 255 ECU_ADDRESS 0x3434CBE3 /* @ECU_Address@TCM_Cluster0Request@ */ /end MEASUREMENT
/begin MEASUREMENT TCM_ClampRRequest "" UBYTE CM_uint8 0 0 0 255 ECU_ADDRESS 0x3434CBE2 /* @ECU_Address@TCM_ClampRRequest@ */ /end MEASUREMENT
/begin MEASUREMENT TCM_ClampIncompatibleWarnFlag "" UBYTE CM_uint8 0 0 0 255 ECU_ADDRESS 0x3434CBE1 /* @ECU_Address@TCM_ClampIncompatibleWarnFlag@ */ /end MEASUREMENT
/begin MEASUREMENT TCM_Clamp30sRequest "" UBYTE CM_uint8 0 0 0 255 ECU_ADDRESS 0x3434CBE0 /* @ECU_Address@TCM_Clamp30sRequest@ */ /end MEASUREMENT
/begin MEASUREMENT TCM_Clamp30cRequest "" UBYTE CM_uint8 0 0 0 255 ECU_ADDRESS 0x3434CBDF /* @ECU_Address@TCM_Clamp30cRequest@ */ /end MEASUREMENT
/begin MEASUREMENT TCM_Clamp15Request "" UBYTE CM_uint8 0 0 0 255 ECU_ADDRESS 0x3434CBDE /* @ECU_Address@TCM_Clamp15Request@ */ /end MEASUREMENT
/begin MEASUREMENT TCM_AccLowSocSaveModeTimer "" UBYTE CM_uint8 0 0 0 255 ECU_ADDRESS 0x3434C9E2 /* @ECU_Address@TCM_AccLowSocSaveModeTimer@ */ /end MEASUREMENT
/begin MEASUREMENT TCM_AccIdleTimer "" UBYTE CM_uint8 0 0 0 255 ECU_ADDRESS 0x3434C9E3 /* @ECU_Address@TCM_AccIdleTimer@ */ /end MEASUREMENT
/begin MEASUREMENT IMMO_IMMOSts "" UBYTE CM_uint8 0 0 0 255 ECU_ADDRESS 0x3434CB45 /* @ECU_Address@IMMO_IMMOSts@ */ /end MEASUREMENT
/begin MEASUREMENT FCAM_RemoteDrivingRequest "" UBYTE CM_uint8 0 0 0 255 ECU_ADDRESS 0x3434C7AD /* @ECU_Address@FCAM_RemoteDrivingRequest@ */ /end MEASUREMENT
/begin MEASUREMENT CVC_TransportModeSts "" UBYTE CM_uint8 0 0 0 255 ECU_ADDRESS 0x3434C7AF /* @ECU_Address@CVC_TransportModeSts@ */ /end MEASUREMENT
/begin MEASUREMENT CVC_SocDisplay "" FLOAT32_IEEE CM_single 0 0 -3.4E+38 3.4E+38 ECU_ADDRESS 0x3434CAC8 /* @ECU_Address@CVC_SocDisplay@ */ /end MEASUREMENT
/begin MEASUREMENT CVC_RemoteParkingRequest "" UBYTE CM_uint8 0 0 0 255 ECU_ADDRESS 0x3434C7B1 /* @ECU_Address@CVC_RemoteParkingRequest@ */ /end MEASUREMENT
/begin MEASUREMENT CVC_OtaRequest "" UBYTE CM_uint8 0 0 0 255 ECU_ADDRESS 0x3434CA2B /* @ECU_Address@CVC_OtaRequest@ */ /end MEASUREMENT
/begin MEASUREMENT CVC_AccessoryModeRequest "" UBYTE CM_uint8 0 0 0 255 ECU_ADDRESS 0x3434C7AE /* @ECU_Address@CVC_AccessoryModeRequest@ */ /end MEASUREMENT
/begin MEASUREMENT BMS_HVOnOffSts "" UBYTE CM_uint8 0 0 0 255 ECU_ADDRESS 0x3434CA70 /* @ECU_Address@BMS_HVOnOffSts@ */ /end MEASUREMENT
/begin MEASUREMENT BCMRE_TailgatePassiveEntryReq "" UBYTE CM_uint8 0 0 0 255 ECU_ADDRESS 0x3434CA71 /* @ECU_Address@BCMRE_TailgatePassiveEntryReq@ */ /end MEASUREMENT
/begin MEASUREMENT BCMRE_FootKickOperationRequest "" UBYTE CM_uint8 0 0 0 255 ECU_ADDRESS 0x3434CA72 /* @ECU_Address@BCMRE_FootKickOperationRequest@ */ /end MEASUREMENT
/begin MEASUREMENT BCMRE_ClampRRE "" UBYTE CM_uint8 0 0 0 255 ECU_ADDRESS 0x3434CB46 /* @ECU_Address@BCMRE_ClampRRE@ */ /end MEASUREMENT
/begin MEASUREMENT BCMRE_Clamp30sRE "" UBYTE CM_uint8 0 0 0 255 ECU_ADDRESS 0x3434CB47 /* @ECU_Address@BCMRE_Clamp30sRE@ */ /end MEASUREMENT
/begin MEASUREMENT BCMRE_Clamp30cRE "" UBYTE CM_uint8 0 0 0 255 ECU_ADDRESS 0x3434CB48 /* @ECU_Address@BCMRE_Clamp30cRE@ */ /end MEASUREMENT
/begin MEASUREMENT BCMRE_Clamp15RE "" UBYTE CM_uint8 0 0 0 255 ECU_ADDRESS 0x3434CB49 /* @ECU_Address@BCMRE_Clamp15RE@ */ /end MEASUREMENT
/begin MEASUREMENT BCMRE_AlcoholockSwitch "" UBYTE CM_uint8 0 0 0 255 ECU_ADDRESS 0x3434CA73 /* @ECU_Address@BCMRE_AlcoholockSwitch@ */ /end MEASUREMENT
/begin MEASUREMENT BCMFR_ClampRFR "" UBYTE CM_uint8 0 0 0 255 ECU_ADDRESS 0x3434CB4A /* @ECU_Address@BCMFR_ClampRFR@ */ /end MEASUREMENT
/begin MEASUREMENT BCMFR_Clamp30sFR "" UBYTE CM_uint8 0 0 0 255 ECU_ADDRESS 0x3434CB4B /* @ECU_Address@BCMFR_Clamp30sFR@ */ /end MEASUREMENT
/begin MEASUREMENT BCMFR_Clamp30cFR "" UBYTE CM_uint8 0 0 0 255 ECU_ADDRESS 0x3434CB4C /* @ECU_Address@BCMFR_Clamp30cFR@ */ /end MEASUREMENT
/begin MEASUREMENT BCMFR_Clamp15FR "" UBYTE CM_uint8 0 0 0 255 ECU_ADDRESS 0x3434CB4D /* @ECU_Address@BCMFR_Clamp15FR@ */ /end MEASUREMENT
/begin MEASUREMENT BCMFL_ClampRFL "" UBYTE CM_uint8 0 0 0 255 ECU_ADDRESS 0x3434CB4E /* @ECU_Address@BCMFL_ClampRFL@ */ /end MEASUREMENT
/begin MEASUREMENT BCMFL_Clamp30sFL "" UBYTE CM_uint8 0 0 0 255 ECU_ADDRESS 0x3434CB4F /* @ECU_Address@BCMFL_Clamp30sFL@ */ /end MEASUREMENT
/begin MEASUREMENT BCMFL_Clamp30cFL "" UBYTE CM_uint8 0 0 0 255 ECU_ADDRESS 0x3434CB50 /* @ECU_Address@BCMFL_Clamp30cFL@ */ /end MEASUREMENT
/begin MEASUREMENT BCMFL_Clamp15FL "" UBYTE CM_uint8 0 0 0 255 ECU_ADDRESS 0x3434CB51 /* @ECU_Address@BCMFL_Clamp15FL@ */ /end MEASUREMENT
/begin MEASUREMENT ATA_AntiTheftStatus "" UBYTE CM_uint8 0 0 0 255 ECU_ADDRESS 0x3434CB52 /* @ECU_Address@ATA_AntiTheftStatus@ */ /end MEASUREMENT
/begin MEASUREMENT ACM_SeatOccupancyPassenger "" UBYTE CM_uint8 0 0 0 255 ECU_ADDRESS 0x3434CA2D /* @ECU_Address@ACM_SeatOccupancyPassenger@ */ /end MEASUREMENT
/begin MEASUREMENT ACM_SeatOccupancy2ndRowPas "" UBYTE CM_uint8 0 0 0 255 ECU_ADDRESS 0x3434CA2E /* @ECU_Address@ACM_SeatOccupancy2ndRowPas@ */ /end MEASUREMENT
/begin MEASUREMENT ACM_SeatOccupancy2ndRowMid "" UBYTE CM_uint8 0 0 0 255 ECU_ADDRESS 0x3434CA2F /* @ECU_Address@ACM_SeatOccupancy2ndRowMid@ */ /end MEASUREMENT
/begin MEASUREMENT ACM_SeatOccupancy2ndRowDri "" UBYTE CM_uint8 0 0 0 255 ECU_ADDRESS 0x3434CA30 /* @ECU_Address@ACM_SeatOccupancy2ndRowDri@ */ /end MEASUREMENT
/begin MEASUREMENT SMAM_TiltSettingValidFlag "" UBYTE CM_uint8 0 0 0 255 ECU_ADDRESS 0x3434CBDD /* @ECU_Address@SMAM_TiltSettingValidFlag@ */ /end MEASUREMENT
/begin MEASUREMENT SMAM_SetRearHeatWindow "" UBYTE CM_uint8 0 0 0 255 ECU_ADDRESS 0x3434CBDC /* @ECU_Address@SMAM_SetRearHeatWindow@ */ /end MEASUREMENT
/begin MEASUREMENT SMAM_SetMirrorFoldRight "" UBYTE CM_uint8 0 0 0 255 ECU_ADDRESS 0x3434CBDB /* @ECU_Address@SMAM_SetMirrorFoldRight@ */ /end MEASUREMENT
/begin MEASUREMENT SMAM_SetMirrorFoldLeft "" UBYTE CM_uint8 0 0 0 255 ECU_ADDRESS 0x3434CBDA /* @ECU_Address@SMAM_SetMirrorFoldLeft@ */ /end MEASUREMENT
/begin MEASUREMENT SMAM_RHMirrorAdjustmentSet "" UBYTE CM_uint8 0 0 0 255 ECU_ADDRESS 0x3434CBD9 /* @ECU_Address@SMAM_RHMirrorAdjustmentSet@ */ /end MEASUREMENT
/begin MEASUREMENT SMAM_RHMirrorAdjustmentReq "" UBYTE CM_uint8 0 0 0 255 ECU_ADDRESS 0x3434CBD8 /* @ECU_Address@SMAM_RHMirrorAdjustmentReq@ */ /end MEASUREMENT
/begin MEASUREMENT SMAM_LHMirrorAdjustmentSet "" UBYTE CM_uint8 0 0 0 255 ECU_ADDRESS 0x3434CBB3 /* @ECU_Address@SMAM_LHMirrorAdjustmentSet@ */ /end MEASUREMENT
/begin MEASUREMENT SMAM_LHMirrorAdjustmentReq "" UBYTE CM_uint8 0 0 0 255 ECU_ADDRESS 0x3434CBB2 /* @ECU_Address@SMAM_LHMirrorAdjustmentReq@ */ /end MEASUREMENT
/begin MEASUREMENT SMAM_FoldSettingValidFlag "" UBYTE CM_uint8 0 0 0 255 ECU_ADDRESS 0x3434CBB1 /* @ECU_Address@SMAM_FoldSettingValidFlag@ */ /end MEASUREMENT
/begin MEASUREMENT S2S_SetMirrorAutoUnfold "" UBYTE CM_uint8 0 0 0 255 ECU_ADDRESS 0x3434CB53 /* @ECU_Address@S2S_SetMirrorAutoUnfold@ */ /end MEASUREMENT
/begin MEASUREMENT S2S_RightMirrorFoldRequest "" UBYTE CM_uint8 0 0 0 255 ECU_ADDRESS 0x3434CB54 /* @ECU_Address@S2S_RightMirrorFoldRequest@ */ /end MEASUREMENT
/begin MEASUREMENT S2S_RearHeatedWindowSet "" UBYTE CM_uint8 0 0 0 255 ECU_ADDRESS 0x3434CB55 /* @ECU_Address@S2S_RearHeatedWindowSet@ */ /end MEASUREMENT
/begin MEASUREMENT S2S_MirrorAdjustRightSetOn "" UBYTE CM_uint8 0 0 0 255 ECU_ADDRESS 0x3434CB56 /* @ECU_Address@S2S_MirrorAdjustRightSetOn@ */ /end MEASUREMENT
/begin MEASUREMENT S2S_MirrorAdjustRightSetOff "" UBYTE CM_uint8 0 0 0 255 ECU_ADDRESS 0x3434CB57 /* @ECU_Address@S2S_MirrorAdjustRightSetOff@ */ /end MEASUREMENT
/begin MEASUREMENT S2S_MirrorAdjustLeftSetOn "" UBYTE CM_uint8 0 0 0 255 ECU_ADDRESS 0x3434CB58 /* @ECU_Address@S2S_MirrorAdjustLeftSetOn@ */ /end MEASUREMENT
/begin MEASUREMENT S2S_MirrorAdjustLeftSetOff "" UBYTE CM_uint8 0 0 0 255 ECU_ADDRESS 0x3434CB59 /* @ECU_Address@S2S_MirrorAdjustLeftSetOff@ */ /end MEASUREMENT
/begin MEASUREMENT S2S_LeftMirrorFoldRequest "" UBYTE CM_uint8 0 0 0 255 ECU_ADDRESS 0x3434CB5A /* @ECU_Address@S2S_LeftMirrorFoldRequest@ */ /end MEASUREMENT
/begin MEASUREMENT S2S_Autotilt "" UBYTE CM_uint8 0 0 0 255 ECU_ADDRESS 0x3434CB5B /* @ECU_Address@S2S_Autotilt@ */ /end MEASUREMENT
/begin MEASUREMENT MHU_UserProfileId "" UBYTE CM_uint8 0 0 0 255 ECU_ADDRESS 0x3434CA74 /* @ECU_Address@MHU_UserProfileId@ */ /end MEASUREMENT
/begin MEASUREMENT MHU_SetRearDefrost "" UBYTE CM_uint8 0 0 0 255 ECU_ADDRESS 0x3434C7C2 /* @ECU_Address@MHU_SetRearDefrost@ */ /end MEASUREMENT
/begin MEASUREMENT MFS_UpControl "" UBYTE CM_uint8 0 0 0 255 ECU_ADDRESS 0x3434C7C1 /* @ECU_Address@MFS_UpControl@ */ /end MEASUREMENT
/begin MEASUREMENT MFS_RightControl "" UBYTE CM_uint8 0 0 0 255 ECU_ADDRESS 0x3434C7C0 /* @ECU_Address@MFS_RightControl@ */ /end MEASUREMENT
/begin MEASUREMENT MFS_LeftControl "" UBYTE CM_uint8 0 0 0 255 ECU_ADDRESS 0x3434C7BF /* @ECU_Address@MFS_LeftControl@ */ /end MEASUREMENT
/begin MEASUREMENT MFS_DownControl "" UBYTE CM_uint8 0 0 0 255 ECU_ADDRESS 0x3434C7BE /* @ECU_Address@MFS_DownControl@ */ /end MEASUREMENT
/begin MEASUREMENT BCMFR_STAT_RightMirrorPosY "" SBYTE CM_int8 0 0 -128 127 ECU_ADDRESS 0x3434CA75 /* @ECU_Address@BCMFR_STAT_RightMirrorPosY@ */ /end MEASUREMENT
/begin MEASUREMENT BCMFR_STAT_RightMirrorPosX "" SBYTE CM_int8 0 0 -128 127 ECU_ADDRESS 0x3434CA76 /* @ECU_Address@BCMFR_STAT_RightMirrorPosX@ */ /end MEASUREMENT
/begin MEASUREMENT BCMFR_STAT_RightMirrorHeating "" UBYTE CM_uint8 0 0 0 255 ECU_ADDRESS 0x3434CA77 /* @ECU_Address@BCMFR_STAT_RightMirrorHeating@ */ /end MEASUREMENT
/begin MEASUREMENT BCMFR_STAT_RightMirrorFold "" UBYTE CM_uint8 0 0 0 255 ECU_ADDRESS 0x3434CA78 /* @ECU_Address@BCMFR_STAT_RightMirrorFold@ */ /end MEASUREMENT
/begin MEASUREMENT BCMFR_STAT_MirrorAdjustRight "" UBYTE CM_uint8 0 0 0 255 ECU_ADDRESS 0x3434CA79 /* @ECU_Address@BCMFR_STAT_MirrorAdjustRight@ */ /end MEASUREMENT
/begin MEASUREMENT BCMFL_STAT_MirrorAdjustLeft "" UBYTE CM_uint8 0 0 0 255 ECU_ADDRESS 0x3434CA7A /* @ECU_Address@BCMFL_STAT_MirrorAdjustLeft@ */ /end MEASUREMENT
/begin MEASUREMENT BCMFL_STAT_LeftMirrorPosY "" SBYTE CM_int8 0 0 -128 127 ECU_ADDRESS 0x3434CA63 /* @ECU_Address@BCMFL_STAT_LeftMirrorPosY@ */ /end MEASUREMENT
/begin MEASUREMENT BCMFL_STAT_LeftMirrorPosX "" SBYTE CM_int8 0 0 -128 127 ECU_ADDRESS 0x3434CA7C /* @ECU_Address@BCMFL_STAT_LeftMirrorPosX@ */ /end MEASUREMENT
/begin MEASUREMENT BCMFL_STAT_LeftMirrorHeating "" UBYTE CM_uint8 0 0 0 255 ECU_ADDRESS 0x3434CA7D /* @ECU_Address@BCMFL_STAT_LeftMirrorHeating@ */ /end MEASUREMENT
/begin MEASUREMENT BCMFL_STAT_LeftMirrorFold "" UBYTE CM_uint8 0 0 0 255 ECU_ADDRESS 0x3434CA7E /* @ECU_Address@BCMFL_STAT_LeftMirrorFold@ */ /end MEASUREMENT
/begin MEASUREMENT S2S_SwitchLightBrightness "" UBYTE CM_uint8 0 0 0 255 ECU_ADDRESS 0x3434C793 /* @ECU_Address@S2S_SwitchLightBrightness@ */ /end MEASUREMENT
/begin MEASUREMENT S2S_RearDomeLampSet "" UBYTE CM_uint8 0 0 0 255 ECU_ADDRESS 0x3434C792 /* @ECU_Address@S2S_RearDomeLampSet@ */ /end MEASUREMENT
/begin MEASUREMENT S2S_FrontDomeLampSet "" UBYTE CM_uint8 0 0 0 255 ECU_ADDRESS 0x3434C791 /* @ECU_Address@S2S_FrontDomeLampSet@ */ /end MEASUREMENT
/begin MEASUREMENT S2S_FootwellLightMode "" UBYTE CM_uint8 0 0 0 255 ECU_ADDRESS 0x3434C790 /* @ECU_Address@S2S_FootwellLightMode@ */ /end MEASUREMENT
/begin MEASUREMENT S2S_AmbLightTypeReq "" UBYTE CM_uint8 0 0 0 255 ECU_ADDRESS 0x3434C78F /* @ECU_Address@S2S_AmbLightTypeReq@ */ /end MEASUREMENT
/begin MEASUREMENT S2S_AmbLightColorRed "" UBYTE CM_uint8 0 0 0 255 ECU_ADDRESS 0x3434C78B /* @ECU_Address@S2S_AmbLightColorRed@ */ /end MEASUREMENT
/begin MEASUREMENT S2S_AmbLightColorGreen "" UBYTE CM_uint8 0 0 0 255 ECU_ADDRESS 0x3434C78C /* @ECU_Address@S2S_AmbLightColorGreen@ */ /end MEASUREMENT
/begin MEASUREMENT S2S_AmbLightColorBlue "" UBYTE CM_uint8 0 0 0 255 ECU_ADDRESS 0x3434C78D /* @ECU_Address@S2S_AmbLightColorBlue@ */ /end MEASUREMENT
/begin MEASUREMENT S2S_AmbLightBrightnessReq "" UBYTE CM_uint8 0 0 0 255 ECU_ADDRESS 0x3434C78E /* @ECU_Address@S2S_AmbLightBrightnessReq@ */ /end MEASUREMENT
/begin MEASUREMENT S2S_AmbLightAllZoneReq "" UBYTE CM_uint8 0 0 0 255 ECU_ADDRESS 0x3434C789 /* @ECU_Address@S2S_AmbLightAllZoneReq@ */ /end MEASUREMENT
/begin MEASUREMENT PAS_RightDoorAmbLightReq "" UBYTE CM_uint8 0 0 0 255 ECU_ADDRESS 0x3434CA83 /* @ECU_Address@PAS_RightDoorAmbLightReq@ */ /end MEASUREMENT
/begin MEASUREMENT PAS_LeftDoorAmbLightReq "" UBYTE CM_uint8 0 0 0 255 ECU_ADDRESS 0x3434CA84 /* @ECU_Address@PAS_LeftDoorAmbLightReq@ */ /end MEASUREMENT
/begin MEASUREMENT ILM_SwitchLightBrightnessSet "" UBYTE CM_uint8 0 0 0 255 ECU_ADDRESS 0x3434C9E5 /* @ECU_Address@ILM_SwitchLightBrightnessSet@ */ /end MEASUREMENT
/begin MEASUREMENT ILM_SwitchLightBrightnessNot "" UBYTE CM_uint8 0 0 0 255 ECU_ADDRESS 0x3434CBAA /* @ECU_Address@ILM_SwitchLightBrightnessNot@ */ /end MEASUREMENT
/begin MEASUREMENT ILM_RearDomeLampReq "" UBYTE CM_uint8 0 0 0 255 ECU_ADDRESS 0x3434C9E6 /* @ECU_Address@ILM_RearDomeLampReq@ */ /end MEASUREMENT
/begin MEASUREMENT ILM_RRProjectorLightReq "" UBYTE CM_uint8 0 0 0 255 ECU_ADDRESS 0x3434C9E7 /* @ECU_Address@ILM_RRProjectorLightReq@ */ /end MEASUREMENT
/begin MEASUREMENT ILM_RRDoorCourtesyLightReq "" UBYTE CM_uint8 0 0 0 255 ECU_ADDRESS 0x3434C9E8 /* @ECU_Address@ILM_RRDoorCourtesyLightReq@ */ /end MEASUREMENT
/begin MEASUREMENT ILM_RLProjectorLightReq "" UBYTE CM_uint8 0 0 0 255 ECU_ADDRESS 0x3434C9E9 /* @ECU_Address@ILM_RLProjectorLightReq@ */ /end MEASUREMENT
/begin MEASUREMENT ILM_RLDoorCourtesyLightReq "" UBYTE CM_uint8 0 0 0 255 ECU_ADDRESS 0x3434C9EA /* @ECU_Address@ILM_RLDoorCourtesyLightReq@ */ /end MEASUREMENT
/begin MEASUREMENT ILM_PWM_FN_ILUM_LIN "" UBYTE CM_uint8 0 0 0 255 ECU_ADDRESS 0x3434CBA9 /* @ECU_Address@ILM_PWM_FN_ILUM_LIN@ */ /end MEASUREMENT
/begin MEASUREMENT ILM_FrontDomeLampReq "" UBYTE CM_uint8 0 0 0 255 ECU_ADDRESS 0x3434C9EB /* @ECU_Address@ILM_FrontDomeLampReq@ */ /end MEASUREMENT
/begin MEASUREMENT ILM_FRScuffLightReq "" UBYTE CM_uint8 0 0 0 255 ECU_ADDRESS 0x3434C9EC /* @ECU_Address@ILM_FRScuffLightReq@ */ /end MEASUREMENT
/begin MEASUREMENT ILM_FRProjectorLightReq "" UBYTE CM_uint8 0 0 0 255 ECU_ADDRESS 0x3434C9ED /* @ECU_Address@ILM_FRProjectorLightReq@ */ /end MEASUREMENT
/begin MEASUREMENT ILM_FRFootwellLightReq "" UBYTE CM_uint8 0 0 0 255 ECU_ADDRESS 0x3434C9EE /* @ECU_Address@ILM_FRFootwellLightReq@ */ /end MEASUREMENT
/begin MEASUREMENT ILM_FRDoorCourtesyLightReq "" UBYTE CM_uint8 0 0 0 255 ECU_ADDRESS 0x3434C9EF /* @ECU_Address@ILM_FRDoorCourtesyLightReq@ */ /end MEASUREMENT
/begin MEASUREMENT ILM_FLScuffLightReq "" UBYTE CM_uint8 0 0 0 255 ECU_ADDRESS 0x3434C9F0 /* @ECU_Address@ILM_FLScuffLightReq@ */ /end MEASUREMENT
/begin MEASUREMENT ILM_FLProjectorLightReq "" UBYTE CM_uint8 0 0 0 255 ECU_ADDRESS 0x3434C9F1 /* @ECU_Address@ILM_FLProjectorLightReq@ */ /end MEASUREMENT
/begin MEASUREMENT ILM_FLFootwellLightReq "" UBYTE CM_uint8 0 0 0 255 ECU_ADDRESS 0x3434C9F2 /* @ECU_Address@ILM_FLFootwellLightReq@ */ /end MEASUREMENT
/begin MEASUREMENT ILM_FLDoorCourtesyLightReq "" UBYTE CM_uint8 0 0 0 255 ECU_ADDRESS 0x3434C9F3 /* @ECU_Address@ILM_FLDoorCourtesyLightReq@ */ /end MEASUREMENT
/begin MEASUREMENT ILM_CargoLightReq "" UBYTE CM_uint8 0 0 0 255 ECU_ADDRESS 0x3434C9F4 /* @ECU_Address@ILM_CargoLightReq@ */ /end MEASUREMENT
/begin MEASUREMENT ILM_BonnetLightReq "" UBYTE CM_uint8 0 0 0 255 ECU_ADDRESS 0x3434C9F5 /* @ECU_Address@ILM_BonnetLightReq@ */ /end MEASUREMENT
/begin MEASUREMENT ILM_AmbLightZoneRRReq_Z4B "" UBYTE CM_uint8 0 0 0 255 ECU_ADDRESS 0x3434C9D5 /* @ECU_Address@ILM_AmbLightZoneRRReq_Z4B@ */ /end MEASUREMENT
/begin MEASUREMENT ILM_AmbLightZoneRRReq_Z4 "" UBYTE CM_uint8 0 0 0 255 ECU_ADDRESS 0x3434C9D4 /* @ECU_Address@ILM_AmbLightZoneRRReq_Z4@ */ /end MEASUREMENT
/begin MEASUREMENT ILM_AmbLightZoneRLReq_Z5B "" UBYTE CM_uint8 0 0 0 255 ECU_ADDRESS 0x3434C9D3 /* @ECU_Address@ILM_AmbLightZoneRLReq_Z5B@ */ /end MEASUREMENT
/begin MEASUREMENT ILM_AmbLightZoneRLReq_Z5 "" UBYTE CM_uint8 0 0 0 255 ECU_ADDRESS 0x3434C9D2 /* @ECU_Address@ILM_AmbLightZoneRLReq_Z5@ */ /end MEASUREMENT
/begin MEASUREMENT ILM_AmbLightZoneIPPassReq_Z6B "" UBYTE CM_uint8 0 0 0 255 ECU_ADDRESS 0x3434C9D1 /* @ECU_Address@ILM_AmbLightZoneIPPassReq_Z6B@ */ /end MEASUREMENT
/begin MEASUREMENT ILM_AmbLightZoneIPPassReq_Z6 "" UBYTE CM_uint8 0 0 0 255 ECU_ADDRESS 0x3434C9D0 /* @ECU_Address@ILM_AmbLightZoneIPPassReq_Z6@ */ /end MEASUREMENT
/begin MEASUREMENT ILM_AmbLightZoneIPDrivReq_Z1 "" UBYTE CM_uint8 0 0 0 255 ECU_ADDRESS 0x3434C9CF /* @ECU_Address@ILM_AmbLightZoneIPDrivReq_Z1@ */ /end MEASUREMENT
/begin MEASUREMENT ILM_AmbLightZoneFRReq_Z2B "" UBYTE CM_uint8 0 0 0 255 ECU_ADDRESS 0x3434C9CE /* @ECU_Address@ILM_AmbLightZoneFRReq_Z2B@ */ /end MEASUREMENT
/begin MEASUREMENT ILM_AmbLightZoneFRReq_Z2 "" UBYTE CM_uint8 0 0 0 255 ECU_ADDRESS 0x3434C9CD /* @ECU_Address@ILM_AmbLightZoneFRReq_Z2@ */ /end MEASUREMENT
/begin MEASUREMENT ILM_AmbLightZoneFLReq_Z3B "" UBYTE CM_uint8 0 0 0 255 ECU_ADDRESS 0x3434C9CC /* @ECU_Address@ILM_AmbLightZoneFLReq_Z3B@ */ /end MEASUREMENT
/begin MEASUREMENT ILM_AmbLightZoneFLReq_Z3 "" UBYTE CM_uint8 0 0 0 255 ECU_ADDRESS 0x3434C9CB /* @ECU_Address@ILM_AmbLightZoneFLReq_Z3@ */ /end MEASUREMENT
/begin MEASUREMENT ILM_AmbLightZoneConsRReq_Z8B "" UBYTE CM_uint8 0 0 0 255 ECU_ADDRESS 0x3434C9CA /* @ECU_Address@ILM_AmbLightZoneConsRReq_Z8B@ */ /end MEASUREMENT
/begin MEASUREMENT ILM_AmbLightZoneConsRReq_Z8 "" UBYTE CM_uint8 0 0 0 255 ECU_ADDRESS 0x3434C9C9 /* @ECU_Address@ILM_AmbLightZoneConsRReq_Z8@ */ /end MEASUREMENT
/begin MEASUREMENT ILM_AmbLightZoneConsRRReq_Z10 "" UBYTE CM_uint8 0 0 0 255 ECU_ADDRESS 0x3434C9C8 /* @ECU_Address@ILM_AmbLightZoneConsRRReq_Z10@ */ /end MEASUREMENT
/begin MEASUREMENT ILM_AmbLightZoneConsRLReq_Z9 "" UBYTE CM_uint8 0 0 0 255 ECU_ADDRESS 0x3434C9C7 /* @ECU_Address@ILM_AmbLightZoneConsRLReq_Z9@ */ /end MEASUREMENT
/begin MEASUREMENT ILM_AmbLightZoneConsLReq_Z7B "" UBYTE CM_uint8 0 0 0 255 ECU_ADDRESS 0x3434C9C6 /* @ECU_Address@ILM_AmbLightZoneConsLReq_Z7B@ */ /end MEASUREMENT
/begin MEASUREMENT ILM_AmbLightZoneConsLReq_Z7 "" UBYTE CM_uint8 0 0 0 255 ECU_ADDRESS 0x3434C9C5 /* @ECU_Address@ILM_AmbLightZoneConsLReq_Z7@ */ /end MEASUREMENT
/begin MEASUREMENT ILM_AmbLightTypeReq "" UBYTE CM_uint8 0 0 0 255 ECU_ADDRESS 0x3434C9C4 /* @ECU_Address@ILM_AmbLightTypeReq@ */ /end MEASUREMENT
/begin MEASUREMENT ILM_AmbLightT4Req "" FLOAT32_IEEE CM_single 0 0 -3.4E+38 3.4E+38 ECU_ADDRESS 0x3434CB10 /* @ECU_Address@ILM_AmbLightT4Req@ */ /end MEASUREMENT
/begin MEASUREMENT ILM_AmbLightT3Req "" FLOAT32_IEEE CM_single 0 0 -3.4E+38 3.4E+38 ECU_ADDRESS 0x3434CAC0 /* @ECU_Address@ILM_AmbLightT3Req@ */ /end MEASUREMENT
/begin MEASUREMENT ILM_AmbLightT2Req "" FLOAT32_IEEE CM_single 0 0 -3.4E+38 3.4E+38 ECU_ADDRESS 0x3434CAF0 /* @ECU_Address@ILM_AmbLightT2Req@ */ /end MEASUREMENT
/begin MEASUREMENT ILM_AmbLightT1Req "" FLOAT32_IEEE CM_single 0 0 -3.4E+38 3.4E+38 ECU_ADDRESS 0x3434CB08 /* @ECU_Address@ILM_AmbLightT1Req@ */ /end MEASUREMENT
/begin MEASUREMENT ILM_AmbLightN2Req "" FLOAT32_IEEE CM_single 0 0 -3.4E+38 3.4E+38 ECU_ADDRESS 0x3434CB04 /* @ECU_Address@ILM_AmbLightN2Req@ */ /end MEASUREMENT
/begin MEASUREMENT ILM_AmbLightN1Req "" FLOAT32_IEEE CM_single 0 0 -3.4E+38 3.4E+38 ECU_ADDRESS 0x3434CAF4 /* @ECU_Address@ILM_AmbLightN1Req@ */ /end MEASUREMENT
/begin MEASUREMENT ILM_AmbLightColorRed "" UBYTE CM_uint8 0 0 0 255 ECU_ADDRESS 0x3434C9BF /* @ECU_Address@ILM_AmbLightColorRed@ */ /end MEASUREMENT
/begin MEASUREMENT ILM_AmbLightColorGreen "" UBYTE CM_uint8 0 0 0 255 ECU_ADDRESS 0x3434C9BE /* @ECU_Address@ILM_AmbLightColorGreen@ */ /end MEASUREMENT
/begin MEASUREMENT ILM_AmbLightColorBlue "" UBYTE CM_uint8 0 0 0 255 ECU_ADDRESS 0x3434C9D7 /* @ECU_Address@ILM_AmbLightColorBlue@ */ /end MEASUREMENT
/begin MEASUREMENT ILM_AmbLightBrightnessReq "" UBYTE CM_uint8 0 0 0 255 ECU_ADDRESS 0x3434C9D6 /* @ECU_Address@ILM_AmbLightBrightnessReq@ */ /end MEASUREMENT
/begin MEASUREMENT BCMRE_RearDomeLampStatus "" UBYTE CM_uint8 0 0 0 255 ECU_ADDRESS 0x3434CA85 /* @ECU_Address@BCMRE_RearDomeLampStatus@ */ /end MEASUREMENT
/begin MEASUREMENT BCMRE_RRProjectorLightSts "" UBYTE CM_uint8 0 0 0 255 ECU_ADDRESS 0x3434CA86 /* @ECU_Address@BCMRE_RRProjectorLightSts@ */ /end MEASUREMENT
/begin MEASUREMENT BCMRE_RLProjectorLightSts "" UBYTE CM_uint8 0 0 0 255 ECU_ADDRESS 0x3434CA87 /* @ECU_Address@BCMRE_RLProjectorLightSts@ */ /end MEASUREMENT
/begin MEASUREMENT BCMRE_RLDoorCourtesyLightSts "" UBYTE CM_uint8 0 0 0 255 ECU_ADDRESS 0x3434CA88 /* @ECU_Address@BCMRE_RLDoorCourtesyLightSts@ */ /end MEASUREMENT
/begin MEASUREMENT BCMRE_CargoLightSts "" UBYTE CM_uint8 0 0 0 255 ECU_ADDRESS 0x3434CA89 /* @ECU_Address@BCMRE_CargoLightSts@ */ /end MEASUREMENT
/begin MEASUREMENT BCMRE_BonnetLightSts "" UBYTE CM_uint8 0 0 0 255 ECU_ADDRESS 0x3434CA8A /* @ECU_Address@BCMRE_BonnetLightSts@ */ /end MEASUREMENT
/begin MEASUREMENT BCMFR_FRScuffLightSts "" UBYTE CM_uint8 0 0 0 255 ECU_ADDRESS 0x3434CA8B /* @ECU_Address@BCMFR_FRScuffLightSts@ */ /end MEASUREMENT
/begin MEASUREMENT BCMFR_FRProjectorLightSts "" UBYTE CM_uint8 0 0 0 255 ECU_ADDRESS 0x3434CA8C /* @ECU_Address@BCMFR_FRProjectorLightSts@ */ /end MEASUREMENT
/begin MEASUREMENT BCMFR_FRFootwellLightSts "" UBYTE CM_uint8 0 0 0 255 ECU_ADDRESS 0x3434CA68 /* @ECU_Address@BCMFR_FRFootwellLightSts@ */ /end MEASUREMENT
/begin MEASUREMENT BCMFR_FRDoorCourtesyLightSts "" UBYTE CM_uint8 0 0 0 255 ECU_ADDRESS 0x3434CA8E /* @ECU_Address@BCMFR_FRDoorCourtesyLightSts@ */ /end MEASUREMENT
/begin MEASUREMENT BCMFL_SwitchLightBrightnessSts "" UBYTE CM_uint8 0 0 0 255 ECU_ADDRESS 0x3434CA2C /* @ECU_Address@BCMFL_SwitchLightBrightnessSts@ */ /end MEASUREMENT
/begin MEASUREMENT BCMFL_FrontDomeLampStatus "" UBYTE CM_uint8 0 0 0 255 ECU_ADDRESS 0x3434CA8F /* @ECU_Address@BCMFL_FrontDomeLampStatus@ */ /end MEASUREMENT
/begin MEASUREMENT BCMFL_FLScuffLightSts "" UBYTE CM_uint8 0 0 0 255 ECU_ADDRESS 0x3434CA7B /* @ECU_Address@BCMFL_FLScuffLightSts@ */ /end MEASUREMENT
/begin MEASUREMENT BCMFL_FLProjectorLightSts "" UBYTE CM_uint8 0 0 0 255 ECU_ADDRESS 0x3434CA91 /* @ECU_Address@BCMFL_FLProjectorLightSts@ */ /end MEASUREMENT
/begin MEASUREMENT BCMFL_FLFootwellLightSts "" UBYTE CM_uint8 0 0 0 255 ECU_ADDRESS 0x3434CA92 /* @ECU_Address@BCMFL_FLFootwellLightSts@ */ /end MEASUREMENT
/begin MEASUREMENT BCMFL_FLDoorCourtesyLightSts "" UBYTE CM_uint8 0 0 0 255 ECU_ADDRESS 0x3434CA93 /* @ECU_Address@BCMFL_FLDoorCourtesyLightSts@ */ /end MEASUREMENT
/begin MEASUREMENT S2S_CAPPHornRequest "" UBYTE CM_uint8 0 0 0 255 ECU_ADDRESS 0x3434C7B2 /* @ECU_Address@S2S_CAPPHornRequest@ */ /end MEASUREMENT
/begin MEASUREMENT HCM_HornRequest "" UBYTE CM_uint8 0 0 0 255 ECU_ADDRESS 0x3434C9F6 /* @ECU_Address@HCM_HornRequest@ */ /end MEASUREMENT
/begin MEASUREMENT CLM_HornONReminder "" UBYTE CM_uint8 0 0 0 255 ECU_ADDRESS 0x3434CB64 /* @ECU_Address@CLM_HornONReminder@ */ /end MEASUREMENT
/begin MEASUREMENT BCMFL_HornSts "" UBYTE CM_uint8 0 0 0 255 ECU_ADDRESS 0x3434CA94 /* @ECU_Address@BCMFL_HornSts@ */ /end MEASUREMENT
/begin MEASUREMENT ATA_HornRequest "" UBYTE CM_uint8 0 0 0 255 ECU_ADDRESS 0x3434CB5C /* @ECU_Address@ATA_HornRequest@ */ /end MEASUREMENT
/begin MEASUREMENT BCMRE_RightBrakeLightStatus "" UBYTE CM_uint8 0 0 0 255 ECU_ADDRESS 0x3434CAA1 /* @ECU_Address@BCMRE_RightBrakeLightStatus@ */ /end MEASUREMENT
/begin MEASUREMENT BCMRE_RRTurnLightStatus "" UBYTE CM_uint8 0 0 0 255 ECU_ADDRESS 0x3434CA99 /* @ECU_Address@BCMRE_RRTurnLightStatus@ */ /end MEASUREMENT
/begin MEASUREMENT BCMRE_RRPosLightStatus "" UBYTE CM_uint8 0 0 0 255 ECU_ADDRESS 0x3434CAA5 /* @ECU_Address@BCMRE_RRPosLightStatus@ */ /end MEASUREMENT
/begin MEASUREMENT BCMRE_RRFogLightStatus "" UBYTE CM_uint8 0 0 0 255 ECU_ADDRESS 0x3434CAA6 /* @ECU_Address@BCMRE_RRFogLightStatus@ */ /end MEASUREMENT
/begin MEASUREMENT BCMRE_RLTurnLightStatus "" UBYTE CM_uint8 0 0 0 255 ECU_ADDRESS 0x3434CAA7 /* @ECU_Address@BCMRE_RLTurnLightStatus@ */ /end MEASUREMENT
/begin MEASUREMENT BCMRE_RLPosLightStatus "" UBYTE CM_uint8 0 0 0 255 ECU_ADDRESS 0x3434CAA2 /* @ECU_Address@BCMRE_RLPosLightStatus@ */ /end MEASUREMENT
/begin MEASUREMENT BCMRE_RLFogLightStatus "" UBYTE CM_uint8 0 0 0 255 ECU_ADDRESS 0x3434CAA9 /* @ECU_Address@BCMRE_RLFogLightStatus@ */ /end MEASUREMENT
/begin MEASUREMENT BCMRE_LicensePlateLampStatus "" UBYTE CM_uint8 0 0 0 255 ECU_ADDRESS 0x3434CAAA /* @ECU_Address@BCMRE_LicensePlateLampStatus@ */ /end MEASUREMENT
/begin MEASUREMENT BCMRE_LeftBrakeLightStatus "" UBYTE CM_uint8 0 0 0 255 ECU_ADDRESS 0x3434C9C2 /* @ECU_Address@BCMRE_LeftBrakeLightStatus@ */ /end MEASUREMENT
/begin MEASUREMENT BCMRE_CMBrakeLightStatus "" UBYTE CM_uint8 0 0 0 255 ECU_ADDRESS 0x3434CAAC /* @ECU_Address@BCMRE_CMBrakeLightStatus@ */ /end MEASUREMENT
/begin MEASUREMENT BCMFR_RightReverseLampStatus "" UBYTE CM_uint8 0 0 0 255 ECU_ADDRESS 0x3434CAA4 /* @ECU_Address@BCMFR_RightReverseLampStatus@ */ /end MEASUREMENT
/begin MEASUREMENT BCMFR_FRPosLightStatus "" UBYTE CM_uint8 0 0 0 255 ECU_ADDRESS 0x3434CB69 /* @ECU_Address@BCMFR_FRPosLightStatus@ */ /end MEASUREMENT
/begin MEASUREMENT BCMFR_FRLowBeamStatus "" UBYTE CM_uint8 0 0 0 255 ECU_ADDRESS 0x3434CB6A /* @ECU_Address@BCMFR_FRLowBeamStatus@ */ /end MEASUREMENT
/begin MEASUREMENT BCMFR_FRHighBeamStatus "" UBYTE CM_uint8 0 0 0 255 ECU_ADDRESS 0x3434CB6B /* @ECU_Address@BCMFR_FRHighBeamStatus@ */ /end MEASUREMENT
/begin MEASUREMENT BCMFR_FRFogLightStatus "" UBYTE CM_uint8 0 0 0 255 ECU_ADDRESS 0x3434CAB1 /* @ECU_Address@BCMFR_FRFogLightStatus@ */ /end MEASUREMENT
/begin MEASUREMENT BCMFR_FLFogLightStatus "" UBYTE CM_uint8 0 0 0 255 ECU_ADDRESS 0x3434CA6D /* @ECU_Address@BCMFR_FLFogLightStatus@ */ /end MEASUREMENT
/begin MEASUREMENT BCMFL_LeftReverseLampStatus "" UBYTE CM_uint8 0 0 0 255 ECU_ADDRESS 0x3434CAB0 /* @ECU_Address@BCMFL_LeftReverseLampStatus@ */ /end MEASUREMENT
/begin MEASUREMENT BCMFL_FRTurnLightStatus "" UBYTE CM_uint8 0 0 0 255 ECU_ADDRESS 0x3434CAAD /* @ECU_Address@BCMFL_FRTurnLightStatus@ */ /end MEASUREMENT
/begin MEASUREMENT BCMFL_FLTurnLightStatus "" UBYTE CM_uint8 0 0 0 255 ECU_ADDRESS 0x3434CAB3 /* @ECU_Address@BCMFL_FLTurnLightStatus@ */ /end MEASUREMENT
/begin MEASUREMENT BCMFL_FLPosLightStatus "" UBYTE CM_uint8 0 0 0 255 ECU_ADDRESS 0x3434CAAB /* @ECU_Address@BCMFL_FLPosLightStatus@ */ /end MEASUREMENT
/begin MEASUREMENT BCMFL_FLLowBeamStatus "" UBYTE CM_uint8 0 0 0 255 ECU_ADDRESS 0x3434CAA3 /* @ECU_Address@BCMFL_FLLowBeamStatus@ */ /end MEASUREMENT
/begin MEASUREMENT BCMFL_FLHighBeamStatus "" UBYTE CM_uint8 0 0 0 255 ECU_ADDRESS 0x3434CA6F /* @ECU_Address@BCMFL_FLHighBeamStatus@ */ /end MEASUREMENT
/begin FUNCTION ExteriorLightManager_BitUpack "" /begin IN_MEASUREMENT SCM_LeftStalkSwitchStatus /end IN_MEASUREMENT /end FUNCTION
/begin FUNCTION WiperWasherManager_BitUpack ""
 /begin IN_MEASUREMENT COM_RightStalkSwitchSts WiperWasherManager_ARID_DEF.DataTypeCov1 WiperWasherManager_ARID_DEF.DataTypeCov2 WiperWasherManager_ARID_DEF.DataTypeCov4 WiperWasherManager_ARID_DEF.DataTypeCov7 /end IN_MEASUREMENT
/end FUNCTION
/begin FUNCTION ExteriorLight_IfActionSubsystem ""
 /begin IN_MEASUREMENT ExteriorLightManager_ARID_DEF.Merge ExteriorLightManager_ARID_DEF.UnitDelay_DSTATE_e0 /end IN_MEASUREMENT
/end FUNCTION
/begin FUNCTION ExteriorLightManager_Hysteresis ""
 /begin IN_MEASUREMENT YSS_LonglAccRate ExteriorLightManager_ARID_DEF.DelayInput1_DSTATE_hz /end IN_MEASUREMENT
/end FUNCTION
/end MODULE
/end PROJECT
/* (add any file trailer comments here) */ /* EOF aem_ApplErrMgr_FD.a2l*/
